## CMakeLists.txt
```
cmake_minimum_required(VERSION 3.20.0)

set(CMAKE_CXX_STANDARD 20)
set(CMAKE_CXX_STANDARD_REQUIRED ON)
set(CMAKE_CXX_EXTENSIONS OFF)

find_package(Zephyr REQUIRED HINTS $ENV{ZEPHYR_BASE})
project(I2c_task, CXX)

target_sources(app PRIVATE
    src/main.cpp
)

target_compile_options(app PRIVATE
    -Wall
    -Wextra
    -Werror
   
)
```

## prj.conf
```kconfig
CONFIG_CPP=y
CONFIG_STD_CPP20=y
CONFIG_GLIBCXX_LIBCPP=y
CONFIG_NEWLIB_LIBC=y


CONFIG_HEAP_MEM_POOL_SIZE=0

CONFIG_I2C=y

# Console/logging still goes out over the board's default UART console
# (e.g. via minicom/ST-Link VCP); this is independent of the I2C1
# peripheral now used for the application protocol itself.
CONFIG_SERIAL=y

CONFIG_LOG=y
CONFIG_UART_CONSOLE=y
CONFIG_CONSOLE=y

CONFIG_ASSERT=y
CONFIG_BOOT_BANNER=n
CONFIG_REBOOT=y
```

## boards/nucleo_g474re.overlay
```dts
#include <zephyr/dt-bindings/i2c/i2c.h>

/*
 * I2C1 on the Arduino header: SCL=PB8, SDA=PB9.
 * Standard-mode (100 kHz) I2C, matching the previous SPI project's
 * 1 MHz-class polling cadence but at typical I2C bus speed.
 */
&i2c1 {
	pinctrl-0 = <&i2c1_scl_pb8 &i2c1_sda_pb9>;
	pinctrl-names = "default";
	status = "okay";
	clock-frequency = <I2C_BITRATE_STANDARD>;
};
```

## src/main.cpp
```c
#include <zephyr/kernel.h>
#include <zephyr/logging/log.h>
#include <zephyr/device.h>
#include <zephyr/drivers/i2c.h>

LOG_MODULE_REGISTER(I2c_task, LOG_LEVEL_INF);

namespace {

const struct device* i2c_dev = DEVICE_DT_GET(DT_NODELABEL(i2c1));

// TODO: replace with the actual 7-bit address of the target I2C device.
constexpr uint16_t kI2cSlaveAddr = 0x50U;

}  // namespace

int main() {

    LOG_INF("Board is booting up");

    if (!device_is_ready(i2c_dev))
    {
        LOG_ERR("I2C device is not ready");
        return -1;
    }

    LOG_INF("Board is running");

    uint8_t tx_byte = 0x00U;
    uint8_t rx_byte = 0x00U;

    while (true)
    {
        int ret = i2c_write_read(i2c_dev, kI2cSlaveAddr,
                                  &tx_byte, sizeof(tx_byte),
                                  &rx_byte, sizeof(rx_byte));

        if (ret == 0)
        {
            LOG_INF("Received byte: 0x%02x", rx_byte);
        }
        else
        {
            LOG_ERR("I2C transfer failed: %d", ret);
        }

        k_msleep(500);
    }

    return 0;
}
```
