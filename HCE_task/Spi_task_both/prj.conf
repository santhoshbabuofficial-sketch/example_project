## CMakeLists.txt
```
cmake_minimum_required(VERSION 3.20.0)

set(CMAKE_CXX_STANDARD 20)
set(CMAKE_CXX_STANDARD_REQUIRED ON)
set(CMAKE_CXX_EXTENSIONS OFF)

find_package(Zephyr REQUIRED HINTS $ENV{ZEPHYR_BASE})
project(Spi_task, CXX)

target_sources(app PRIVATE
    src/main.cpp
)

target_compile_options(app PRIVATE
    -Wall
    -Wextra
    -Werror
   
)
```

## prj.conf
```kconfig
CONFIG_CPP=y
CONFIG_STD_CPP20=y
CONFIG_GLIBCXX_LIBCPP=y
CONFIG_NEWLIB_LIBC=y


CONFIG_HEAP_MEM_POOL_SIZE=0

CONFIG_GPIO=y
CONFIG_SPI=y

# Console/logging still goes out over the board's default UART console
# (e.g. via minicom/ST-Link VCP); this is independent of the SPI1
# peripheral now used for the application protocol itself.
CONFIG_SERIAL=y

CONFIG_LOG=y
CONFIG_UART_CONSOLE=y
CONFIG_CONSOLE=y

CONFIG_ASSERT=y
CONFIG_BOOT_BANNER=n
CONFIG_REBOOT=y
```

## boards/nucleo_g474re.overlay
```dts
#include <zephyr/dt-bindings/gpio/gpio.h>

/*
 * SPI1 on the Arduino header: SCK=PA5, MISO=PA6, MOSI=PA7, CS=PB6.
 * CS is driven as a plain GPIO (cs-gpios) rather than hardware NSS, which
 * is the standard, driver-independent way Zephyr controls chip select.
 */
&spi1 {
	pinctrl-0 = <&spi1_sck_pa5 &spi1_miso_pa6 &spi1_mosi_pa7>;
	pinctrl-names = "default";
	cs-gpios = <&gpiob 6 GPIO_ACTIVE_LOW>;
	status = "okay";
};
```

## src/main.cpp
```c
#include <zephyr/kernel.h>
#include <zephyr/logging/log.h>
#include <zephyr/device.h>
#include <zephyr/drivers/spi.h>
#include <zephyr/drivers/gpio.h>

LOG_MODULE_REGISTER(Spi_task, LOG_LEVEL_INF);

namespace {

const struct device* spi_dev = DEVICE_DT_GET(DT_NODELABEL(spi1));

struct spi_cs_control cs_ctrl = {
    .gpio = GPIO_DT_SPEC_GET(DT_NODELABEL(spi1), cs_gpios),
    .delay = 0U,
};

struct spi_config spi_cfg = {
    .frequency = 1000000U,
    .operation = SPI_WORD_SET(8) | SPI_TRANSFER_MSB | SPI_OP_MODE_MASTER,
    .slave = 0U,
    .cs = cs_ctrl,
};

}  // namespace

int main() {

    LOG_INF("Board is booting up");

    if (!device_is_ready(spi_dev))
    {
        LOG_ERR("SPI device is not ready");
        return -1;
    }

    if (!device_is_ready(cs_ctrl.gpio.port))
    {
        LOG_ERR("SPI CS GPIO is not ready");
        return -1;
    }

    LOG_INF("Board is running");

    uint8_t tx_byte = 0x00U;
    uint8_t rx_byte = 0x00U;

    struct spi_buf tx_buf = { .buf = &tx_byte, .len = 1U };
    struct spi_buf_set tx_set = { .buffers = &tx_buf, .count = 1U };

    struct spi_buf rx_buf = { .buf = &rx_byte, .len = 1U };
    struct spi_buf_set rx_set = { .buffers = &rx_buf, .count = 1U };

    while (true)
    {
        int ret = spi_transceive(spi_dev, &spi_cfg, &tx_set, &rx_set);

        if (ret == 0)
        {
            LOG_INF("Received byte: 0x%02x", rx_byte);
        }
        else
        {
            LOG_ERR("SPI transceive failed: %d", ret);
        }

        k_msleep(500);
    }

    return 0;
}
```
