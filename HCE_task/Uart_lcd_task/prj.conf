## CMakeLists.txt
```
cmake_minimum_required(VERSION 3.20.0)

set(CMAKE_CXX_STANDARD 20)
set(CMAKE_CXX_STANDARD_REQUIRED ON)
set(CMAKE_CXX_EXTENSIONS OFF)

find_package(Zephyr REQUIRED HINTS $ENV{ZEPHYR_BASE})
project(Uart_task, CXX)

target_sources(app PRIVATE
    src/main.cpp
    src/uart.cpp
    src/lcd.cpp
)

target_compile_options(app PRIVATE
    -Wall
    -Wextra
    -Werror
   
)
```

## prj.conf
```kconfig
CONFIG_CPP=y
CONFIG_STD_CPP20=y
CONFIG_GLIBCXX_LIBCPP=y
CONFIG_NEWLIB_LIBC=y


CONFIG_HEAP_MEM_POOL_SIZE=0

CONFIG_GPIO=y
CONFIG_I2C=y

CONFIG_SERIAL=y
CONFIG_UART_INTERRUPT_DRIVEN=y

CONFIG_LOG=y
CONFIG_UART_CONSOLE=y
CONFIG_CONSOLE=y

CONFIG_ASSERT=y
CONFIG_BOOT_BANNER=n
CONFIG_REBOOT=y
```

## boards/nucleo_g474re.overlay
```dts
&lpuart1 {
    
	current-speed = <115200>;
	status = "okay";
};

 / { 
	aliases
              {
                 uart1 = &lpuart1;
				 };
};

&i2c1 {
    status = "okay";
};
```

## src/main.cpp
```c
#include "uart.hpp"

int main() {

    return uart_run();
}
```

## src/lcd.cpp
```c
#include "lcd.hpp"

#include <zephyr/kernel.h>
#include <zephyr/device.h>
#include <zephyr/drivers/i2c.h>


namespace {

const struct device* i2c_dev = DEVICE_DT_GET(DT_NODELABEL(i2c1));

constexpr uint8_t lcd_addr  = 0x27;
constexpr uint8_t backlight = 0x08;
constexpr uint8_t en_bit    = 0x04;
constexpr uint8_t rs_bit    = 0x01;

void lcd_write4bits(uint8_t data)
{
    uint8_t buf = data | backlight;
    i2c_write(i2c_dev, &buf, 1, lcd_addr);

    buf = data | backlight | en_bit;
    i2c_write(i2c_dev, &buf, 1, lcd_addr);
    k_busy_wait(1);

    buf = data | backlight;
    i2c_write(i2c_dev, &buf, 1, lcd_addr);
    k_busy_wait(50);
}

void lcd_send(uint8_t value, uint8_t mode)
{
    uint8_t high_nibble = (value & 0xF0) | mode;
    uint8_t low_nibble  = static_cast<uint8_t>((value << 4) & 0xF0) | mode;

    lcd_write4bits(high_nibble);
    lcd_write4bits(low_nibble);
}

void lcd_command(uint8_t cmd)
{
    lcd_send(cmd, 0);
}

void lcd_data(uint8_t data)
{
    lcd_send(data, rs_bit);
}

}  // namespace


bool lcd_init()
{
    if (!device_is_ready(i2c_dev))
    {
        return false;
    }

    k_msleep(50);

    lcd_write4bits(0x30);
    k_msleep(5);
    lcd_write4bits(0x30);
    k_msleep(1);
    lcd_write4bits(0x30);
    k_msleep(1);
    lcd_write4bits(0x20);   /* switch to 4-bit mode */

    lcd_command(0x28);      /* 4-bit, 2 line, 5x8 font */
    lcd_command(0x0C);      /* display on, cursor off */
    lcd_command(0x01);      /* clear display */
    k_msleep(2);
    lcd_command(0x06);      /* entry mode: increment cursor */

    return true;
}

void lcd_print(const char* str)
{
    while (*str != '\0')
    {
        lcd_data(static_cast<uint8_t>(*str));
        str++;
    }
}
```

## src/lcd.hpp
```c
#pragma once

bool lcd_init();
void lcd_print(const char* str);
```

## src/uart.cpp
```c
#include "uart.hpp"
#include "lcd.hpp"

#include <zephyr/kernel.h>
#include <zephyr/logging/log.h>
#include <zephyr/device.h>
#include <zephyr/drivers/uart.h>
#include <cstring>

LOG_MODULE_REGISTER(Uart_task, LOG_LEVEL_INF);


namespace {

const struct device* uart_pin = DEVICE_DT_GET(DT_ALIAS(uart1)) ;
char rx_buf[15];
int i = 0;
}

int uart_run() {

    LOG_INF("Board is booting up");


    if (!device_is_ready(uart_pin)) 
    {
        LOG_ERR("UART device is not ready");
        return -1;
    }

    if (!lcd_init())
    {
        LOG_ERR("LCD device is not ready");
        return -1;
    }
     
      

    LOG_INF("Board is running");

    while (true)
    {
        unsigned char c;

        if (uart_poll_in(uart_pin, &c) == 0)
        {
            uart_poll_out(uart_pin, c);  

            if (c == '\n')
            {
                rx_buf[i] = '\0';
                i = 0;

                if (strcmp(rx_buf, "vanakam") == 0)
                {
                    const char* reply = "vanakam\r\n";

                    while (*reply != '\0')
                    {
                        uart_poll_out(uart_pin, *reply);
                        reply++;
                    }

                    lcd_print("vanakam");
                }
            }
            else if (i < 14)
            {
                rx_buf[i] = c;
                i++;
            }
        }
    }

    return 0;
   
}
```

## src/uart.hpp
```c
#pragma once

int uart_run();
```
