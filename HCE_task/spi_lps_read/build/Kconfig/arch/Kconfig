## HCE_task/spi_lps_read/build/Kconfig/arch/Kconfig
```kconfig
# Load arch Kconfig descriptions.
osource "/home/siva-inc-5840/Documents/zephyrproject/zephyr/arch/x86/Kconfig"
osource "/home/siva-inc-5840/Documents/zephyrproject/zephyr/arch/xtensa/Kconfig"
osource "/home/siva-inc-5840/Documents/zephyrproject/zephyr/arch/sparc/Kconfig"
osource "/home/siva-inc-5840/Documents/zephyrproject/zephyr/arch/riscv/Kconfig"
osource "/home/siva-inc-5840/Documents/zephyrproject/zephyr/arch/posix/Kconfig"
osource "/home/siva-inc-5840/Documents/zephyrproject/zephyr/arch/nios2/Kconfig"
osource "/home/siva-inc-5840/Documents/zephyrproject/zephyr/arch/mips/Kconfig"
osource "/home/siva-inc-5840/Documents/zephyrproject/zephyr/arch/arm64/Kconfig"
osource "/home/siva-inc-5840/Documents/zephyrproject/zephyr/arch/arm/Kconfig"
osource "/home/siva-inc-5840/Documents/zephyrproject/zephyr/arch/arc/Kconfig"
```
