## CMakeLists.txt
```
cmake_minimum_required(VERSION 3.20.0)

set(CMAKE_CXX_STANDARD 20)
set(CMAKE_CXX_STANDARD_REQUIRED ON)
set(CMAKE_CXX_EXTENSIONS OFF)

#
set(DTC_OVERLAY_FILE ${CMAKE_CURRENT_SOURCE_DIR}/Board/nucleo_g474re.overlay)

find_package(Zephyr REQUIRED HINTS $ENV{ZEPHYR_BASE})
project(Blink_Task LANGUAGES CXX)

target_sources(app PRIVATE
  ${CMAKE_CURRENT_SOURCE_DIR}/src/main.cpp
)

target_compile_options(app PRIVATE
  -Wall
  -Wextra
  -Werror
  -Wvolatile
)

target_include_directories(app PRIVATE
  ${CMAKE_CURRENT_SOURCE_DIR}/Include
)
```

## prj.conf
```kconfig
# --- Core ---------------------------------------------------------------
CONFIG_CPP=y
CONFIG_STD_CPP20=y
CONFIG_GLIBCXX_LIBCPP=y
CONFIG_NEWLIB_LIBC=y
CONFIG_MAIN_STACK_SIZE=2048

# --- GPIO -----------------------------------------------------------------
CONFIG_GPIO=y

# --- Logging --------------------------------------------------------------
CONFIG_LOG=y
CONFIG_LOG_MODE_DEFERRED=y
CONFIG_LOG_DEFAULT_LEVEL=3

# --- Console (routed to UART on this board) --------------------------------
CONFIG_CONSOLE=y
CONFIG_UART_CONSOLE=y

# --- No dynamic allocation in application code; keep heap minimal ---------
CONFIG_HEAP_MEM_POOL_SIZE=1024
```

## src/main.cpp
```c
#include <zephyr/kernel.h>                                  
#include <zephyr/logging/log.h>                                  
#include <zephyr/drivers/gpio.h>                                


LOG_MODULE_REGISTER(blink_task_main, LOG_LEVEL_INF);           


namespace {                                                       


constexpr uint16_t kBlinkPeriodMs = 500U;                         

const gpio_dt_spec g_led = GPIO_DT_SPEC_GET(DT_ALIAS(blinkled), gpios);


} 


int main() {                                                      

    LOG_INF("blink task booting");                                

    if (!gpio_is_ready_dt(&g_led)) {                               

        LOG_ERR("led gpio device not ready - halting");                 

        return -1;                                                       
    }

    const int config_result =
        gpio_pin_configure_dt(&g_led, GPIO_OUTPUT_INACTIVE);

    if (config_result != 0) {                                       

        LOG_ERR("led gpio configure failed (%d) - halting", config_result);
        // Prints configuration error along with the returned error code.

        return -1;                                                       // Stops program on failure.
    }

    LOG_INF("blink task running");                                      // Prints running message.

    while (true) {                                                       // Creates infinite RTOS task loop.

        gpio_pin_toggle_dt(&g_led);                                        // Toggles the LED output state.

        k_msleep(kBlinkPeriodMs);                                          // Delays thread for the blink period.
    }

    return 0;                                                             // Unreachable; kept for a well-defined return path.
}
```
