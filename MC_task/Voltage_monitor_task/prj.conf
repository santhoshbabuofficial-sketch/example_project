## CMakeLists.txt
```
cmake_minimum_required(VERSION 3.20.0)

set(CMAKE_CXX_STANDARD 20)
set(CMAKE_CXX_STANDARD_REQUIRED ON)
set(CMAKE_CXX_EXTENSIONS OFF)

# The overlay lives in "Board/" (capital B, singular), which is not
# Zephyr's auto-detected "boards/" convention, so DTC_OVERLAY_FILE must be
# set explicitly - and before find_package(Zephyr ...).
set(DTC_OVERLAY_FILE ${CMAKE_CURRENT_SOURCE_DIR}/Board/nucleo_g474re.overlay)

find_package(Zephyr REQUIRED HINTS $ENV{ZEPHYR_BASE})
project(Voltage_Monitor_Task LANGUAGES CXX)

target_sources(app PRIVATE
  ${CMAKE_CURRENT_SOURCE_DIR}/src/main.cpp
  ${CMAKE_CURRENT_SOURCE_DIR}/src/voltage_sensor.cpp
)

target_compile_options(app PRIVATE
  -Wall
  -Wextra
  -Werror
  -Wvolatile
)

# Folder on disk is "Include/" (capital I) - case-sensitive on Linux.
target_include_directories(app PRIVATE
  ${CMAKE_CURRENT_SOURCE_DIR}/Include
)
```

## prj.conf
```kconfig
# --- Core ---------------------------------------------------------------
CONFIG_CPP=y
CONFIG_STD_CPP20=y
CONFIG_GLIBCXX_LIBCPP=y
CONFIG_NEWLIB_LIBC=y
CONFIG_MAIN_STACK_SIZE=2048

# --- GPIO (PC0 normal trigger / PC1 fault trigger) -------------------------
CONFIG_GPIO=y

# --- ADC (0-25V voltage sensor module on ADC2_IN17 / PA4) -------------------
CONFIG_ADC=y
CONFIG_ADC_STM32=y

# --- Floating point in log output ------------------------------------------
CONFIG_FPU=y

# --- Logging --------------------------------------------------------------------
CONFIG_LOG=y
CONFIG_LOG_MODE_DEFERRED=y
CONFIG_LOG_DEFAULT_LEVEL=3

# --- Console (routed to UART on this board) ---------------------------------------
CONFIG_CONSOLE=y
CONFIG_UART_CONSOLE=y

# --- No dynamic allocation in application code; keep heap minimal for libc use ------
CONFIG_HEAP_MEM_POOL_SIZE=1024
```

## src/main.cpp
```c
#include <zephyr/kernel.h>                                       // Includes Zephyr kernel sleep and thread functions.
#include <zephyr/logging/log.h>                                  // Includes Zephyr logging functions.

#include "voltage_sensor.hpp"                                    // Includes VoltageSensor / VoltageMonitor definitions.


LOG_MODULE_REGISTER(main, LOG_LEVEL_INF);                        // Creates log module for the application entry point.


namespace {                                                       // Opens anonymous namespace for file-local objects.

constexpr uint32_t kSupervisionIntervalMs = 100U;
// Voltage is re-evaluated 10x per second. Fast enough to react to a
// supply going out of range, slow enough that the averaged ADC read
// costs nothing meaningful.

// Statically allocated - no heap use anywhere in this application.
motor_control::VoltageSensor g_voltage_sensor{};                  // Creates the 0-25V module voltage sensor object.

motor_control::VoltageMonitor g_voltage_monitor{g_voltage_sensor}; // Creates the supervisor driving PC0 / PC1.

}  // namespace


int main() {                                                       // Application entry point.

    LOG_INF("Voltage supervision task starting (nominal 24 V)");   // Prints application startup message.

    if (!g_voltage_monitor.Init()) {                                // Initializes ADC path and both trigger pins.

        LOG_ERR("Voltage monitor init failed - halting");           // Prints initialization failure.

        // Init() leaves both trigger pins LOW on any failure path, so
        // halting here asserts neither "normal" nor "fault".
        return -1;                                                   // Stops the application.
    }

    while (true) {                                                   // Runs the supervision loop forever.

        static_cast<void>(g_voltage_monitor.Update());               // Reads voltage and updates the trigger pins.

        k_msleep(kSupervisionIntervalMs);                            // Waits before the next supervision cycle.
    }

    return 0;                                                        // Never reached.
}
```

## Include/voltage_sensor.hpp
```c
#pragma once

#include <cstdint>                                        // Includes fixed-size integer types.

#include <zephyr/device.h>                                // Includes Zephyr device structure and APIs.
#include <zephyr/drivers/gpio.h>                          // Includes Zephyr GPIO driver functions.


namespace motor_control {                              // Opens motor control namespace.


// Voltage supervision result. Exactly one of these is active at any time,
// which is what guarantees PC0 and PC1 can never be driven high together.
enum class VoltageState : uint8_t {                       // Creates enum describing supervised voltage condition.

    kUnknown = 0U,                                        // No valid reading taken yet - both trigger pins stay LOW.

    kNormal  = 1U,                                        // Voltage inside the accepted window -> PC0 HIGH, PC1 LOW.

    kFault   = 2U,                                        // Voltage over/under limit or unreadable -> PC1 HIGH, PC0 LOW.
};


class IVoltageSensor {                                    // Creates interface class for voltage sensor abstraction.

public:

    virtual ~IVoltageSensor() = default;                  // Virtual destructor allows safe object deletion.

    virtual bool Init() = 0;                              // Pure virtual function for sensor initialization.

    virtual bool Read(float& voltage_v_out) = 0;          // Pure virtual function to read voltage value in volts.
};


// Generic "0-25V DC voltage sensor module" - a fixed resistor divider
// (commonly 30k / 7.5k, ratio 5:1) feeding STM32G4 ADC2 channel on PA4.
class VoltageSensor final : public IVoltageSensor {       // Creates VoltageSensor class implementing IVoltageSensor.

public:

    VoltageSensor() = default;                            // Creates default constructor for VoltageSensor object.

    bool Init() override;                                 // Initializes voltage sensor ADC reading path.

    bool Read(float& voltage_v_out) override;             // Reads ADC and converts to volts.


    static constexpr uint8_t kVoltageAdcChannel = 17U;    // ADC2_IN17 -> PA4 -> voltage divider output.

    static constexpr uint8_t kAdcResolutionBits = 12U;    // STM32G4 ADC resolution used for the voltage channel.


private:

    static constexpr float kDividerRatio = 5.0F;
    // 0-25V module divider ratio: Vin = Vadc * 5 (verify against your
    // specific module if it differs).

    static constexpr float kAdcRefVoltage = 3.3F;         // STM32G4 ADC reference voltage.

    static constexpr uint32_t kAdcMaxCode =
        (1U << kAdcResolutionBits) - 1U;                   // Maximum raw ADC code (4095 for 12-bit).

    static constexpr uint8_t kAverageSamples = 8U;
    // Averages several conversions per Read() so ADC/divider noise does
    // not bounce the supervisor across a threshold on a single bad sample.

    const device* adc_dev_ = nullptr;                      // Stores ADC2 device pointer (voltage sensor).

    bool initialized_ = false;                             // Stores whether voltage sensor initialization is completed.
};


// Supervises the measured bus voltage against the nominal 24 V window and
// drives the two trigger outputs.
//
// MUTUAL EXCLUSION: both pins are written only from ApplyState(), which
// always drives the outgoing pin LOW *before* driving the incoming pin
// HIGH (break-before-make). There is no other code path that touches
// either pin, so PC0 and PC1 can never be HIGH simultaneously - not at
// boot, not during a transition, and not on a fault.
class VoltageMonitor {                                     // Creates class that maps voltage readings onto trigger pins.

public:

    explicit VoltageMonitor(IVoltageSensor& sensor);        // Constructor connects supervisor with a voltage sensor.

    bool Init();                                            // Initializes trigger pins and the underlying sensor.

    // Takes one reading, evaluates it against the window, and updates the
    // trigger pins. Returns the state now being asserted.
    VoltageState Update();

    VoltageState state() const { return state_; }           // Returns the currently asserted supervision state.


    // ---- Nominal 24 V supervision window -----------------------------------

    static constexpr float kNominalVoltage = 24.0F;         // Nominal bus voltage of the supervised supply.

    static constexpr float kOverVoltageLimit  = 26.4F;      // Trip above this (+10% of nominal).

    static constexpr float kUnderVoltageLimit = 21.6F;      // Trip below this (-10% of nominal).

    static constexpr float kRecoveryHysteresis = 0.5F;
    // Once faulted, the voltage must come back 0.5 V *inside* the trip
    // limits before returning to normal. Without this, a supply sitting
    // exactly on a limit would chatter both relays/pins continuously.


private:

    void ApplyState(VoltageState new_state);                 // Drives trigger pins for a state, break-before-make.

    IVoltageSensor& sensor_;                                  // Stores reference to the voltage sensor being supervised.

    gpio_dt_spec normal_trigger_{};                            // Stores normal-state trigger pin spec (PC0).

    gpio_dt_spec fault_trigger_{};                             // Stores fault-state trigger pin spec (PC1).

    VoltageState state_ = VoltageState::kUnknown;              // Stores currently asserted supervision state.

    bool initialized_ = false;                                 // Stores whether supervisor initialization is completed.
};


}  // namespace motor_control
```

## src/voltage_sensor.cpp
```c
#include "voltage_sensor.hpp"                                    // Includes VoltageSensor / VoltageMonitor definitions.

#include <zephyr/devicetree.h>                                   // Includes Zephyr device tree support.
#include <zephyr/drivers/adc.h>                                  // Includes Zephyr ADC read functions.
#include <zephyr/logging/log.h>                                  // Includes Zephyr logging functions.


LOG_MODULE_REGISTER(voltage_sensor, LOG_LEVEL_INF);              // Creates log module for voltage sensor.


namespace motor_control {                                    // Opens motor control namespace.


// ===========================================================================
// VoltageSensor - ADC acquisition and conversion to real bus volts
// ===========================================================================

bool VoltageSensor::Init() {                                       // Initializes voltage sensor ADC path.

    adc_dev_ = DEVICE_DT_GET(DT_ALIAS(voltagesensor));             // Gets ADC2 device (0-25V voltage sensor module).

    if (!device_is_ready(adc_dev_)) {                              // Checks whether ADC2 device is ready.

        LOG_ERR("Voltage sensor ADC device not ready");            // Prints ADC error message.

        initialized_ = false;                                       // Marks sensor initialization as failed.

        return false;                                               // Returns failure.
    }

    const adc_channel_cfg voltage_cfg = {
        .gain = ADC_GAIN_1,                                         // Uses unity gain (no internal amplification).
        .reference = ADC_REF_INTERNAL,                              // Uses internal ADC reference voltage.
        .acquisition_time = ADC_ACQ_TIME_DEFAULT,                    // Uses driver default acquisition time.
        .channel_id = kVoltageAdcChannel,                            // Selects ADC2_IN17 (PA4).
        .differential = 0,                                           // Uses single-ended measurement.
    };

    if (adc_channel_setup(adc_dev_, &voltage_cfg) != 0) {           // Configures the voltage sensing ADC channel.

        LOG_ERR("Voltage sensor ADC channel setup failed");         // Prints ADC channel configuration error.

        initialized_ = false;                                        // Marks sensor initialization as failed.

        return false;                                                // Returns failure.
    }

    initialized_ = true;                                             // Marks voltage sensor as initialized.

    return true;                                                     // Returns successful initialization.
}


bool VoltageSensor::Read(float& voltage_v_out) {                    // Reads voltage sensor module value.

    if (!initialized_) {                                             // Checks whether sensor was initialized.

        return false;                                                 // Returns failure if sensor is not ready.
    }

    uint32_t accumulated_code = 0U;                                   // Accumulates raw codes across the averaged samples.

    for (uint8_t i = 0U; i < kAverageSamples; ++i) {                  // Takes several conversions to average out noise.

        int16_t raw_sample = 0;                                       // Creates buffer to hold raw ADC conversion result.

        adc_sequence sequence = {};                                   // Creates ADC read sequence descriptor.
        sequence.channels = BIT(kVoltageAdcChannel);                  // Selects the voltage-sensor ADC channel.
        sequence.buffer = &raw_sample;                                 // Points sequence at the raw sample buffer.
        sequence.buffer_size = sizeof(raw_sample);                     // Sets buffer size in bytes.
        sequence.resolution = kAdcResolutionBits;                      // Sets ADC resolution to 12 bits.

        const int err = adc_read(adc_dev_, &sequence);                 // Performs the ADC conversion.

        if (err != 0) {                                                // Checks if ADC read failed.

            LOG_WRN("Voltage sensor ADC read failed: %d", err);        // Prints ADC read error.

            return false;                                              // Returns failure - caller treats this as a fault.
        }

        accumulated_code += static_cast<uint32_t>(raw_sample < 0 ? 0 : raw_sample);
        // Clamps a negative sample (should not normally occur) to zero, then accumulates.
    }

    const auto raw_code = accumulated_code / kAverageSamples;          // Averages the accumulated raw ADC codes.

    const float adc_pin_voltage =
        (static_cast<float>(raw_code) * kAdcRefVoltage) / static_cast<float>(kAdcMaxCode);
    // Converts averaged raw ADC code into the voltage actually present on the ADC pin.

    voltage_v_out = adc_pin_voltage * kDividerRatio;
    // Scales the ADC pin voltage back up to the real supply/bus voltage.

    LOG_DBG("Voltage sensor raw=%u Vbus=%d.%02u V", raw_code,
            static_cast<int>(voltage_v_out),
            static_cast<unsigned>((voltage_v_out - static_cast<int>(voltage_v_out)) * 100));
    // Prints raw code and computed bus voltage for debugging.

    return true;                                                       // Returns successful voltage reading.
}


// ===========================================================================
// VoltageMonitor - window supervision and mutually-exclusive trigger pins
// ===========================================================================

VoltageMonitor::VoltageMonitor(IVoltageSensor& sensor) : sensor_(sensor) {}
// Constructor connects the supervisor with the voltage sensor it evaluates.


bool VoltageMonitor::Init() {                                         // Initializes trigger pins and underlying sensor.

    if (!sensor_.Init()) {                                             // Initializes the ADC voltage sensing path.

        LOG_ERR("Voltage monitor: sensor init failed");                // Prints sensor initialization error.

        return false;                                                  // Returns failure.
    }

    normal_trigger_ = GPIO_DT_SPEC_GET(DT_ALIAS(normaltrigger), gpios); // Resolves normal-state trigger pin spec (PC0).
    fault_trigger_  = GPIO_DT_SPEC_GET(DT_ALIAS(faulttrigger), gpios);  // Resolves fault-state trigger pin spec (PC1).

    if (!gpio_is_ready_dt(&normal_trigger_) || !gpio_is_ready_dt(&fault_trigger_)) {

        LOG_ERR("Voltage monitor: trigger pin(s) not ready");          // Prints trigger pin error.

        return false;                                                  // Returns failure.
    }

    // Both pins start LOW. Nothing is asserted until a valid reading has
    // been classified, so a sensor that never comes up leaves both
    // outputs inactive rather than falsely asserting "normal".
    if (gpio_pin_configure_dt(&normal_trigger_, GPIO_OUTPUT_INACTIVE) != 0 ||
        gpio_pin_configure_dt(&fault_trigger_, GPIO_OUTPUT_INACTIVE) != 0) {

        LOG_ERR("Voltage monitor: trigger pin configure failed");      // Prints pin configuration error.

        return false;                                                  // Returns failure.
    }

    state_ = VoltageState::kUnknown;                                    // Starts in the unknown state with both pins LOW.

    initialized_ = true;                                                // Marks supervisor initialization as completed.

    LOG_INF("Voltage monitor ready: nominal %d V, window %d.%02u - %d.%02u V",
            static_cast<int>(kNominalVoltage),
            static_cast<int>(kUnderVoltageLimit),
            static_cast<unsigned>((kUnderVoltageLimit - static_cast<int>(kUnderVoltageLimit)) * 100),
            static_cast<int>(kOverVoltageLimit),
            static_cast<unsigned>((kOverVoltageLimit - static_cast<int>(kOverVoltageLimit)) * 100));
    // Prints the supervision window actually compiled in.

    return true;                                                        // Returns successful initialization.
}


void VoltageMonitor::ApplyState(VoltageState new_state) {               // Drives the trigger pins for the given state.

    if (new_state == state_) {                                          // Checks whether the state actually changed.

        return;                                                         // Skips redundant pin writes.
    }

    // BREAK-BEFORE-MAKE: the outgoing pin is always driven LOW first, so
    // there is no instant at which both trigger pins are HIGH.
    switch (new_state) {

    case VoltageState::kNormal:

        gpio_pin_set_dt(&fault_trigger_, 0);                            // Drives fault trigger PC1 LOW first.
        gpio_pin_set_dt(&normal_trigger_, 1);                           // Drives normal trigger PC0 HIGH.

        LOG_INF("Voltage NORMAL -> PC0 HIGH, PC1 LOW");                 // Prints the asserted normal state.
        break;

    case VoltageState::kFault:

        gpio_pin_set_dt(&normal_trigger_, 0);                           // Drives normal trigger PC0 LOW first.
        gpio_pin_set_dt(&fault_trigger_, 1);                            // Drives fault trigger PC1 HIGH.

        LOG_WRN("Voltage FAULT -> PC1 HIGH, PC0 LOW");                  // Prints the asserted fault state.
        break;

    case VoltageState::kUnknown:
    default:

        gpio_pin_set_dt(&normal_trigger_, 0);                           // Drives normal trigger PC0 LOW.
        gpio_pin_set_dt(&fault_trigger_, 0);                            // Drives fault trigger PC1 LOW.

        LOG_WRN("Voltage UNKNOWN -> both triggers LOW");                // Prints the inactive state.
        break;
    }

    state_ = new_state;                                                  // Stores the newly asserted state.
}


VoltageState VoltageMonitor::Update() {                                  // Reads, classifies, and drives the triggers.

    if (!initialized_) {                                                 // Checks whether the supervisor was initialized.

        return VoltageState::kUnknown;                                   // Returns unknown if not ready.
    }

    float bus_voltage = 0.0F;                                            // Holds the measured bus voltage in volts.

    if (!sensor_.Read(bus_voltage)) {                                    // Attempts to read the bus voltage.

        // A sensor that cannot be read is treated as a fault, not as
        // "normal" - failing safe rather than failing silent.
        LOG_ERR("Voltage read failed - asserting fault");                // Prints the read failure.

        ApplyState(VoltageState::kFault);                                // Asserts the fault trigger.

        return state_;                                                   // Returns the asserted state.
    }

    // Threshold selection depends on the current state (hysteresis):
    // a healthy supply may drift right up to a limit, so returning to
    // normal requires coming back a margin inside the window.
    float upper_limit = kOverVoltageLimit;                               // Selects the applicable upper trip limit.
    float lower_limit = kUnderVoltageLimit;                              // Selects the applicable lower trip limit.

    if (state_ != VoltageState::kNormal) {                               // Checks whether recovering into the normal window.

        upper_limit = kOverVoltageLimit - kRecoveryHysteresis;           // Tightens the upper limit for recovery.
        lower_limit = kUnderVoltageLimit + kRecoveryHysteresis;          // Tightens the lower limit for recovery.
    }

    if ((bus_voltage > upper_limit) || (bus_voltage < lower_limit)) {    // Checks for over-voltage or under-voltage.

        LOG_WRN("Voltage out of range: %d.%02u V",
                static_cast<int>(bus_voltage),
                static_cast<unsigned>((bus_voltage - static_cast<int>(bus_voltage)) * 100));
        // Prints the offending measurement.

        ApplyState(VoltageState::kFault);                                 // Asserts the fault trigger.

    } else {

        ApplyState(VoltageState::kNormal);                                // Asserts the normal trigger.
    }

    return state_;                                                        // Returns the asserted state.
}


}  // namespace motor_control
```
