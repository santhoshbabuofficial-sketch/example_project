## CMakeLists.txt
```
cmake_minimum_required(VERSION 3.20.0)

set(CMAKE_CXX_STANDARD 20)
set(CMAKE_CXX_STANDARD_REQUIRED ON)
set(CMAKE_CXX_EXTENSIONS OFF)

# Overlay lives in "Board/" (capital B, singular) rather than Zephyr's
# auto-detected "boards/" convention, so DTC_OVERLAY_FILE must be set
# explicitly before find_package(Zephyr ...).
set(DTC_OVERLAY_FILE ${CMAKE_CURRENT_SOURCE_DIR}/Board/nucleo_g474re.overlay)

find_package(Zephyr REQUIRED HINTS $ENV{ZEPHYR_BASE})
project(Current_PI_Control_Task LANGUAGES CXX)

target_sources(app PRIVATE
  ${CMAKE_CURRENT_SOURCE_DIR}/src/main.cpp
  ${CMAKE_CURRENT_SOURCE_DIR}/src/gpio_overlay.cpp
  ${CMAKE_CURRENT_SOURCE_DIR}/src/current_sensor.cpp
  ${CMAKE_CURRENT_SOURCE_DIR}/src/pi_controller.cpp
  ${CMAKE_CURRENT_SOURCE_DIR}/src/current_control.cpp
  ${CMAKE_CURRENT_SOURCE_DIR}/src/fault_detection.cpp
)

target_compile_options(app PRIVATE
  -Wall
  -Wextra
  -Werror
  -Wvolatile
)

target_include_directories(app PRIVATE
  ${CMAKE_CURRENT_SOURCE_DIR}/Include
)
```

## prj.conf
```kconfig
# --- Core ---------------------------------------------------------------
CONFIG_CPP=y
CONFIG_STD_CPP20=y
CONFIG_GLIBCXX_LIBCPP=y
CONFIG_NEWLIB_LIBC=y
CONFIG_MAIN_STACK_SIZE=2048

# --- GPIO -----------------------------------------------------------------
CONFIG_GPIO=y

# --- PWM (coil driver gate-drive input) -------------------------------------
CONFIG_PWM=y
CONFIG_PWM_STM32=y

# --- ADC (coil current sensing) ----------------------------------------------
CONFIG_ADC=y
CONFIG_ADC_STM32=y

# --- Logging (telemetry: reference/measured/error/duty each cycle) -------------
CONFIG_LOG=y
CONFIG_LOG_MODE_DEFERRED=y
CONFIG_LOG_DEFAULT_LEVEL=3

# --- Console (routed to UART on this board) ---------------------------------------
CONFIG_CONSOLE=y
CONFIG_UART_CONSOLE=y

# --- No dynamic allocation in application code; keep heap minimal for libc use ------
CONFIG_HEAP_MEM_POOL_SIZE=1024
```

## src/main.cpp
```c
#include <new>                                                   // Required for placement new (no-heap static-storage construction below).

#include <zephyr/kernel.h>                                      // Includes Zephyr RTOS kernel functions like threads and sleep.
#include <zephyr/logging/log.h>                                  // Includes Zephyr logging functions.

#include "current_control.hpp"                                   // Includes the closed-loop current controller.
#include "current_sensor.hpp"                                    // Includes current sensor class.
#include "fault_detection.hpp"                                   // Includes over-current fault detection class.
#include "gpio_overlay.hpp"                                      // Includes GPIO and hardware device control.
#include "pi_controller.hpp"                                     // Includes generic PI controller.


LOG_MODULE_REGISTER(current_control_task_main, LOG_LEVEL_INF);   // Creates log module for the current-control task main.


namespace {                                                       // Opens private namespace for local variables and functions.


using motor_control::CurrentLoopController;                  // Creates short name for the current loop controller class.
using motor_control::CurrentSensor;                           // Creates short name for current sensor class.
using motor_control::FaultDetector;                            // Creates short name for fault detector class.
using motor_control::GpioOverlay;                               // Creates short name for GPIO overlay class.
using motor_control::PiController;                               // Creates short name for PI controller class.


// ---- PI tuning (starting point - re-tune for your actual coil/driver) -----
// Kp: how hard duty reacts to the instantaneous error. Too high -> ringing
// or oscillation; too low -> sluggish response as current rises.
// Ki: how fast the integral term removes steady-state error. Too high ->
// overshoot and slow-decaying oscillation; too low -> current settles
// slightly off the limit and takes a long time to creep to it.
// Start with Ki = 0, raise Kp until the loop pulls duty down fast enough
// when current rises toward the limit, then raise Ki just enough to hold
// current steady at the limit without re-introducing oscillation.
constexpr float kPiKp = 15.0F;                                     // Proportional gain (duty% per amp of error).
constexpr float kPiKi = 40.0F;                                     // Integral gain (duty%/s per amp of error).

// This is the current limit: the loop starts open-loop at 50% duty, then
// closes around this target - if measured current rises above it, the PI
// term goes negative and pulls duty down until current settles back at
// (or below) this value.
constexpr float kCurrentLimitA = 0.2F;                              // Current limit / regulation target: 200 mA.

constexpr uint16_t kControlLoopPeriodMs = 2U;                       // Current-loop update period (500 Hz).
constexpr uint16_t kFaultCheckPeriodMs = 20U;                        // Fault-check period (separate from control-loop rate).

constexpr size_t kControlThreadStackSize = 2048U;                     // Memory size for the control-loop thread stack.
constexpr int kControlThreadPriority = 5;                               // Control-loop thread priority.


GpioOverlay g_overlay;                                                    // Creates GPIO/PWM/ADC hardware control object.

CurrentSensor* g_current_sensor = nullptr;                                 // Creates pointer for current sensor object.
PiController* g_pi = nullptr;                                               // Creates pointer for PI controller object.
CurrentLoopController* g_current_loop = nullptr;                             // Creates pointer for current loop controller object.
FaultDetector g_fault_detector;                                               // Creates fault detector object (no dynamic hardware needed).


alignas(CurrentSensor) uint8_t g_current_sensor_storage[sizeof(CurrentSensor)];
// Creates memory storage for current sensor object.

alignas(PiController) uint8_t g_pi_storage[sizeof(PiController)];
// Creates memory storage for PI controller object.

alignas(CurrentLoopController) uint8_t g_current_loop_storage[sizeof(CurrentLoopController)];
// Creates memory storage for current loop controller object.


void ControlThreadEntry(void*, void*, void*) {
// Zephyr thread function running the periodic PI current-control loop and
// the over-current fault check. No button, no manual trigger - this starts
// regulating the instant the thread runs.

    const float dt_s = static_cast<float>(kControlLoopPeriodMs) / 1000.0F;     // Precomputes the fixed control-loop sample time in seconds.

    uint16_t ms_since_fault_check = 0U;                                          // Tracks elapsed time toward the next fault check.

    while (true) {                                                               // Creates infinite RTOS task loop.

        g_current_loop->Tick(dt_s);                                               // Runs one PI current-loop step (measure -> PI -> apply duty).

        ms_since_fault_check =
            static_cast<uint16_t>(ms_since_fault_check + kControlLoopPeriodMs);
        // Advances the fault-check timer by one control-loop period.

        if (ms_since_fault_check >= kFaultCheckPeriodMs) {                          // Checks whether it is time for a fault check.

            ms_since_fault_check = 0U;                                               // Resets the fault-check timer.

            if (!g_fault_detector.IsFaulted() &&
                g_fault_detector.CheckCurrent(g_current_loop->measured_current())) {
                // Feeds the latest measured current into the fault detector.

                g_current_loop->EmergencyStop();                                        // Immediately disables the coil driver on over-current.

                LOG_ERR("Current loop stopped due to over-current fault");               // Logs the stop event.
            }
        }

        k_msleep(kControlLoopPeriodMs);                                              // Delays thread for the control-loop sample period.
    }
}


K_THREAD_STACK_DEFINE(g_control_thread_stack, kControlThreadStackSize);
// Creates stack memory for the control-loop RTOS thread.

k_thread g_control_thread{};                                                 // Creates control-loop thread control object.


}  // namespace                                                              // Closes private namespace.


int main() {                                                                 // Main function starts the current-control task.

    LOG_INF("current control task booting");                                    // Prints startup message.

    if (!g_overlay.Init()) {                                                   // Initializes GPIO/PWM/ADC hardware.

        LOG_ERR("gpio_overlay init failed - halting");                          // Prints initialization error.

        return -1;                                                               // Stops program due to hardware failure.
    }

    g_current_sensor = new (g_current_sensor_storage) CurrentSensor(g_overlay);
    // Creates current sensor object in preallocated memory.

    g_pi = new (g_pi_storage) PiController(kPiKp, kPiKi, 0.0F, 100.0F);
    // Creates the PI controller object in preallocated memory (output clamped 0-100%,
    // further clamped to 0-90% inside CurrentLoopController).

    g_current_loop =
        new (g_current_loop_storage) CurrentLoopController(g_overlay, *g_current_sensor, *g_pi);
    // Creates the closed-loop current controller object in preallocated memory.

    if (!g_current_sensor->Init() || !g_current_loop->Init()) {
    // Initializes current sensor and current-loop hardware.

        LOG_ERR("Peripheral init failed - halting");                             // Prints peripheral initialization error.

        return -1;                                                                 // Stops program on failure.
    }

    g_current_loop->SetReferenceCurrent(kCurrentLimitA);                            // Loads the fixed 200 mA current limit as the regulation target.

    g_current_loop->Enable();                                                        // Starts at 50% duty and immediately begins closing the loop -
                                                                                       // no button needed, this runs from boot.

    k_thread_create(&g_control_thread, g_control_thread_stack, kControlThreadStackSize,
                     ControlThreadEntry, nullptr, nullptr, nullptr, kControlThreadPriority, 0,
                     K_NO_WAIT);
    // Creates and starts the PI current-control RTOS thread.

    k_thread_name_set(&g_control_thread, "current_loop");                          // Names the control thread.

    LOG_INF("current control task running - limiting coil current to 200 mA");       // Prints running message.

    return 0;                                                                          // Ends main function successfully.
}
```

## Include/current_control.hpp
```c
#pragma once

#include <cstdint>                                                // Includes fixed-size integer types.

#include "current_sensor.hpp"                                    // Includes current sensor interface.
#include "gpio_overlay.hpp"                                       // Includes GPIO/PWM hardware access.
#include "pi_controller.hpp"                                      // Includes generic PI controller.


namespace motor_control {                                    // Opens motor control namespace.


// Ties the three pieces of the current loop together each Tick():
//   measure actual coil current -> PI(reference, actual) -> apply duty.
// This is the "single phase/coil closed-loop current regulation" the task
// asks for, and is deliberately the same shape a single leg of an FOC
// current loop would take later.
class CurrentLoopController {                                  // Creates class implementing the closed-loop current controller.

public:

    CurrentLoopController(GpioOverlay& overlay, ICurrentSensor& current_sensor, PiController& pi);
    // Constructor wires the controller to hardware, the sensor, and the PI core.

    bool Init();                                                 // Brings PWM/enable pin to a safe stopped state.

    void SetReferenceCurrent(float reference_a);                  // Sets the target coil current in amperes.

    void Enable();                                                 // Enables the coil driver and starts closed-loop regulation.

    void Disable();                                                 // Disables the coil driver and holds 0% duty (normal stop).

    void EmergencyStop();                                           // Immediately disables the driver and latches a stop (fault path).

    // Runs one control-loop iteration: read sensor, run PI, apply duty.
    // dt_s is the time since the previous Tick() call, in seconds.
    void Tick(float dt_s);

    float reference_current() const { return reference_a_; }        // Returns the currently commanded reference current.

    float measured_current() const { return measured_a_; }          // Returns the most recently measured coil current.

    uint8_t duty_percent() const { return duty_percent_; }          // Returns the currently applied PWM duty percentage.

    bool is_enabled() const { return enabled_; }                    // Returns whether the loop is actively regulating.


private:

    static constexpr uint8_t kDutyMinPercent = 0U;                   // Minimum PWM duty percentage (PI output lower clamp).
    static constexpr uint8_t kDutyMaxPercent = 90U;                  // Maximum PWM duty percentage (leaves headroom off 100%).
    static constexpr uint8_t kStartDutyPercent = 50U;                 // Open-loop starting duty applied the instant the loop enables.

    void ApplyDutyPercent(uint8_t duty_percent);                      // Pushes a duty percentage out to the PWM peripheral.

    GpioOverlay& overlay_;                                             // Stores reference to GPIO/PWM hardware control object.

    ICurrentSensor& current_sensor_;                                    // Stores reference to the current sensor.

    PiController& pi_;                                                   // Stores reference to the PI controller core.

    float reference_a_ = 0.0F;                                            // Stores the commanded target coil current.

    float measured_a_ = 0.0F;                                              // Stores the most recently measured coil current.

    uint8_t duty_percent_ = 0U;                                             // Stores the currently applied PWM duty percentage.

    bool enabled_ = false;                                                   // Stores whether the loop is actively regulating.
};


}  // namespace motor_control
```

## Include/current_sensor.hpp
```c
#pragma once

#include <cstdint>                                        // Includes fixed-size integer types.

#include "gpio_overlay.hpp"


namespace motor_control {                            // Opens motor control namespace.


class ICurrentSensor {                                     // Creates interface class for current sensor abstraction.

public:

    virtual ~ICurrentSensor() = default;                    // Virtual destructor allows safe object deletion.

    virtual bool Init() = 0;                                // Pure virtual function for sensor initialization.

    virtual bool Read(float& current_a_out) = 0;            // Pure virtual function to read current value in amperes.
};


class CurrentSensor final : public ICurrentSensor {         // Creates CurrentSensor class implementing ICurrentSensor.

public:

    explicit CurrentSensor(GpioOverlay& overlay);           // Constructor connects sensor with GPIO/ADC hardware.

    bool Init() override;                                   // Initializes current sensor ADC reading path.

    bool Read(float& current_a_out) override;                // Reads ADC and converts to amperes.


private:

    static constexpr float kAcsSupplyVoltage = 5.0F;         // ACS712 module supply voltage (typical 5.0V).

    static constexpr float kAcsZeroCurrentVoltage = kAcsSupplyVoltage / 2.0F;
    // Output voltage at 0A is nominally Vcc/2 per ACS712 datasheet.

    static constexpr float kAcsSensitivityVPerA = 0.185F;
    // ACS712-05B sensitivity is 185 mV/A. Change to 0.100F for the 20A
    // variant or 0.066F for the 30A variant if that is what is fitted.
    // This scale factor directly sets how "loud" a given coil current
    // reads to the PI loop - re-check it first if tracking looks off.

    static constexpr float kAdcInputDividerRatio = 1.0F;

    // ---- STM32G4 ADC characteristics ------

    static constexpr float kAdcRefVoltage = 3.3F;             // STM32G4 ADC reference voltage.

    static constexpr uint32_t kAdcMaxCode =
        (1U << GpioOverlay::kAdcResolutionBits) - 1U;          // Maximum raw ADC code (4095 for 12-bit).

    GpioOverlay& overlay_;                                    // Stores reference to GPIO/ADC hardware control object.

    bool initialized_ = false;                                // Stores sensor initialization status.
};


}  // namespace motor_control
```

## Include/fault_detection.hpp
```c
#pragma once

namespace motor_control {                              // Opens motor control namespace.


// Simple latching over-current guard. No voltage monitoring in this task -
// there is no voltage sensor here, only the current loop.
//
// This is a hard safety ceiling, separate from the PI loop's 200 mA
// regulation target: the PI loop is expected to keep current AT the
// reference by pulling duty down as current rises toward it. This detector
// only trips if the loop fails to do that fast enough (e.g. a stall or a
// sensor fault) and current keeps climbing past a safe margin above the
// reference. Adjust kMaxCurrentA to whatever margin your hardware needs.
class FaultDetector {                                        // Creates class to monitor the coil current limit.

public:

    static constexpr float kMaxCurrentA = 0.5F;                // Hard safety ceiling (2.5x the 200 mA regulation target).

    // Feeds one new current sample. Returns true if this sample newly
    // triggers a fault (was previously clear).
    bool CheckCurrent(float current_a);

    bool IsFaulted() const { return active_; }                // Returns whether a fault is currently latched.

    void Reset();                                               // Clears the latched fault (call only after a safe restart).


private:

    bool active_ = false;                                       // Stores whether a fault is currently latched.
};


}  // namespace motor_control
```

## Include/gpio_overlay.hpp
```c
#pragma once

#include <cstdint>                                        // Includes fixed-size integer types.

#include <zephyr/device.h>                                // Includes Zephyr device structure and APIs.
#include <zephyr/drivers/gpio.h>                          // Includes Zephyr GPIO driver functions.


namespace motor_control {                            // Opens motor control task namespace.


// Central hardware access point for the current-control task. Only what a
// single-phase/coil closed-loop current limiter needs: one PWM leg, one
// enable (SD) pin, and one current-sense ADC channel. No LCD, no voltage
// sensing, no second bridge leg, no button - the loop free-runs from boot.
class GpioOverlay {                                       // Creates class to manage all hardware pin and device connections.

public:

    GpioOverlay() = default;                               // Creates default constructor for GpioOverlay object.

    bool Init();                                           // Initializes GPIO pins and hardware devices.

    // ---- PWM (single IR2104 gate-drive PWM input, pin 2) ----------------

    const device* pwm_dev() const { return pwm_dev_; }      // Returns the TIM1 PWM device driving the coil leg.

    static constexpr uint32_t kPwmChannel = 1U;              // TIM1_CH1 -> PC0 -> IR2104 PWM input.
    static constexpr uint32_t kPwmPeriodNs = 50000U;          // 20 kHz PWM period (well above audible range).

    // ---- IR2104 SHUTDOWN / enable pin (pin 3) ----------------------------
    // Active-LOW in devicetree: gpio_pin_set_dt(spec, 1) == enabled (SD low),
    // gpio_pin_set_dt(spec, 0) == shutdown (SD high), matching IR2104 datasheet.

    const gpio_dt_spec& enable_pin() const { return enable_pin_; }  // Returns the coil-driver enable/shutdown pin spec (PC1).

    // ---- ADC (coil current sensing, ACS712) --------------------------------

    const device* current_adc_dev() const { return current_adc_dev_; } // Returns ADC1 device (ACS712 current sensor).

    static constexpr uint8_t kCurrentAdcChannel = 1U;         // ADC1_IN1 -> PA0 -> ACS712 output.
    static constexpr uint8_t kAdcResolutionBits = 12U;        // STM32G4 ADC resolution.


private:

    const device* pwm_dev_ = nullptr;                        // Stores TIM1 PWM device pointer.

    gpio_dt_spec enable_pin_{};                               // Stores IR2104 shutdown/enable pin spec.

    const device* current_adc_dev_ = nullptr;                  // Stores ADC1 device pointer (current sensor).

    bool initialized_ = false;                                  // Stores whether hardware initialization is completed.
};


}  // namespace motor_control
```

## Include/pi_controller.hpp
```c
#pragma once                                              // Prevents this header file from being included multiple times.


namespace motor_control {                              // Opens motor control namespace.


// Generic discrete PI controller. Not tied to current/voltage/anything -
// CurrentLoopController is what gives this its meaning as a current loop.
class PiController {                                        // Creates class implementing a discrete-time PI controller.

public:

    PiController(float kp, float ki, float output_min, float output_max);
    // Constructor sets proportional/integral gains and output clamp limits.

    float Update(float setpoint, float measurement, float dt_s);
    // Computes one PI step and returns the clamped controller output.

    void Reset(float seed_output = 0.0F);
    // Clears the integral term (call on start/stop/fault-clear). Pass a
    // non-zero seed_output to make the very first Update() start from that
    // output (with zero error) instead of ramping up from zero - e.g. an
    // open-loop starting duty that the loop then closes around.

    void SetGains(float kp, float ki);                        // Allows re-tuning Kp/Ki at runtime (e.g. from a shell command).

    float last_error() const { return last_error_; }          // Returns the most recent setpoint-minus-measurement error.

    float integral_term() const { return integral_; }         // Returns the current accumulated integral term (for logging/tuning).


private:

    float kp_;                                                 // Stores proportional gain.

    float ki_;                                                  // Stores integral gain.

    const float output_min_;                                    // Stores lower clamp for the controller output.

    const float output_max_;                                     // Stores upper clamp for the controller output.

    float integral_ = 0.0F;                                       // Stores the running integral (error * time) accumulator.

    float last_error_ = 0.0F;                                     // Stores the most recent error sample, for diagnostics.
};


}  // namespace motor_control
```

## src/current_control.cpp
```c
#include "current_control.hpp"                                       // Includes CurrentLoopController class definition.

#include <zephyr/drivers/gpio.h>                                    // Includes Zephyr GPIO control functions.
#include <zephyr/drivers/pwm.h>                                     // Includes Zephyr PWM control functions.
#include <zephyr/logging/log.h>                                     // Includes Zephyr logging functions.


LOG_MODULE_REGISTER(current_control, LOG_LEVEL_INF);                // Creates log module for the current loop.


namespace motor_control {                                      // Opens motor control namespace.


CurrentLoopController::CurrentLoopController(GpioOverlay& overlay, ICurrentSensor& current_sensor,
                                              PiController& pi)
    : overlay_(overlay), current_sensor_(current_sensor), pi_(pi) {}
// Constructor wires the controller to hardware, the sensor, and the PI core.


bool CurrentLoopController::Init() {                                  // Brings the coil driver to a safe stopped state.

    gpio_pin_set_dt(&overlay_.enable_pin(), 0);                        // Asserts SD (shutdown) - driver disabled at init.

    duty_percent_ = kDutyMinPercent;                                    // Starts commanded duty at 0% while the driver is disabled.

    ApplyDutyPercent(duty_percent_);                                     // Pushes 0% duty out to the PWM leg.

    pi_.Reset();                                                          // Clears any stale PI integral state.

    enabled_ = false;                                                     // Starts disabled - Enable() must be called explicitly.

    return true;                                                          // Returns successful initialization.
}


void CurrentLoopController::ApplyDutyPercent(uint8_t duty_percent) {       // Pushes a duty percentage out to the PWM leg.

    const uint32_t pulse_ns =
        (static_cast<uint32_t>(GpioOverlay::kPwmPeriodNs) * duty_percent) / 100U;
    // Converts the commanded percentage into a pulse width in nanoseconds.

    pwm_set(overlay_.pwm_dev(), GpioOverlay::kPwmChannel, GpioOverlay::kPwmPeriodNs, pulse_ns,
            PWM_POLARITY_NORMAL);
    // Applies the coil-leg (TIM1_CH1/PC0) PWM duty cycle.
}


void CurrentLoopController::SetReferenceCurrent(float reference_a) {         // Sets the target coil current.

    reference_a_ = reference_a;                                               // Stores the new reference current.

    LOG_INF("Reference current set to %d.%02u A", static_cast<int>(reference_a_),
            static_cast<unsigned>((reference_a_ - static_cast<int>(reference_a_)) * 100));
    // Prints the new reference for tuning/step-response visibility.
}


void CurrentLoopController::Enable() {                                        // Enables the coil driver and starts regulation.

    duty_percent_ = kStartDutyPercent;                                            // Opens the loop at the fixed starting duty (50%).

    ApplyDutyPercent(duty_percent_);                                               // Pushes the starting duty out to the PWM leg immediately.

    pi_.Reset(static_cast<float>(kStartDutyPercent));
    // Seeds the PI integral so the very first Tick() output starts at
    // kStartDutyPercent (for zero error) rather than ramping up from zero -
    // if measured current is already above the reference at that duty, the
    // very first control step pulls the duty back down straight away.

    gpio_pin_set_dt(&overlay_.enable_pin(), 1);                                  // Clears SD (active-LOW spec: 1 == enabled).

    enabled_ = true;                                                              // Marks the loop as actively regulating.

    LOG_INF("Current loop ENABLED at %u%% starting duty", duty_percent_);           // Logs the enable event.
}


void CurrentLoopController::Disable() {                                          // Disables the coil driver (normal stop).

    duty_percent_ = kDutyMinPercent;                                               // Clears commanded duty.

    ApplyDutyPercent(duty_percent_);                                                // Applies 0% duty before disabling the driver.

    gpio_pin_set_dt(&overlay_.enable_pin(), 0);                                     // Asserts SD (shutdown).

    enabled_ = false;                                                                // Marks the loop as stopped.

    LOG_INF("Current loop DISABLED");                                                // Logs the disable event.
}


void CurrentLoopController::EmergencyStop() {                                        // Immediately halts the coil driver (fault path).

    duty_percent_ = kDutyMinPercent;                                                    // Clears commanded duty.

    ApplyDutyPercent(duty_percent_);                                                     // Applies 0% duty immediately.

    gpio_pin_set_dt(&overlay_.enable_pin(), 0);                                            // Asserts SD (shutdown) immediately.

    enabled_ = false;                                                                        // Marks the loop as stopped.

    pi_.Reset();                                                                              // Clears integral state so a restart begins clean.

    LOG_ERR("Current loop EMERGENCY STOP");                                                     // Logs the emergency stop.
}


void CurrentLoopController::Tick(float dt_s) {                                                  // Runs one control-loop iteration.

    if (!enabled_) {                                                                              // Skips regulation while disabled.

        return;                                                                                    // Nothing to do.
    }

    float measured = 0.0F;                                                                          // Creates local buffer for this sample's measured current.

    if (!current_sensor_.Read(measured)) {                                                           // Reads the coil current.

        LOG_WRN("Current sensor read failed - holding last duty");                                    // Prints sensor-read warning.

        return;                                                                                        // Skips this control step; keeps last commanded duty applied.
    }

    measured_a_ = measured;                                                                            // Stores the fresh measurement.

    const float pi_output_percent = pi_.Update(reference_a_, measured_a_, dt_s);                         // Runs one PI step (setpoint - measurement -> duty%).

    float clamped_percent = pi_output_percent;                                                            // Creates a working copy to clamp into range.

    if (clamped_percent < static_cast<float>(kDutyMinPercent)) {                                           // Checks lower duty bound.

        clamped_percent = static_cast<float>(kDutyMinPercent);                                              // Clamps to the minimum duty.

    } else if (clamped_percent > static_cast<float>(kDutyMaxPercent)) {                                     // Checks upper duty bound.

        clamped_percent = static_cast<float>(kDutyMaxPercent);                                               // Clamps to the maximum duty.
    }

    duty_percent_ = static_cast<uint8_t>(clamped_percent);                                                   // Stores the applied duty percentage.

    ApplyDutyPercent(duty_percent_);                                                                          // Pushes the new duty out to the PWM leg.

    LOG_INF("ref=%d.%02uA meas=%d.%02uA err=%d.%02uA duty=%u%%",
            static_cast<int>(reference_a_),
            static_cast<unsigned>((reference_a_ - static_cast<int>(reference_a_)) * 100),
            static_cast<int>(measured_a_),
            static_cast<unsigned>((measured_a_ - static_cast<int>(measured_a_)) * 100),
            static_cast<int>(pi_.last_error()),
            static_cast<unsigned>((pi_.last_error() - static_cast<int>(pi_.last_error())) * 100),
            duty_percent_);
    // Prints per-cycle telemetry so the PI step response can be observed on
    // the console (this replaces the LCD row-1 status readout from the
    // direction-reversal task, which this task does not use).
}


}  // namespace motor_control
```

## src/current_sensor.cpp
```c
#include "current_sensor.hpp"                                      // Includes CurrentSensor class definition.

#include <zephyr/drivers/adc.h>                                    // Includes Zephyr ADC read functions.
#include <zephyr/logging/log.h>                                    // Includes Zephyr logging functions.


LOG_MODULE_REGISTER(current_sensor, LOG_LEVEL_INF);                // Creates log module for current sensor.


namespace motor_control {                                     // Opens motor control namespace.


CurrentSensor::CurrentSensor(GpioOverlay& overlay) : overlay_(overlay) {}
// Constructor connects current sensor object with GPIO/ADC hardware control.


bool CurrentSensor::Init() {                                       // Initializes current sensor ADC path.

    if (!device_is_ready(overlay_.current_adc_dev())) {            // Checks whether ADC1 device is ready.

        LOG_ERR("Current sensor ADC device not ready");            // Prints ADC error message.

        initialized_ = false;                                      // Marks sensor initialization as failed.

        return false;                                               // Returns failure.
    }

    initialized_ = true;                                            // Marks current sensor as initialized.

    return true;                                                    // Returns successful initialization.
}


bool CurrentSensor::Read(float& current_a_out) {                   // Reads ACS712 current value.

    if (!initialized_) {                                            // Checks whether sensor was initialized.

        return false;                                               // Returns failure if sensor is not ready.
    }

    int16_t raw_sample = 0;                                         // Creates buffer to hold raw ADC conversion result.

    adc_sequence sequence = {};                                     // Creates ADC read sequence descriptor.
    sequence.channels = BIT(GpioOverlay::kCurrentAdcChannel);       // Selects the ACS712 ADC channel.
    sequence.buffer = &raw_sample;                                   // Points sequence at the raw sample buffer.
    sequence.buffer_size = sizeof(raw_sample);                       // Sets buffer size in bytes.
    sequence.resolution = GpioOverlay::kAdcResolutionBits;           // Sets ADC resolution to 12 bits.

    const int err = adc_read(overlay_.current_adc_dev(), &sequence); // Performs the ADC conversion.

    if (err != 0) {                                                  // Checks if ADC read failed.

        LOG_WRN("Current sensor ADC read failed: %d", err);          // Prints ADC read error.

        return false;                                                // Returns failure.
    }

    const auto raw_code = static_cast<uint32_t>(raw_sample < 0 ? 0 : raw_sample);
    // Clamps a negative sample (should not normally occur) to zero.

    const float adc_pin_voltage =
        (static_cast<float>(raw_code) * kAdcRefVoltage) / static_cast<float>(kAdcMaxCode);
    // Converts raw ADC code into the voltage actually present on the ADC pin.

    const float acs_output_voltage = adc_pin_voltage / kAdcInputDividerRatio;
    // Recovers the ACS712 output voltage before any external divider.

    current_a_out = (acs_output_voltage - kAcsZeroCurrentVoltage) / kAcsSensitivityVPerA;
    // Converts ACS712 output voltage into current in amperes.

    return true;                                                     // Returns successful sensor reading.
}


}  // namespace motor_control
```

## src/fault_detection.cpp
```c
#include "fault_detection.hpp"

#include <zephyr/logging/log.h>


LOG_MODULE_REGISTER(fault_detection, LOG_LEVEL_INF);              // Creates log module for fault detection.


namespace motor_control {                                    // Opens motor control namespace.


bool FaultDetector::CheckCurrent(float current_a) {                 // Checks a new current sample against the limit.

    if (active_) {                                                  // Checks whether a fault is already latched.

        return false;                                               // Does not re-trigger an already-latched fault.
    }

    if (current_a > kMaxCurrentA) {                                  // Checks whether current exceeds the limit.

        active_ = true;                                              // Latches the fault.

        LOG_ERR("FAULT: over-current %d.%02u A (limit %d A)",
                static_cast<int>(current_a),
                static_cast<unsigned>((current_a - static_cast<int>(current_a)) * 100),
                static_cast<int>(kMaxCurrentA));
        // Prints over-current fault details.

        return true;                                                  // Reports a newly-triggered fault.
    }

    return false;                                                    // No fault on this sample.
}


void FaultDetector::Reset() {                                        // Clears the latched fault.

    active_ = false;                                                   // Clears fault-active flag.
}


}  // namespace motor_control
```

## src/gpio_overlay.cpp
```c
#include "gpio_overlay.hpp"                                       // Includes GpioOverlay class definition.

#include <zephyr/devicetree.h>                                    // Includes Zephyr device tree support.
#include <zephyr/drivers/adc.h>                                   // Includes Zephyr ADC driver functions.
#include <zephyr/drivers/gpio.h>                                  // Includes Zephyr GPIO control functions.
#include <zephyr/logging/log.h>                                   // Includes Zephyr logging functions.


LOG_MODULE_REGISTER(current_ctrl_gpio_overlay, LOG_LEVEL_INF);    // Creates log module for GPIO overlay.


namespace motor_control {                                    // Opens motor control task namespace.


bool GpioOverlay::Init() {                                        // Initializes all hardware devices and pins.

    bool all_ready = true;                                        // Tracks whether every device/pin initialized cleanly.

    // ---- PWM device (TIM1, single coil leg) -------------------------------

    pwm_dev_ = DEVICE_DT_GET(DT_ALIAS(coilpwm));                  // Gets the TIM1 PWM device for the coil leg.

    if (!device_is_ready(pwm_dev_)) {
        LOG_ERR("TIM1 PWM device not ready");                      // Prints PWM device error.
        all_ready = false;                                        // Marks initialization as failed.
    }

    // ---- IR2104 SHUTDOWN / enable pin --------------------------------------

    enable_pin_ = GPIO_DT_SPEC_GET(DT_ALIAS(coilen), gpios);       // Resolves the coil-driver enable/shutdown pin spec.

    if (!gpio_is_ready_dt(&enable_pin_)) {
        LOG_ERR("Coil driver enable pin not ready");               // Prints enable pin error.
        all_ready = false;                                        // Marks initialization as failed.
    } else {
        // Start disabled (SD high / driver shut down) until the current
        // loop explicitly enables it - safest power-up state.
        gpio_pin_configure_dt(&enable_pin_, GPIO_OUTPUT_INACTIVE); // Configures enable pin as output, starts disabled.
    }

    // ---- ADC device (coil current sensing) -----------------------------------

    current_adc_dev_ = DEVICE_DT_GET(DT_ALIAS(currentsensor));    // Gets ADC1 device (ACS712 current sensor).

    if (!device_is_ready(current_adc_dev_)) {
        LOG_ERR("Current sensor ADC device not ready");            // Prints ADC device error.
        all_ready = false;                                        // Marks initialization as failed.
    } else {

        const adc_channel_cfg current_cfg = {
            .gain = ADC_GAIN_1,                                    // Uses unity gain (no internal amplification).
            .reference = ADC_REF_INTERNAL,                         // Uses internal ADC reference voltage.
            .acquisition_time = ADC_ACQ_TIME_DEFAULT,               // Uses driver default acquisition time.
            .channel_id = kCurrentAdcChannel,                       // Selects ADC1_IN1 (PA0).
            .differential = 0,                                      // Uses single-ended measurement.
        };

        if (adc_channel_setup(current_adc_dev_, &current_cfg) != 0) {
            LOG_ERR("Current sensor ADC channel setup failed");    // Prints ADC channel configuration error.
            all_ready = false;                                      // Marks initialization as failed.
        }
    }

    if (!all_ready) {                                                // Checks if any hardware initialization failed.
        return false;                                                // Stops initialization and returns failure.
    }

    initialized_ = true;                                             // Stores that hardware initialization is completed.

    return true;                                                     // Returns successful initialization.
}


}  // namespace motor_control
```

## src/pi_controller.cpp
```c
#include "pi_controller.hpp"                                       // Includes PiController class definition.

#include <zephyr/logging/log.h>                                    // Includes Zephyr logging functions.


LOG_MODULE_REGISTER(pi_controller, LOG_LEVEL_INF);                 // Creates log module for the PI controller.


namespace motor_control {                                     // Opens motor control namespace.


PiController::PiController(float kp, float ki, float output_min, float output_max)
    : kp_(kp), ki_(ki), output_min_(output_min), output_max_(output_max) {}
// Constructor stores gains and output clamp limits; integral starts at zero.


float PiController::Update(float setpoint, float measurement, float dt_s) {  // Runs one PI update step.

    const float error = setpoint - measurement;                      // Computes the tracking error for this sample.

    last_error_ = error;                                              // Stores error for diagnostics/logging.

    const float proportional_term = kp_ * error;                       // Computes the proportional contribution.

    const float candidate_integral = integral_ + (ki_ * error * dt_s);  // Computes what the integral WOULD become this step.

    float output = proportional_term + candidate_integral;               // Computes the unclamped controller output.

    if (output > output_max_) {                                          // Checks if output would saturate high.

        output = output_max_;                                             // Clamps output to the upper limit.

        // Anti-windup: only accept the integral update if it does not push
        // the output further past the limit than it already is. This keeps
        // the integral from winding up unboundedly while saturated.
        if (candidate_integral < integral_ || error < 0.0F) {

            integral_ = candidate_integral;                                 // Accepts the integral update (it is helping, not hurting).
        }

    } else if (output < output_min_) {                                    // Checks if output would saturate low.

        output = output_min_;                                              // Clamps output to the lower limit.

        if (candidate_integral > integral_ || error > 0.0F) {

            integral_ = candidate_integral;                                  // Accepts the integral update (it is helping, not hurting).
        }

    } else {

        integral_ = candidate_integral;                                     // Not saturated - integral updates normally.

        output = proportional_term + integral_;                              // Recomputes output with the accepted integral term.
    }

    return output;                                                          // Returns the clamped PI controller output.
}


void PiController::Reset(float seed_output) {                               // Clears/seeds the integral accumulator.

    integral_ = seed_output;                                                  // Seeds integral so Update() starts near seed_output.

    last_error_ = 0.0F;                                                      // Resets last error to zero.
}


void PiController::SetGains(float kp, float ki) {                           // Updates Kp/Ki at runtime.

    kp_ = kp;                                                                 // Stores new proportional gain.

    ki_ = ki;                                                                  // Stores new integral gain.

    LOG_INF("PI gains updated: Kp=%d.%03u Ki=%d.%03u",
            static_cast<int>(kp_),
            static_cast<unsigned>((kp_ - static_cast<int>(kp_)) * 1000),
            static_cast<int>(ki_),
            static_cast<unsigned>((ki_ - static_cast<int>(ki_)) * 1000));
    // Prints the new gains for tuning visibility over the console.
}


}  // namespace motor_control
```
