## CMakeLists.txt
```
cmake_minimum_required(VERSION 3.20.0)

set(CMAKE_CXX_STANDARD 20)
set(CMAKE_CXX_STANDARD_REQUIRED ON)
set(CMAKE_CXX_EXTENSIONS OFF)

# Overlay lives in "Board/" (capital B, singular), not Zephyr's
# auto-detected "boards/" convention, so DTC_OVERLAY_FILE must be set
# explicitly before find_package(Zephyr ...).
set(DTC_OVERLAY_FILE ${CMAKE_CURRENT_SOURCE_DIR}/Board/nucleo_g474re.overlay)

find_package(Zephyr REQUIRED HINTS $ENV{ZEPHYR_BASE})
project(Bldc_Sensorless_SixStep LANGUAGES CXX)

target_sources(app PRIVATE
  ${CMAKE_CURRENT_SOURCE_DIR}/src/main.cpp
  ${CMAKE_CURRENT_SOURCE_DIR}/src/phase_driver.cpp
  ${CMAKE_CURRENT_SOURCE_DIR}/src/bemf_sensor.cpp
  ${CMAKE_CURRENT_SOURCE_DIR}/src/motor_controller.cpp
)

target_compile_options(app PRIVATE
  -Wall
  -Wextra
  -Werror
  -Wvolatile
)
```

## prj.conf
```kconfig
# --- Core ---------------------------------------------------------------
CONFIG_CPP=y
CONFIG_STD_CPP20=y
CONFIG_GLIBCXX_LIBCPP=y
CONFIG_NEWLIB_LIBC=y
CONFIG_MAIN_STACK_SIZE=4096

# --- PWM (TIM1 CH1/CH2/CH3 -> phase U/V/W) -------------------------------
CONFIG_PWM=y
CONFIG_PWM_STM32=y

# --- GPIO (per-phase driver enable / tri-state) --------------------------
CONFIG_GPIO=y

# --- ADC (back-EMF zero-cross sensing) ------------------------------------
CONFIG_ADC=y
CONFIG_ADC_STM32=y

# --- Logging --------------------------------------------------------------------
CONFIG_LOG=y
CONFIG_LOG_MODE_DEFERRED=y
CONFIG_LOG_DEFAULT_LEVEL=3

# --- Console (routed to UART on this board) ---------------------------------------
CONFIG_CONSOLE=y
CONFIG_UART_CONSOLE=y
```

## src/main.cpp
```c
#include <array>

#include <zephyr/devicetree.h>
#include <zephyr/drivers/adc.h>
#include <zephyr/drivers/gpio.h>
#include <zephyr/drivers/pwm.h>
#include <zephyr/kernel.h>
#include <zephyr/logging/log.h>

#include "bemf_sensor.hpp"
#include "motor_controller.hpp"
#include "phase_driver.hpp"

LOG_MODULE_REGISTER(bldc_sensorless, LOG_LEVEL_INF);

namespace {

// zephyr,user node in Board/nucleo_g474re.overlay holds the ADC
// io-channels and the per-phase enable GPIOs.
#define BLDC_IO_NODE DT_PATH(zephyr_user)

const bldc::PhaseDriver::PhaseHw kPhaseU{
    .pwm = PWM_DT_SPEC_GET(DT_ALIAS(bldc_pwm_u)),
    .enable = GPIO_DT_SPEC_GET_BY_IDX(BLDC_IO_NODE, phase_en_gpios, 0),
};
const bldc::PhaseDriver::PhaseHw kPhaseV{
    .pwm = PWM_DT_SPEC_GET(DT_ALIAS(bldc_pwm_v)),
    .enable = GPIO_DT_SPEC_GET_BY_IDX(BLDC_IO_NODE, phase_en_gpios, 1),
};
const bldc::PhaseDriver::PhaseHw kPhaseW{
    .pwm = PWM_DT_SPEC_GET(DT_ALIAS(bldc_pwm_w)),
    .enable = GPIO_DT_SPEC_GET_BY_IDX(BLDC_IO_NODE, phase_en_gpios, 2),
};

const std::array<adc_dt_spec, 3U> kBemfChannels{
    ADC_DT_SPEC_GET_BY_IDX(BLDC_IO_NODE, 0),
    ADC_DT_SPEC_GET_BY_IDX(BLDC_IO_NODE, 1),
    ADC_DT_SPEC_GET_BY_IDX(BLDC_IO_NODE, 2),
};

}  // namespace

int main() {
    LOG_INF("Sensorless BLDC six-step commutation booting");

    const std::array<bldc::PhaseDriver::PhaseHw, 3U> phases{kPhaseU, kPhaseV, kPhaseW};
    bldc::PhaseDriver driver(phases);
    bldc::BemfSensor sensor(kBemfChannels);
    bldc::MotorController controller(driver, sensor);

    if (!controller.Init()) {
        LOG_ERR("Motor controller init failed - halting");
        return -1;
    }

    controller.Run();

    // Run() only returns on an unrecoverable fault; phases are already
    // off by this point.
    while (true) {
        k_msleep(1000);
    }

    return 0;
}
```

## src/bemf_sensor.cpp
```c
#include "bemf_sensor.hpp"

#include <zephyr/logging/log.h>

LOG_MODULE_REGISTER(bldc_bemf_sensor, LOG_LEVEL_INF);

namespace bldc {

BemfSensor::BemfSensor(const std::array<adc_dt_spec, 3U>& channels) : channels_(channels) {}

bool BemfSensor::Init() {
    for (const auto& ch : channels_) {
        if (!adc_is_ready_dt(&ch)) {
            LOG_ERR("BEMF ADC channel not ready");
            return false;
        }
        if (adc_channel_setup_dt(&ch) != 0) {
            LOG_ERR("BEMF ADC channel setup failed");
            return false;
        }
    }
    return true;
}

bool BemfSensor::SampleAll() {
    for (uint8_t i = 0U; i < channels_.size(); ++i) {
        adc_sequence seq{};
        seq.buffer = &raw_samples_[i];
        seq.buffer_size = sizeof(raw_samples_[i]);

        if (adc_sequence_init_dt(&channels_[i], &seq) != 0) {
            return false;
        }
        if (adc_read_dt(&channels_[i], &seq) != 0) {
            return false;
        }
    }
    return true;
}

void BemfSensor::ResetEdgeTracking() {
    have_previous_sample_ = false;
}

bool BemfSensor::ZeroCrossDetected(Phase floating_phase, Phase high_phase, Phase low_phase,
                                    ZeroCrossEdge expected_edge) {
    const auto f_idx = static_cast<uint8_t>(floating_phase);
    const auto h_idx = static_cast<uint8_t>(high_phase);
    const auto l_idx = static_cast<uint8_t>(low_phase);

    const int32_t neutral =
        (static_cast<int32_t>(raw_samples_[h_idx]) + static_cast<int32_t>(raw_samples_[l_idx])) /
        2;
    const int32_t relative = static_cast<int32_t>(raw_samples_[f_idx]) - neutral;

    if (!have_previous_sample_) {
        previous_relative_ = relative;
        have_previous_sample_ = true;
        return false;
    }

    bool crossed = false;
    if (expected_edge == ZeroCrossEdge::kRising) {
        crossed = (previous_relative_ < 0) && (relative >= 0);
    } else {
        crossed = (previous_relative_ > 0) && (relative <= 0);
    }

    previous_relative_ = relative;
    return crossed;
}

}  // namespace bldc
```

## src/bemf_sensor.hpp
```c
#pragma once

#include <array>
#include <cstdint>

#include <zephyr/drivers/adc.h>

#include "bldc_types.hpp"

namespace bldc {

// Samples all three phase voltages and detects the back-EMF zero cross on
// the currently floating phase, using a software "virtual neutral" formed
// from the average of the two actively-driven phases. This avoids needing
// a dedicated neutral-point resistor network, at the cost of some noise
// sensitivity right at commutation edges - tune kZeroCrossSampleIntervalUs
// in motor_controller.cpp and/or add hardware low-pass filtering on the
// divider network if zero crossings look noisy on a scope.
class BemfSensor {
public:
    explicit BemfSensor(const std::array<adc_dt_spec, 3U>& channels);

    [[nodiscard]] bool Init();

    // Samples all three phase-voltage ADC channels. Call once per control
    // loop tick, before ZeroCrossDetected().
    [[nodiscard]] bool SampleAll();

    // Must be called whenever the floating phase changes (i.e. right after
    // a commutation), so the previous sample isn't compared against a
    // different phase's voltage.
    void ResetEdgeTracking();

    // Returns true the first tick the floating phase's voltage crosses the
    // virtual neutral in the expected direction.
    [[nodiscard]] bool ZeroCrossDetected(Phase floating_phase, Phase high_phase,
                                          Phase low_phase, ZeroCrossEdge expected_edge);

private:
    std::array<adc_dt_spec, 3U> channels_;
    std::array<int16_t, 3U> raw_samples_{};
    int32_t previous_relative_ = 0;
    bool have_previous_sample_ = false;
};

}  // namespace bldc
```

## src/commutation_table.hpp
```c
#pragma once

#include <array>

#include "bldc_types.hpp"

namespace bldc {

struct CommutationStep {
    Phase high_phase;      // Driven with PWM (high-side).
    Phase low_phase;       // Grounded (low-side fully on).
    Phase floating_phase;  // Tri-stated; sampled for the back-EMF zero cross.
    ZeroCrossEdge expected_edge;
};

// Standard six-step trapezoidal sequence for forward rotation. To reverse
// direction, walk the table backwards instead of forwards.
inline constexpr std::array<CommutationStep, 6U> kCommutationTable{{
    {Phase::kU, Phase::kV, Phase::kW, ZeroCrossEdge::kRising},
    {Phase::kU, Phase::kW, Phase::kV, ZeroCrossEdge::kFalling},
    {Phase::kV, Phase::kW, Phase::kU, ZeroCrossEdge::kRising},
    {Phase::kV, Phase::kU, Phase::kW, ZeroCrossEdge::kFalling},
    {Phase::kW, Phase::kU, Phase::kV, ZeroCrossEdge::kRising},
    {Phase::kW, Phase::kV, Phase::kU, ZeroCrossEdge::kFalling},
}};

}  // namespace bldc
```

## src/motor_controller.cpp
```c
#include "motor_controller.hpp"

#include <zephyr/kernel.h>
#include <zephyr/logging/log.h>

LOG_MODULE_REGISTER(bldc_motor_controller, LOG_LEVEL_INF);

namespace bldc {
namespace {

// --- Tunables - placeholders, adjust for your motor/driver -------------
constexpr uint32_t kAlignDutyPercent = 20U;
constexpr uint32_t kAlignDurationMs = 500U;

constexpr uint32_t kOpenLoopDutyPercent = 25U;
constexpr uint32_t kOpenLoopStartPeriodUs = 8000U;  // Slow first steps.
constexpr uint32_t kOpenLoopEndPeriodUs = 1500U;    // Speed to hand off at.
constexpr uint32_t kOpenLoopPeriodDecrementUs = 40U;

constexpr uint32_t kClosedLoopDutyPercent = 35U;
constexpr uint32_t kZeroCrossSampleIntervalUs = 50U;  // 20 kHz BEMF poll rate.
constexpr int64_t kStallTimeoutMs = 500;

}  // namespace

MotorController::MotorController(PhaseDriver& driver, BemfSensor& sensor)
    : driver_(driver), sensor_(sensor) {}

bool MotorController::Init() {
    if (!driver_.Init()) {
        return false;
    }
    if (!sensor_.Init()) {
        return false;
    }
    driver_.AllOff();
    return true;
}

void MotorController::Align() {
    LOG_INF("Aligning rotor");
    step_index_ = 0U;
    const auto& step = kCommutationTable[step_index_];
    static_cast<void>(
        driver_.ApplyStep(step.high_phase, step.low_phase, step.floating_phase, kAlignDutyPercent));
    k_msleep(kAlignDurationMs);
}

void MotorController::OpenLoopRamp() {
    LOG_INF("Open-loop ramp");
    uint32_t period_us = kOpenLoopStartPeriodUs;

    while (period_us > kOpenLoopEndPeriodUs) {
        step_index_ = static_cast<uint8_t>((step_index_ + 1U) % kCommutationTable.size());
        const auto& step = kCommutationTable[step_index_];
        if (!driver_.ApplyStep(step.high_phase, step.low_phase, step.floating_phase,
                                kOpenLoopDutyPercent)) {
            Fault("phase driver failure during ramp");
            return;
        }
        k_usleep(static_cast<int32_t>(period_us));
        period_us -= kOpenLoopPeriodDecrementUs;
    }

    LOG_INF("Ramp complete, handing off to closed-loop BEMF sensing");
}

void MotorController::ClosedLoop() {
    LOG_INF("Closed-loop BEMF commutation");
    sensor_.ResetEdgeTracking();

    int64_t last_zero_cross_uptime = k_uptime_get();
    int64_t last_step_uptime = last_zero_cross_uptime;

    while (true) {
        k_usleep(kZeroCrossSampleIntervalUs);

        if (!sensor_.SampleAll()) {
            Fault("BEMF ADC sample failure");
            return;
        }

        const auto& step = kCommutationTable[step_index_];
        const bool zero_cross = sensor_.ZeroCrossDetected(step.floating_phase, step.high_phase,
                                                            step.low_phase, step.expected_edge);
        const int64_t now = k_uptime_get();

        if (zero_cross) {
            const int64_t interval_ms = now - last_zero_cross_uptime;
            last_zero_cross_uptime = now;

            // Commutate 30 electrical degrees after the zero cross, i.e.
            // half of the last zero-cross-to-zero-cross interval.
            if (interval_ms > 0) {
                k_msleep(static_cast<int32_t>(interval_ms / 2));
            }

            step_index_ = static_cast<uint8_t>((step_index_ + 1U) % kCommutationTable.size());
            const auto& next_step = kCommutationTable[step_index_];
            if (!driver_.ApplyStep(next_step.high_phase, next_step.low_phase,
                                    next_step.floating_phase, kClosedLoopDutyPercent)) {
                Fault("phase driver failure in closed loop");
                return;
            }
            sensor_.ResetEdgeTracking();
            last_step_uptime = k_uptime_get();
        } else if ((now - last_step_uptime) > kStallTimeoutMs) {
            Fault("stall detected: no zero cross within timeout");
            return;
        }
    }
}

void MotorController::Fault(const char* reason) {
    LOG_ERR("Motor fault: %s - cutting all phases", reason);
    driver_.AllOff();
}

void MotorController::Run() {
    Align();
    OpenLoopRamp();
    ClosedLoop();
}

}  // namespace bldc
```

## src/motor_controller.hpp
```c
#pragma once

#include <cstdint>

#include "bemf_sensor.hpp"
#include "commutation_table.hpp"
#include "phase_driver.hpp"

namespace bldc {

// Sensorless six-step trapezoidal BLDC controller:
//   1. Align  - force one commutation step for a fixed time to park the
//               rotor at a known electrical position.
//   2. Ramp   - force commutation at a decreasing, open-loop interval
//               until the motor is spinning fast enough for BEMF to be
//               readable.
//   3. Closed loop - commutate from ADC-sensed zero crossings, timed 30
//               electrical degrees after each detected crossing.
// This is a starting point, not a tuned controller: align/ramp timing,
// duty cycles, and the stall timeout are all placeholders in
// motor_controller.cpp and will need adjusting against your motor and a
// scope on the floating-phase / commutation signals.
class MotorController {
public:
    MotorController(PhaseDriver& driver, BemfSensor& sensor);

    [[nodiscard]] bool Init();

    // Blocking: runs Align -> OpenLoopRamp -> ClosedLoop. Only returns on
    // an unrecoverable fault (driver or ADC failure); all phases are off
    // by the time it returns.
    void Run();

private:
    void Align();
    void OpenLoopRamp();
    void ClosedLoop();
    void Fault(const char* reason);

    PhaseDriver& driver_;
    BemfSensor& sensor_;
    uint8_t step_index_ = 0U;
};

}  // namespace bldc
```

## src/phase_driver.hpp
```c
#pragma once

#include <array>
#include <cstdint>

#include <zephyr/drivers/gpio.h>
#include <zephyr/drivers/pwm.h>

#include "bldc_types.hpp"

namespace bldc {

// Drives one three-phase inverter leg per Phase. Assumes each phase is
// backed by an integrated half-bridge (e.g. DRV8313 / L6234 class) that:
//   - accepts a single PWM input to set high-side duty while internally
//     handling low-side complementary switching and dead time,
//   - provides an enable/tri-state pin so the phase can be floated for
//     back-EMF sensing.
// If your hardware instead uses discrete MOSFETs with separate high/low
// gate drivers, adapt DriveHigh()/DriveLow()/Float() in phase_driver.cpp
// to drive both gate signals per phase - this class only assumes the
// 3-state (high / low / floating) contract described above.
class PhaseDriver {
public:
    struct PhaseHw {
        pwm_dt_spec pwm;      // PWM output that sets this phase's duty cycle.
        gpio_dt_spec enable;  // Active-high: enables this phase's half-bridge output.
    };

    explicit PhaseDriver(const std::array<PhaseHw, 3U>& phases);

    [[nodiscard]] bool Init();

    // Applies a commutation step: high_phase is driven with PWM at
    // duty_percent, low_phase is grounded, floating_phase is tri-stated.
    [[nodiscard]] bool ApplyStep(Phase high_phase, Phase low_phase, Phase floating_phase,
                                  uint32_t duty_percent);

    // Tri-states all three phases (coast / fault stop).
    void AllOff();

private:
    [[nodiscard]] bool DriveHigh(Phase phase, uint32_t duty_percent);
    [[nodiscard]] bool DriveLow(Phase phase);
    [[nodiscard]] bool Float(Phase phase);

    std::array<PhaseHw, 3U> phases_;
};

}  // namespace bldc
```
