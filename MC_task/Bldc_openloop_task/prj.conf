## CMakeLists.txt
```
cmake_minimum_required(VERSION 3.20.0)

set(CMAKE_CXX_STANDARD 20)
set(CMAKE_CXX_STANDARD_REQUIRED ON)
set(CMAKE_CXX_EXTENSIONS OFF)

# The overlay lives in "Board/" (capital B, singular), which is not
# Zephyr's auto-detected "boards/" convention, so DTC_OVERLAY_FILE must be
# set explicitly - and before find_package(Zephyr ...).
set(DTC_OVERLAY_FILE ${CMAKE_CURRENT_SOURCE_DIR}/Board/nucleo_g474re.overlay)

find_package(Zephyr REQUIRED HINTS $ENV{ZEPHYR_BASE})
project(Bldc_OpenLoop_Task LANGUAGES CXX)

target_sources(app PRIVATE
  ${CMAKE_CURRENT_SOURCE_DIR}/src/main.cpp
  ${CMAKE_CURRENT_SOURCE_DIR}/src/gpio_overlay.cpp
  ${CMAKE_CURRENT_SOURCE_DIR}/src/bldc_driver.cpp
  ${CMAKE_CURRENT_SOURCE_DIR}/src/speed_ramp.cpp
)

target_compile_options(app PRIVATE
  -Wall
  -Wextra
  -Werror
  -Wvolatile
)

# Folder on disk is "Include/" (capital I) - case-sensitive on Linux.
target_include_directories(app PRIVATE
  ${CMAKE_CURRENT_SOURCE_DIR}/Include
)
```

## prj.conf
```kconfig
# --- Core ---------------------------------------------------------------
CONFIG_CPP=y
CONFIG_STD_CPP20=y
CONFIG_GLIBCXX_LIBCPP=y
CONFIG_NEWLIB_LIBC=y
CONFIG_MAIN_STACK_SIZE=2048

# --- PWM (TIM1 CH1/CH2/CH3 -> phase U/V/W gate-drive inputs) ---------------
CONFIG_PWM=y
CONFIG_PWM_STM32=y

# --- GPIO (phase enable pins + scope sync pins) ----------------------------
CONFIG_GPIO=y

# --- Timing -----------------------------------------------------------------
# The commutation loop sleeps down to ~1.5 ms per step. A 1 kHz tick would
# quantise that badly, so the tick rate is raised to keep k_usleep() honest
# at the fast end of the ramp.
CONFIG_SYS_CLOCK_TICKS_PER_SEC=10000

# --- Logging --------------------------------------------------------------------
# Deferred mode keeps LOG_INF() out of the commutation timing path - the
# log strings are formatted on a separate thread rather than inline.
CONFIG_LOG=y
CONFIG_LOG_MODE_DEFERRED=y
CONFIG_LOG_DEFAULT_LEVEL=3

# --- Console (routed to UART on this board) ---------------------------------------
CONFIG_CONSOLE=y
CONFIG_UART_CONSOLE=y

# --- No dynamic allocation in application code; keep heap minimal for libc use ------
CONFIG_HEAP_MEM_POOL_SIZE=1024
```

## src/main.cpp
```c
#include <zephyr/kernel.h>                                       // Includes Zephyr kernel thread and sleep functions.
#include <zephyr/logging/log.h>                                  // Includes Zephyr logging functions.

#include "bldc_driver.hpp"                                       // Includes inverter driver definition.
#include "commutation_table.hpp"                                 // Includes six-step commutation table.
#include "gpio_overlay.hpp"                                      // Includes hardware access object.
#include "speed_ramp.hpp"                                        // Includes open-loop speed profile.


LOG_MODULE_REGISTER(main, LOG_LEVEL_INF);                        // Creates log module for the application entry point.


namespace {                                                       // Opens anonymous namespace for file-local objects.

constexpr uint32_t kStatusIntervalMs = 500U;
// How often the running speed is printed. Deliberately slow: logging from
// inside the commutation loop at 1.5 ms per step would flood the UART and
// distort the very timing being measured.

// Statically allocated - no heap use anywhere in this application.
motor_control::GpioOverlay g_overlay{};                           // Creates the central hardware access object.

motor_control::BldcDriver g_driver{g_overlay};                     // Creates the three-phase inverter driver.

motor_control::SpeedRamp g_ramp{};                                 // Creates the open-loop speed profile generator.

}  // namespace


int main() {                                                       // Application entry point.

    LOG_INF("Open-loop BLDC commutation starting");                // Prints application startup message.

    if (!g_overlay.Init()) {                                        // Initializes PWM device, enable pins, sync pins.

        LOG_ERR("Hardware init failed - halting");                  // Prints initialization failure.

        return -1;                                                   // Stops the application with the motor off.
    }

    if (!g_driver.Init()) {                                          // Initializes the inverter into all-off state.

        LOG_ERR("Inverter init failed - halting");                   // Prints initialization failure.

        return -1;                                                   // Stops the application with the motor off.
    }

    g_ramp.Start();                                                  // Begins the align -> accelerate -> run profile.

    uint8_t step_index = 0U;                                         // Tracks which of the six steps is active.

    int64_t last_status_ms = k_uptime_get();                         // Tracks when status was last printed.

    while (true) {                                                   // Runs the commutation loop forever.

        g_ramp.Update();                                             // Recomputes step period and duty for this moment.

        if (!g_driver.ApplyStep(step_index, g_ramp.duty_percent())) { // Applies the current commutation step.

            LOG_ERR("Commutation failed - cutting output");           // Prints the commutation failure.

            g_driver.AllOff();                                        // Tri-states every phase on any driver error.

            break;                                                    // Leaves the commutation loop.
        }

        // During align the rotor is being parked, so the step index is
        // deliberately NOT advanced - the same step is held until the align
        // window expires, which is what pulls the rotor to a known position.
        if (g_ramp.phase() != motor_control::RampPhase::kAlign) {

            step_index = static_cast<uint8_t>(
                (step_index + 1U) % motor_control::kStepsPerElectricalRev);
            // Advances to the next step, wrapping after six.
        }

        const int64_t now_ms = k_uptime_get();                        // Reads the current uptime.

        if ((now_ms - last_status_ms) >= static_cast<int64_t>(kStatusIntervalMs)) {

            LOG_INF("step=%u period=%u us duty=%u%% elec_rpm=%u",
                    step_index, g_ramp.step_period_us(),
                    g_ramp.duty_percent(), g_ramp.ElectricalRpm());
            // Prints the present operating point for monitoring.

            last_status_ms = now_ms;                                   // Records when status was printed.
        }

        k_usleep(static_cast<int32_t>(g_ramp.step_period_us()));       // Holds this step for its computed duration.
    }

    // Only reached on a driver failure. The motor is already coasting.
    while (true) {                                                     // Parks the application safely.

        k_msleep(1000);                                                // Sleeps indefinitely with the motor off.
    }

    return 0;                                                          // Never reached.
}
```

## Include/bldc_driver.hpp
```c
#pragma once

#include <cstdint>                                        // Includes fixed-size integer types.

#include "commutation_table.hpp"                          // Includes Phase and CommutationStep definitions.
#include "gpio_overlay.hpp"                               // Includes hardware access object.


namespace motor_control {                              // Opens motor control task namespace.


// Drives the three-phase inverter one commutation step at a time.
//
// HARDWARE ASSUMPTION - verify against your driver board: each phase is
// backed by a half-bridge driver (DRV8313 / L6234 class) that takes ONE
// PWM input to set high-side duty (low side and dead time handled
// internally) plus ONE enable pin to tri-state the phase. If you are
// instead driving discrete MOSFETs with separate high/low gate drivers
// (as the IR2104 pairs in the brushed-motor project do), only
// DriveHigh/DriveLow/FloatPhase below need rewriting - the commutation
// logic above them is unaffected.
class BldcDriver {                                        // Creates class that applies commutation steps to the inverter.

public:

    explicit BldcDriver(GpioOverlay& overlay);            // Constructor connects driver with GPIO/PWM hardware.

    bool Init();                                          // Initializes the inverter into a safe all-off state.

    // Applies one commutation step at the given duty cycle, and pulses the
    // scope sync outputs so the step boundary is visible on a scope.
    bool ApplyStep(uint8_t step_index, uint32_t duty_percent);

    void AllOff();                                        // Tri-states all three phases (coast / safe stop).


private:

    bool DriveHigh(Phase phase, uint32_t duty_percent);   // Enables a phase and applies PWM duty to it.

    bool DriveLow(Phase phase);                            // Enables a phase and holds it at 0% duty (grounded).

    bool FloatPhase(Phase phase);                          // Tri-states a phase so it floats (shows back-EMF).

    uint32_t ChannelFor(Phase phase) const;                // Maps a phase onto its TIM1 PWM channel number.

    const gpio_dt_spec& EnableFor(Phase phase) const;      // Maps a phase onto its enable pin spec.

    GpioOverlay& overlay_;                                  // Stores reference to GPIO/PWM hardware control object.

    bool initialized_ = false;                              // Stores whether inverter initialization is completed.
};


}  // namespace motor_control
```

## Include/commutation_table.hpp
```c
#pragma once

#include <array>                                          // Includes fixed-size array container.
#include <cstdint>                                        // Includes fixed-size integer types.


namespace motor_control {                              // Opens motor control task namespace.


enum class Phase : uint8_t {                              // Creates enum identifying the three inverter phases.

    kU = 0U,                                              // Phase U -> TIM1_CH1 -> PC0.

    kV = 1U,                                              // Phase V -> TIM1_CH2 -> PC1.

    kW = 2U,                                              // Phase W -> TIM1_CH3 -> PC2.
};


// One entry of the six-step trapezoidal sequence. In every step exactly
// one phase is PWM-driven, one is pulled to ground, and one floats - which
// is what produces the classic trapezoidal phase waveform on a scope.
struct CommutationStep {                                  // Creates structure describing a single commutation step.

    Phase high_phase;                                     // Phase driven with PWM (current flows in here).

    Phase low_phase;                                      // Phase held at ground (current flows out here).

    Phase floating_phase;                                 // Phase tri-stated - shows back-EMF, not driven.
};


// Standard six-step sequence for forward rotation. Walking this table
// forwards spins one way; walking it backwards spins the other. Each full
// pass through all six entries is one ELECTRICAL revolution, which equals
// one mechanical revolution divided by the motor's pole-pair count.
inline constexpr std::array<CommutationStep, 6U> kCommutationTable{{

    {Phase::kU, Phase::kV, Phase::kW},                    // Step 0: U driven, V grounded, W floating.

    {Phase::kU, Phase::kW, Phase::kV},                    // Step 1: U driven, W grounded, V floating.

    {Phase::kV, Phase::kW, Phase::kU},                    // Step 2: V driven, W grounded, U floating.

    {Phase::kV, Phase::kU, Phase::kW},                    // Step 3: V driven, U grounded, W floating.

    {Phase::kW, Phase::kU, Phase::kV},                    // Step 4: W driven, U grounded, V floating.

    {Phase::kW, Phase::kV, Phase::kU},                    // Step 5: W driven, V grounded, U floating.
}};


inline constexpr uint8_t kStepsPerElectricalRev = 6U;     // Number of commutation steps in one electrical revolution.


}  // namespace motor_control
```

## Include/gpio_overlay.hpp
```c
#pragma once

#include <cstdint>                                        // Includes fixed-size integer types.

#include <zephyr/device.h>                                // Includes Zephyr device structure and APIs.
#include <zephyr/drivers/gpio.h>                          // Includes Zephyr GPIO driver functions.


namespace motor_control {                              // Opens motor control task namespace.


// Central hardware access point. Every other module talks to the board
// through this object instead of touching devicetree macros directly.
class GpioOverlay {                                       // Creates class to manage all hardware pin and device connections.

public:

    GpioOverlay() = default;                               // Creates default constructor for GpioOverlay object.

    bool Init();                                           // Initializes GPIO pins and hardware devices.

    // ---- PWM (three-phase inverter gate-drive inputs) --------------------
    // All three phases come from TIM1, so they share one PWM device and
    // differ only by channel. A single timer also means the three phase
    // outputs stay in lockstep with each other - important when you put a
    // scope across two phases at once.

    const device* pwm_dev() const { return pwm_dev_; }      // Returns the TIM1 PWM device (drives all three phases).

    static constexpr uint32_t kPhaseUChannel = 1U;          // TIM1_CH1 -> PC0 -> phase U gate-drive input.
    static constexpr uint32_t kPhaseVChannel = 2U;          // TIM1_CH2 -> PC1 -> phase V gate-drive input.
    static constexpr uint32_t kPhaseWChannel = 3U;          // TIM1_CH3 -> PC2 -> phase W gate-drive input.

    static constexpr uint32_t kPwmPeriodNs = 50000U;        // 20 kHz PWM period (well above audible range).

    // ---- Phase ENABLE pins (driver IC enable / tri-state, one per phase) --
    // Active-HIGH in devicetree: gpio_pin_set_dt(spec, 1) == phase driven,
    // gpio_pin_set_dt(spec, 0) == phase tri-stated (floating).

    const gpio_dt_spec& en_u() const { return en_u_; }      // Returns phase U enable pin spec (PB0).
    const gpio_dt_spec& en_v() const { return en_v_; }      // Returns phase V enable pin spec (PB1).
    const gpio_dt_spec& en_w() const { return en_w_; }      // Returns phase W enable pin spec (PB2).

    // ---- Scope sync outputs (waveform observation aids) -------------------
    // These carry no motor current. They exist purely so the commutation
    // sequence can be observed on a scope alongside the phase waveforms.

    const gpio_dt_spec& step_sync() const { return step_sync_; }    // Returns per-step sync pin spec (PB4).
    const gpio_dt_spec& cycle_sync() const { return cycle_sync_; }  // Returns per-electrical-cycle sync pin spec (PB5).


private:

    const device* pwm_dev_ = nullptr;                       // Stores TIM1 PWM device pointer (all three phases).

    gpio_dt_spec en_u_{};                                   // Stores phase U enable pin spec.
    gpio_dt_spec en_v_{};                                   // Stores phase V enable pin spec.
    gpio_dt_spec en_w_{};                                   // Stores phase W enable pin spec.

    gpio_dt_spec step_sync_{};                              // Stores per-commutation-step scope sync pin spec.
    gpio_dt_spec cycle_sync_{};                             // Stores per-electrical-cycle scope trigger pin spec.

    bool initialized_ = false;                              // Stores whether hardware initialization is completed.
};


}  // namespace motor_control
```

## Include/speed_ramp.hpp
```c
#pragma once

#include <cstdint>                                        // Includes fixed-size integer types.


namespace motor_control {                              // Opens motor control task namespace.


enum class RampPhase : uint8_t {                          // Creates enum describing where the ramp currently is.

    kAlign      = 0U,                                     // Holding one step to park the rotor before spinning.

    kAccelerate = 1U,                                     // Stepping faster and faster - the gradual speed gain.

    kRunning    = 2U,                                     // Final speed reached; running continuously.
};


// Produces the open-loop speed profile: start slow, gain speed gradually,
// then hold final speed indefinitely.
//
// The two things that ramp together are the STEP PERIOD (how long each of
// the six steps is held - shorter means faster) and the DUTY CYCLE. They
// must rise together: a BLDC at low speed generates almost no back-EMF, so
// full duty at low speed is nearly a short across the winding. Raising
// duty in step with speed is the open-loop stand-in for proper V/f
// control, and is what keeps the current sane during the ramp.
class SpeedRamp {                                         // Creates class producing the open-loop speed profile.

public:

    SpeedRamp() = default;                                // Creates default constructor for SpeedRamp object.

    void Start();                                         // Resets the ramp and records its start time.

    // Recomputes the profile for the current moment. Call once per
    // commutation step, before applying that step.
    void Update();

    uint32_t step_period_us() const { return step_period_us_; } // Returns how long to hold the current step.

    uint32_t duty_percent() const { return duty_percent_; }     // Returns the duty cycle for the current step.

    RampPhase phase() const { return phase_; }                   // Returns which part of the profile is active.

    uint32_t ElectricalRpm() const;                              // Returns the present electrical speed, for logging.


    // ---- Profile tuning - placeholders, adjust for your motor and load ----

    static constexpr uint32_t kAlignDurationMs   = 1000U;
    // Holds step 0 for one second at align duty so the rotor is parked at
    // a known electrical position. Without this the first few commutations
    // fight whatever position the rotor happened to stop in, and the motor
    // stutters or kicks backwards before it catches.

    static constexpr uint32_t kAlignDutyPercent  = 15U;           // Duty used while parking the rotor.

    static constexpr uint32_t kRampDurationMs    = 8000U;         // Time taken to accelerate from start to final speed.

    static constexpr uint32_t kStartStepPeriodUs = 20000U;        // Slow first steps (20 ms per step).

    static constexpr uint32_t kFinalStepPeriodUs = 1500U;         // Final speed step period (1.5 ms per step).

    static constexpr uint32_t kStartDutyPercent  = 15U;           // Duty at the start of the ramp.

    static constexpr uint32_t kFinalDutyPercent  = 40U;           // Duty once final speed is reached.


private:

    int64_t  start_uptime_ms_ = 0;                                 // Stores the uptime at which the ramp started.

    uint32_t step_period_us_  = kStartStepPeriodUs;                // Stores the present step period in microseconds.

    uint32_t duty_percent_    = kAlignDutyPercent;                 // Stores the present duty cycle percentage.

    RampPhase phase_          = RampPhase::kAlign;                 // Stores which part of the profile is active.
};


}  // namespace motor_control
```

## src/bldc_driver.cpp
```c
#include "bldc_driver.hpp"                                        // Includes BldcDriver class definition.

#include <zephyr/drivers/pwm.h>                                   // Includes Zephyr PWM driver functions.
#include <zephyr/logging/log.h>                                   // Includes Zephyr logging functions.


LOG_MODULE_REGISTER(bldc_driver, LOG_LEVEL_INF);                  // Creates log module for the inverter driver.


namespace motor_control {                                    // Opens motor control task namespace.


BldcDriver::BldcDriver(GpioOverlay& overlay) : overlay_(overlay) {}
// Constructor connects the inverter driver with the GPIO/PWM hardware object.


bool BldcDriver::Init() {                                          // Initializes the inverter into a safe all-off state.

    if (overlay_.pwm_dev() == nullptr) {                           // Checks that the PWM device was resolved.

        LOG_ERR("BLDC driver: PWM device missing");                // Prints PWM device error.

        return false;                                               // Returns failure.
    }

    AllOff();                                                       // Tri-states every phase before anything spins.

    initialized_ = true;                                            // Marks inverter initialization as completed.

    return true;                                                    // Returns successful initialization.
}


uint32_t BldcDriver::ChannelFor(Phase phase) const {               // Maps a phase onto its TIM1 PWM channel.

    switch (phase) {

    case Phase::kU:  return GpioOverlay::kPhaseUChannel;           // Phase U uses TIM1_CH1.

    case Phase::kV:  return GpioOverlay::kPhaseVChannel;           // Phase V uses TIM1_CH2.

    case Phase::kW:
    default:         return GpioOverlay::kPhaseWChannel;           // Phase W uses TIM1_CH3.
    }
}


const gpio_dt_spec& BldcDriver::EnableFor(Phase phase) const {     // Maps a phase onto its enable pin spec.

    switch (phase) {

    case Phase::kU:  return overlay_.en_u();                       // Phase U enable pin.

    case Phase::kV:  return overlay_.en_v();                       // Phase V enable pin.

    case Phase::kW:
    default:         return overlay_.en_w();                       // Phase W enable pin.
    }
}


bool BldcDriver::DriveHigh(Phase phase, uint32_t duty_percent) {   // Enables a phase and applies PWM duty to it.

    const gpio_dt_spec& enable = EnableFor(phase);                 // Looks up this phase's enable pin.

    if (gpio_pin_set_dt(&enable, 1) != 0) {                        // Enables the phase's half-bridge output.

        return false;                                              // Returns failure if the pin write failed.
    }

    const uint32_t pulse_ns =
        (GpioOverlay::kPwmPeriodNs * duty_percent) / 100U;          // Converts duty percentage into pulse width.

    return pwm_set(overlay_.pwm_dev(), ChannelFor(phase),
                   GpioOverlay::kPwmPeriodNs, pulse_ns, 0) == 0;    // Applies the PWM duty to this phase.
}


bool BldcDriver::DriveLow(Phase phase) {                            // Enables a phase and holds it grounded.

    const gpio_dt_spec& enable = EnableFor(phase);                  // Looks up this phase's enable pin.

    if (gpio_pin_set_dt(&enable, 1) != 0) {                         // Enables the phase's half-bridge output.

        return false;                                               // Returns failure if the pin write failed.
    }

    // 0% duty with the phase enabled means the low-side device is on
    // continuously - this is the return path for the motor current.
    return pwm_set(overlay_.pwm_dev(), ChannelFor(phase),
                   GpioOverlay::kPwmPeriodNs, 0U, 0) == 0;          // Holds this phase at ground.
}


bool BldcDriver::FloatPhase(Phase phase) {                          // Tri-states a phase so it floats.

    // Duty is zeroed FIRST so nothing is being driven at the instant the
    // enable pin drops - avoids a momentary shoot-through-adjacent state
    // on drivers that latch their input on the enable edge.
    static_cast<void>(pwm_set(overlay_.pwm_dev(), ChannelFor(phase),
                              GpioOverlay::kPwmPeriodNs, 0U, 0));    // Zeroes this phase's duty first.

    const gpio_dt_spec& enable = EnableFor(phase);                   // Looks up this phase's enable pin.

    return gpio_pin_set_dt(&enable, 0) == 0;                         // Tri-states the phase.
}


bool BldcDriver::ApplyStep(uint8_t step_index, uint32_t duty_percent) {
    // Applies one commutation step and marks the boundary for the scope.

    if (!initialized_) {                                              // Checks whether the driver was initialized.

        return false;                                                 // Returns failure if not ready.
    }

    const CommutationStep& step =
        kCommutationTable[step_index % kStepsPerElectricalRev];        // Selects the step, wrapping at six.

    // ORDER MATTERS: float the outgoing phase before driving anything, so
    // no phase is ever briefly both driven and grounded during the
    // transition.
    if (!FloatPhase(step.floating_phase)) {                           // Tri-states the phase that should float.

        LOG_ERR("Commutation: failed to float phase");                // Prints float failure.

        return false;                                                 // Returns failure.
    }

    if (!DriveLow(step.low_phase)) {                                  // Grounds the current return phase.

        LOG_ERR("Commutation: failed to ground phase");               // Prints ground failure.

        return false;                                                 // Returns failure.
    }

    if (!DriveHigh(step.high_phase, duty_percent)) {                  // PWM-drives the source phase.

        LOG_ERR("Commutation: failed to drive phase");                // Prints drive failure.

        return false;                                                 // Returns failure.
    }

    // ---- Scope sync outputs ------------------------------------------------
    // step_sync toggles on every commutation, so its edges line up exactly
    // with the phase waveform transitions - handy as a scope trigger when
    // you want to catch one specific step.
    gpio_pin_toggle_dt(&overlay_.step_sync());                        // Toggles the per-step sync line.

    // cycle_sync goes HIGH only during step 0, giving one pulse per
    // ELECTRICAL revolution. Trigger the scope on this line to get a
    // stable picture of all six steps at once.
    const bool is_cycle_start =
        ((step_index % kStepsPerElectricalRev) == 0U);                 // Checks whether this is the first step.

    gpio_pin_set_dt(&overlay_.cycle_sync(), is_cycle_start ? 1 : 0);   // Marks the start of each electrical cycle.

    return true;                                                       // Returns successful commutation.
}


void BldcDriver::AllOff() {                                            // Tri-states all three phases.

    static_cast<void>(FloatPhase(Phase::kU));                          // Floats phase U.

    static_cast<void>(FloatPhase(Phase::kV));                          // Floats phase V.

    static_cast<void>(FloatPhase(Phase::kW));                          // Floats phase W.

    gpio_pin_set_dt(&overlay_.step_sync(), 0);                          // Clears the per-step sync line.

    gpio_pin_set_dt(&overlay_.cycle_sync(), 0);                         // Clears the per-cycle sync line.
}


}  // namespace motor_control
```

## src/gpio_overlay.cpp
```c
#include "gpio_overlay.hpp"                                       // Includes GpioOverlay class definition.

#include <zephyr/devicetree.h>                                    // Includes Zephyr device tree support.
#include <zephyr/drivers/gpio.h>                                  // Includes Zephyr GPIO control functions.
#include <zephyr/drivers/pwm.h>                                   // Includes Zephyr PWM driver functions.
#include <zephyr/logging/log.h>                                   // Includes Zephyr logging functions.


LOG_MODULE_REGISTER(bldc_gpio_overlay, LOG_LEVEL_INF);            // Creates log module for GPIO overlay.


namespace motor_control {                                    // Opens motor control task namespace.


bool GpioOverlay::Init() {                                        // Initializes all hardware devices and pins.

    bool all_ready = true;                                        // Tracks whether every device/pin initialized cleanly.

    // ---- PWM device (TIM1, shared by all three phases) -------------------

    pwm_dev_ = DEVICE_DT_GET(DT_ALIAS(bldcpwm));                  // Gets the TIM1 PWM device (all phases, different channels).

    if (!device_is_ready(pwm_dev_)) {
        LOG_ERR("TIM1 PWM device not ready");                      // Prints PWM device error.
        all_ready = false;                                        // Marks initialization as failed.
    }

    // ---- Phase enable pins -----------------------------------------------

    en_u_ = GPIO_DT_SPEC_GET(DT_ALIAS(enu), gpios);               // Resolves phase U enable pin spec.
    en_v_ = GPIO_DT_SPEC_GET(DT_ALIAS(env), gpios);               // Resolves phase V enable pin spec.
    en_w_ = GPIO_DT_SPEC_GET(DT_ALIAS(enw), gpios);               // Resolves phase W enable pin spec.

    if (!gpio_is_ready_dt(&en_u_) || !gpio_is_ready_dt(&en_v_) || !gpio_is_ready_dt(&en_w_)) {
        LOG_ERR("Phase enable pin(s) not ready");                  // Prints enable pin error.
        all_ready = false;                                         // Marks initialization as failed.
    } else {
        // All three phases start tri-stated. The motor is electrically
        // disconnected until the commutation loop explicitly drives it -
        // safest power-up state.
        gpio_pin_configure_dt(&en_u_, GPIO_OUTPUT_INACTIVE);       // Configures phase U enable, starts floating.
        gpio_pin_configure_dt(&en_v_, GPIO_OUTPUT_INACTIVE);       // Configures phase V enable, starts floating.
        gpio_pin_configure_dt(&en_w_, GPIO_OUTPUT_INACTIVE);       // Configures phase W enable, starts floating.
    }

    // ---- Scope sync pins ---------------------------------------------------

    step_sync_  = GPIO_DT_SPEC_GET(DT_ALIAS(stepsync), gpios);    // Resolves per-commutation-step sync pin.
    cycle_sync_ = GPIO_DT_SPEC_GET(DT_ALIAS(cyclesync), gpios);   // Resolves per-electrical-cycle sync pin.

    if (!gpio_is_ready_dt(&step_sync_) || !gpio_is_ready_dt(&cycle_sync_)) {
        LOG_ERR("Scope sync pin(s) not ready");                    // Prints sync pin error.
        all_ready = false;                                         // Marks initialization as failed.
    } else {
        gpio_pin_configure_dt(&step_sync_, GPIO_OUTPUT_INACTIVE);  // Configures step sync output, starts LOW.
        gpio_pin_configure_dt(&cycle_sync_, GPIO_OUTPUT_INACTIVE); // Configures cycle sync output, starts LOW.
    }

    if (!all_ready) {                                               // Checks if any hardware initialization failed.
        return false;                                               // Stops initialization and returns failure.
    }

    initialized_ = true;                                            // Stores that hardware initialization is completed.

    return true;                                                    // Returns successful initialization.
}


}  // namespace motor_control
```

## src/speed_ramp.cpp
```c
#include "speed_ramp.hpp"                                          // Includes SpeedRamp class definition.

#include <zephyr/kernel.h>                                         // Includes Zephyr uptime functions.
#include <zephyr/logging/log.h>                                    // Includes Zephyr logging functions.

#include "commutation_table.hpp"                                   // Includes kStepsPerElectricalRev.


LOG_MODULE_REGISTER(speed_ramp, LOG_LEVEL_INF);                    // Creates log module for the speed ramp.


namespace motor_control {                                     // Opens motor control task namespace.


void SpeedRamp::Start() {                                           // Resets the ramp and records its start time.

    start_uptime_ms_ = k_uptime_get();                              // Stores the moment the profile began.

    step_period_us_ = kStartStepPeriodUs;                           // Starts at the slowest step period.

    duty_percent_ = kAlignDutyPercent;                              // Starts at the low align duty.

    phase_ = RampPhase::kAlign;                                     // Begins in the rotor-align phase.

    LOG_INF("Ramp start: align %u ms, then %u ms accel to %u us/step",
            kAlignDurationMs, kRampDurationMs, kFinalStepPeriodUs);
    // Prints the profile actually compiled in.
}


void SpeedRamp::Update() {                                          // Recomputes the profile for the current moment.

    const int64_t elapsed_ms = k_uptime_get() - start_uptime_ms_;   // Measures how long the profile has been running.

    // ---- Phase 1: align --------------------------------------------------
    if (elapsed_ms < static_cast<int64_t>(kAlignDurationMs)) {      // Checks whether still parking the rotor.

        if (phase_ != RampPhase::kAlign) {                          // Checks whether the phase is being entered.

            phase_ = RampPhase::kAlign;                             // Records the align phase.
        }

        step_period_us_ = kStartStepPeriodUs;                        // Holds the slowest step period while aligning.

        duty_percent_ = kAlignDutyPercent;                           // Holds the low align duty.

        return;                                                      // Nothing further to compute.
    }

    const int64_t ramp_elapsed_ms =
        elapsed_ms - static_cast<int64_t>(kAlignDurationMs);         // Measures time spent in the acceleration phase.

    // ---- Phase 3: running at final speed -----------------------------------
    if (ramp_elapsed_ms >= static_cast<int64_t>(kRampDurationMs)) {  // Checks whether the ramp has completed.

        if (phase_ != RampPhase::kRunning) {                          // Checks whether final speed was just reached.

            phase_ = RampPhase::kRunning;                             // Records the running phase.

            LOG_INF("Final speed reached: %u us/step, %u%% duty, %u electrical RPM",
                    kFinalStepPeriodUs, kFinalDutyPercent, ElectricalRpm());
            // Prints the steady-state operating point once.
        }

        step_period_us_ = kFinalStepPeriodUs;                          // Holds the final step period indefinitely.

        duty_percent_ = kFinalDutyPercent;                             // Holds the final duty indefinitely.

        return;                                                        // Nothing further to compute.
    }

    // ---- Phase 2: accelerate ------------------------------------------------
    if (phase_ != RampPhase::kAccelerate) {                            // Checks whether acceleration is being entered.

        phase_ = RampPhase::kAccelerate;                               // Records the acceleration phase.

        LOG_INF("Align complete - accelerating");                      // Prints the transition out of align.
    }

    // Linear interpolation across the ramp, expressed in parts-per-thousand
    // so the whole profile stays in integer arithmetic. Integer math here
    // keeps the commutation path free of any floating-point work, which
    // matters because this runs once per step and the step period gets
    // down to ~1.5 ms.
    const uint32_t progress_permille = static_cast<uint32_t>(
        (ramp_elapsed_ms * 1000) / static_cast<int64_t>(kRampDurationMs));
    // Computes how far through the ramp we are, 0 to 1000.

    const uint32_t period_span = kStartStepPeriodUs - kFinalStepPeriodUs;
    // Total reduction in step period across the whole ramp.

    step_period_us_ =
        kStartStepPeriodUs - ((period_span * progress_permille) / 1000U);
    // Shortens the step period linearly - this is the speed gain.

    const uint32_t duty_span = kFinalDutyPercent - kStartDutyPercent;
    // Total increase in duty across the whole ramp.

    duty_percent_ =
        kStartDutyPercent + ((duty_span * progress_permille) / 1000U);
    // Raises duty in step with speed, keeping winding current reasonable.
}


uint32_t SpeedRamp::ElectricalRpm() const {                            // Returns the present electrical speed.

    if (step_period_us_ == 0U) {                                       // Guards against a divide by zero.

        return 0U;                                                     // Returns zero if the period is invalid.
    }

    // One electrical revolution takes six steps. Electrical RPM is
    // therefore 60 seconds / (6 * step_period). Divide by the motor's
    // pole-pair count to get MECHANICAL RPM - a 7-pole-pair hobby motor
    // spins at one seventh of the number reported here.
    const uint32_t electrical_rev_period_us =
        step_period_us_ * kStepsPerElectricalRev;                      // Duration of one electrical revolution.

    return (60U * 1000000U) / electrical_rev_period_us;                // Converts to revolutions per minute.
}


}  // namespace motor_control
```
