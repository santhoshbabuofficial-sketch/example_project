## CMakeLists.txt
```
cmake_minimum_required(VERSION 3.20.0)

set(CMAKE_CXX_STANDARD 20)
set(CMAKE_CXX_STANDARD_REQUIRED ON)
set(CMAKE_CXX_EXTENSIONS OFF)

# NOTE: the overlay lives in "Board/" (capital B, singular), which is not
# Zephyr's auto-detected "boards/" convention, and nothing previously set
# DTC_OVERLAY_FILE - meaning the overlay was silently never applied. Must
# be set before find_package(Zephyr ...).
set(DTC_OVERLAY_FILE ${CMAKE_CURRENT_SOURCE_DIR}/Board/nucleo_g474re.overlay)

find_package(Zephyr REQUIRED HINTS $ENV{ZEPHYR_BASE})
project(Motor_Control_Task LANGUAGES CXX)

target_sources(app PRIVATE
  ${CMAKE_CURRENT_SOURCE_DIR}/src/main.cpp
  ${CMAKE_CURRENT_SOURCE_DIR}/src/gpio_overlay.cpp
  ${CMAKE_CURRENT_SOURCE_DIR}/src/voltage_sensor.cpp
  ${CMAKE_CURRENT_SOURCE_DIR}/src/current_sensor.cpp
  ${CMAKE_CURRENT_SOURCE_DIR}/src/motor_control.cpp
  ${CMAKE_CURRENT_SOURCE_DIR}/src/sensor_manager.cpp
  ${CMAKE_CURRENT_SOURCE_DIR}/src/lcd_display.cpp
  ${CMAKE_CURRENT_SOURCE_DIR}/src/fault_detection.cpp
)

target_compile_options(app PRIVATE
  -Wall
  -Wextra
  -Werror
  -Wvolatile
)

# NOTE: this was previously "include/" (lowercase). The folder on disk is
# "Include/" (capital I), which is case-sensitive on Linux and would fail
# to build as-is - fixed here.
target_include_directories(app PRIVATE
  ${CMAKE_CURRENT_SOURCE_DIR}/Include
)
```

## prj.conf
```kconfig
# --- Core ---------------------------------------------------------------
CONFIG_CPP=y
CONFIG_STD_CPP20=y
CONFIG_GLIBCXX_LIBCPP=y
CONFIG_NEWLIB_LIBC=y
CONFIG_MAIN_STACK_SIZE=2048

# --- GPIO -----------------------------------------------------------------
CONFIG_GPIO=y

# --- PWM (IR2104 gate-drive inputs) ----------------------------------------
CONFIG_PWM=y
CONFIG_PWM_STM32=y

# --- ADC (voltage / current sensing) ----------------------------------------
CONFIG_ADC=y
CONFIG_ADC_STM32=y

# --- I2C (LCD PCF8574 backpack) -----------------------------------------------
CONFIG_I2C=y

# --- Logging --------------------------------------------------------------------
CONFIG_LOG=y
CONFIG_LOG_MODE_DEFERRED=y
CONFIG_LOG_DEFAULT_LEVEL=3

# --- Console (routed to UART on this board) ---------------------------------------
CONFIG_CONSOLE=y
CONFIG_UART_CONSOLE=y

# --- No dynamic allocation in application code; keep heap minimal for libc use ------
CONFIG_HEAP_MEM_POOL_SIZE=1024
```

## src/main.cpp
```c
#include <zephyr/kernel.h>                                      // Includes Zephyr RTOS kernel functions like threads and sleep.
#include <zephyr/logging/log.h>                                  // Includes Zephyr logging functions.
#include <zephyr/drivers/gpio.h>                                 // Includes Zephyr GPIO control/interrupt functions.

#include "current_sensor.hpp"                                    // Includes current sensor class.
#include "fault_detection.hpp"                                   // Includes fault detection class.
#include "gpio_overlay.hpp"                                      // Includes GPIO and hardware device control.
#include "lcd_display.hpp"                                       // Includes LCD display control class.
#include "motor_control.hpp"                                     // Includes motor control state machine.
#include "sensor_manager.hpp"                                    // Includes sensor management class.
#include "voltage_sensor.hpp"                                    // Includes voltage sensor class.


LOG_MODULE_REGISTER(motor_control_task_main, LOG_LEVEL_INF);     // Creates log module for motor control task main.


namespace {                                                       // Opens private namespace for local variables and functions.


using mc::motor_control::CurrentSensor;                          // Creates short name for current sensor class.
using mc::motor_control::FaultDetector;                          // Creates short name for fault detector class.
using mc::motor_control::FaultReason;                            // Creates short name for fault reason enum.
using mc::motor_control::GpioOverlay;                             // Creates short name for GPIO overlay class.
using mc::motor_control::LcdDisplay;                              // Creates short name for LCD display class.
using mc::motor_control::LcdSensorObserver;                       // Creates short name for LCD observer class.
using mc::motor_control::MotorControl;                            // Creates short name for motor control class.
using mc::motor_control::SensorManager;                           // Creates short name for sensor manager class.
using mc::motor_control::VoltageSensor;                           // Creates short name for voltage sensor class.


constexpr uint16_t kSensorSamplePeriodMs = 1000U;                 // Defines sensor reading period (also fault-check period).
constexpr uint16_t kRampStepPeriodMs = 300U;                      // Defines how often the PWM ramp advances by one 5% step.
constexpr uint16_t kButtonDebounceMs = 50U;                       // Defines minimum time between accepted button presses.

constexpr size_t kSensorThreadStackSize = 2048U;                  // Defines memory size for sensor thread stack.
constexpr size_t kRampThreadStackSize = 1024U;                    // Defines memory size for ramp thread stack.

constexpr int kSensorThreadPriority = 5;                           // Defines sensor thread priority.
constexpr int kRampThreadPriority = 5;                              // Defines ramp thread priority.


GpioOverlay g_overlay;                                              // Creates GPIO hardware control object.

VoltageSensor* g_voltage_sensor = nullptr;                          // Creates pointer for voltage sensor object.
CurrentSensor* g_current_sensor = nullptr;                           // Creates pointer for current sensor object.
LcdDisplay* g_lcd = nullptr;                                          // Creates pointer for LCD object.
LcdSensorObserver* g_lcd_observer = nullptr;                          // Creates pointer for LCD observer object.
SensorManager* g_sensor_manager = nullptr;                             // Creates pointer for sensor manager object.
MotorControl* g_motor = nullptr;                                        // Creates pointer for motor control object.
FaultDetector g_fault_detector;                                          // Creates fault detector object (no dynamic hardware needed).


alignas(VoltageSensor) uint8_t g_voltage_storage[sizeof(VoltageSensor)];
// Creates memory storage for voltage sensor object.

alignas(CurrentSensor) uint8_t g_current_storage[sizeof(CurrentSensor)];
// Creates memory storage for current sensor object.

alignas(LcdDisplay) uint8_t g_lcd_storage[sizeof(LcdDisplay)];
// Creates memory storage for LCD object.

alignas(LcdSensorObserver) uint8_t g_lcd_observer_storage[sizeof(LcdSensorObserver)];
// Creates memory storage for LCD observer object.

alignas(SensorManager) uint8_t g_sensor_manager_storage[sizeof(SensorManager)];
// Creates memory storage for sensor manager object.

alignas(MotorControl) uint8_t g_motor_storage[sizeof(MotorControl)];
// Creates memory storage for motor control object.


k_work g_button_work{};                                              // Creates Zephyr work item for deferred button handling.
gpio_callback g_button_cb{};                                          // Creates Zephyr GPIO callback structure for the button.

int64_t g_last_button_press_ms = 0;                                    // Stores timestamp of the last accepted button press.


const char* FaultReasonText(FaultReason reason) {                       // Converts a fault reason into LCD-friendly text.

    switch (reason) {

        case FaultReason::kOverVoltage:  return "OVER-VOLTAGE";           // Over-voltage fault text.
        case FaultReason::kOverCurrent:  return "OVER-CURRENT";            // Over-current fault text.
        case FaultReason::kNone:
        default:                         return "UNKNOWN";                  // Fallback text (should not normally occur).
    }
}


void ButtonWorkHandler(k_work* /*work*/) {                              // Runs in thread context when a button press is processed.

    if (g_motor != nullptr) {                                             // Checks if motor control object exists.

        g_motor->OnButtonPress();                                          // Forwards the press to the ramp state machine.
    }
}


void ButtonIsr(const device* /*port*/, gpio_callback* /*cb*/, uint32_t /*pins*/) {
// Runs in interrupt context when the user button is pressed.

    const int64_t now_ms = k_uptime_get();                                 // Reads current uptime in milliseconds.

    if ((now_ms - g_last_button_press_ms) < kButtonDebounceMs) {            // Checks debounce window.

        return;                                                              // Ignores presses that are too close together.
    }

    g_last_button_press_ms = now_ms;                                         // Updates last accepted press timestamp.

    k_work_submit(&g_button_work);                                           // Defers actual handling to thread context.
}


void SensorThreadEntry(void* /*p1*/, void* /*p2*/, void* /*p3*/) {
// Zephyr thread function for periodic sensor reading and fault checking.

    while (true) {                                                           // Creates infinite RTOS task loop.

        g_sensor_manager->Tick();                                             // Reads sensors and updates observers.

        if (!g_fault_detector.IsFaulted()) {                                   // Skips re-checking once a fault is latched.

            const bool over_voltage =
                g_fault_detector.CheckVoltage(g_sensor_manager->last_voltage_v());
            // Checks the latest voltage sample against the configured limit.

            const bool over_current =
                !over_voltage &&
                g_fault_detector.CheckCurrent(g_sensor_manager->last_current_a());
            // Checks the latest current sample (only if voltage did not already fault).

            if (over_voltage || over_current) {                                 // Checks if this sample newly triggered a fault.

                g_motor->EmergencyStop();                                         // Immediately stops the motor.

                g_lcd_observer->SetFaultActive(true);                              // Suppresses routine LCD row-0 updates.

                g_lcd->ShowFault(FaultReasonText(g_fault_detector.Reason()));       // Shows the fault on the LCD.

                LOG_ERR("Motor stopped due to fault");                              // Logs the stop event.
            }
        }

        k_msleep(kSensorSamplePeriodMs);                                       // Delays thread for sensor sample period.
    }
}


void RampThreadEntry(void* /*p1*/, void* /*p2*/, void* /*p3*/) {
// Zephyr thread function for advancing the PWM ramp and updating LCD row 1.

    while (true) {                                                             // Creates infinite RTOS task loop.

        g_motor->Tick();                                                        // Advances the ramp state machine by one step.

        if (!g_motor->is_faulted()) {                                            // Skips LCD update while a fault message is shown.

            g_lcd->ShowPwmStatus(g_motor->pwm_percent(),
                                  g_motor->direction() == mc::motor_control::Direction::kForward);
            // Updates LCD row 1 with the current PWM duty and direction.
        }

        k_msleep(kRampStepPeriodMs);                                             // Delays thread for the ramp step period.
    }
}


K_THREAD_STACK_DEFINE(g_sensor_thread_stack, kSensorThreadStackSize);
// Creates stack memory for sensor RTOS thread.

K_THREAD_STACK_DEFINE(g_ramp_thread_stack, kRampThreadStackSize);
// Creates stack memory for ramp RTOS thread.

k_thread g_sensor_thread{};                                                 // Creates sensor thread control object.

k_thread g_ramp_thread{};                                                    // Creates ramp thread control object.


}  // namespace                                                              // Closes private namespace.


int main() {                                                                 // Main function starts the motor control task.

    LOG_INF("motor control task booting");                                    // Prints startup message.

    if (!g_overlay.Init()) {                                                   // Initializes GPIO/PWM/ADC/I2C hardware.

        LOG_ERR("gpio_overlay init failed - halting");                          // Prints initialization error.

        return -1;                                                               // Stops program due to hardware failure.
    }

    g_voltage_sensor = new (g_voltage_storage) VoltageSensor(g_overlay);
    // Creates voltage sensor object in preallocated memory.

    g_current_sensor = new (g_current_storage) CurrentSensor(g_overlay);
    // Creates current sensor object in preallocated memory.

    g_lcd = new (g_lcd_storage) LcdDisplay(g_overlay);
    // Creates LCD object in preallocated memory.

    g_lcd_observer = new (g_lcd_observer_storage) LcdSensorObserver(*g_lcd);
    // Creates LCD observer object in preallocated memory.

    g_sensor_manager =
        new (g_sensor_manager_storage) SensorManager(*g_voltage_sensor, *g_current_sensor);
    // Creates sensor manager object in preallocated memory.

    g_motor = new (g_motor_storage) MotorControl(g_overlay);
    // Creates motor control object in preallocated memory.

    if (!g_voltage_sensor->Init() || !g_current_sensor->Init() || !g_lcd->Init() ||
        !g_motor->Init()) {
    // Initializes voltage sensor, current sensor, LCD, and motor control hardware.

        LOG_ERR("Peripheral init failed - halting");                             // Prints peripheral initialization error.

        return -1;                                                                 // Stops program on failure.
    }

    g_sensor_manager->AddObserver(*g_lcd_observer);                                // Adds LCD observer for sensor updates.

    k_work_init(&g_button_work, ButtonWorkHandler);                                // Initializes deferred button work item.

    gpio_pin_interrupt_configure_dt(&g_overlay.user_button(), GPIO_INT_EDGE_TO_ACTIVE);
    // Configures the user button to interrupt on its active edge.

    gpio_init_callback(&g_button_cb, ButtonIsr, BIT(g_overlay.user_button().pin));
    // Sets up the GPIO callback structure for the user button pin.

    gpio_add_callback(g_overlay.user_button().port, &g_button_cb);
    // Registers the button callback with the GPIO driver.

    k_thread_create(&g_sensor_thread, g_sensor_thread_stack, kSensorThreadStackSize,
                     SensorThreadEntry, nullptr, nullptr, nullptr, kSensorThreadPriority, 0,
                     K_NO_WAIT);
    // Creates and starts sensor/fault reading RTOS thread.

    k_thread_name_set(&g_sensor_thread, "sensor_sample");                          // Names the sensor thread.

    k_thread_create(&g_ramp_thread, g_ramp_thread_stack, kRampThreadStackSize,
                     RampThreadEntry, nullptr, nullptr, nullptr, kRampThreadPriority, 0,
                     K_NO_WAIT);
    // Creates and starts the PWM ramp RTOS thread.

    k_thread_name_set(&g_ramp_thread, "motor_ramp");                                 // Names the ramp thread.

    LOG_INF("motor control task running");                                            // Prints running message.

    return 0;                                                                          // Ends main function successfully.
}
```

## Include/current_sensor.hpp
```c
#pragma once                                              // Prevents this header file from being included multiple times.

#include <cstdint>                                        // Includes fixed-size integer types.

#include "gpio_overlay.hpp"                                // Includes GPIO/ADC hardware access.


namespace mc::motor_control {                             // Opens motor control namespace.


class ICurrentSensor {                                     // Creates interface class for current sensor abstraction.

public:

    virtual ~ICurrentSensor() = default;                    // Virtual destructor allows safe object deletion.

    virtual bool Init() = 0;                                // Pure virtual function for sensor initialization.

    virtual bool Read(float& current_a_out) = 0;            // Pure virtual function to read current value in amperes.
};


// ACS712 hall-effect current sensor, read through the STM32G4 ADC1 channel
// wired to PA0. Sensitivity/zero-offset are named constants below - verify
// against your actual ACS712 variant (5A/20A/30A) and adjust if needed.
class CurrentSensor final : public ICurrentSensor {         // Creates CurrentSensor class implementing ICurrentSensor.

public:

    explicit CurrentSensor(GpioOverlay& overlay);           // Constructor connects sensor with GPIO/ADC hardware.

    bool Init() override;                                   // Initializes current sensor ADC reading path.

    bool Read(float& current_a_out) override;                // Reads ADC and converts to amperes.


private:

    // ---- ACS712 electrical characteristics (VERIFY against your module) --

    static constexpr float kAcsSupplyVoltage = 5.0F;         // ACS712 module supply voltage (typical 5.0V).

    static constexpr float kAcsZeroCurrentVoltage = kAcsSupplyVoltage / 2.0F;
    // Output voltage at 0A is nominally Vcc/2 per ACS712 datasheet.

    static constexpr float kAcsSensitivityVPerA = 0.185F;
    // ACS712-05B sensitivity is 185 mV/A. Change to 0.100F for the 20A
    // variant or 0.066F for the 30A variant if that is what is fitted.

    static constexpr float kAdcInputDividerRatio = 1.0F;
    // Ratio applied between the ACS712 output and the ADC pin, if any
    // external divider/level-shift is present on the board. 1.0 assumes
    // the ACS712 output is fed to the ADC pin directly/already conditioned
    // into the 0-3.3V range - update this if a divider is present.

    // ---- STM32G4 ADC characteristics --------------------------------------

    static constexpr float kAdcRefVoltage = 3.3F;             // STM32G4 ADC reference voltage.

    static constexpr uint32_t kAdcMaxCode =
        (1U << GpioOverlay::kAdcResolutionBits) - 1U;          // Maximum raw ADC code (4095 for 12-bit).

    GpioOverlay& overlay_;                                    // Stores reference to GPIO/ADC hardware control object.

    bool initialized_ = false;                                // Stores sensor initialization status.
};


}  // namespace mc::motor_control                            // Closes motor control namespace.
```

## Include/fault_detection.hpp
```c
#pragma once                                              // Prevents this header file from being included multiple times.


namespace mc::motor_control {                              // Opens motor control namespace.


enum class FaultReason {                                    // Enumerates possible fault causes.

    kNone,                                                   // No fault present.
    kOverVoltage,                                             // Bus voltage exceeded the configured limit.
    kOverCurrent,                                              // Motor current exceeded the configured limit.
};


// Latching threshold monitor: once tripped, stays tripped until Reset() is
// called explicitly (e.g. after the user acknowledges the fault). This
// avoids the motor silently re-enabling itself the instant a reading dips
// back under the limit for one sample.
class FaultDetector {                                        // Creates class to monitor voltage/current limits.

public:

    static constexpr float kMaxVoltageV = 14.0F;              // Maximum allowed bus voltage before fault.
    static constexpr float kMaxCurrentA = 3.0F;                // Maximum allowed motor current before fault.

    // Feeds one new voltage sample. Returns true if this sample newly
    // triggers a fault (was previously clear).
    bool CheckVoltage(float voltage_v);

    // Feeds one new current sample. Returns true if this sample newly
    // triggers a fault (was previously clear).
    bool CheckCurrent(float current_a);

    bool IsFaulted() const { return active_; }                // Returns whether a fault is currently latched.

    FaultReason Reason() const { return reason_; }             // Returns the reason for the latched fault.

    void Reset();                                               // Clears the latched fault (call only after a safe restart).


private:

    bool active_ = false;                                       // Stores whether a fault is currently latched.

    FaultReason reason_ = FaultReason::kNone;                    // Stores the reason for the latched fault.
};


}  // namespace mc::motor_control                              // Closes motor control namespace.
```

## Include/gpio_overlay.hpp
```c
#pragma once                                              // Prevents this header file from being included multiple times.

#include <cstdint>                                        // Includes fixed-size integer types.

#include <zephyr/device.h>                                // Includes Zephyr device structure and APIs.
#include <zephyr/drivers/gpio.h>                          // Includes Zephyr GPIO driver functions.


namespace mc::motor_control {                            // Opens motor control task namespace.


// Central hardware access point. Every other module talks to the board
// only through this class - no raw devicetree macros anywhere else.
class GpioOverlay {                                       // Creates class to manage all hardware pin and device connections.

public:

    GpioOverlay() = default;                               // Creates default constructor for GpioOverlay object.

    bool Init();                                           // Initializes GPIO pins and hardware devices.

    // ---- PWM (IR2104 gate-drive PWM inputs, pin 2 of each IC) ----------
    // Both legs live on the same TIM1 peripheral (different channels), so
    // there is a single PWM device shared by both - not two separate ones.

    const device* pwm_dev() const { return pwm_dev_; }      // Returns the TIM1 PWM device (drives both IR2104 legs).

    static constexpr uint32_t kPwm1Channel = 1U;            // TIM1_CH1 -> PC0 -> IR2104 #1 PWM input.
    static constexpr uint32_t kPwm2Channel = 3U;            // TIM1_CH3 -> PC2 -> IR2104 #2 PWM input.
    static constexpr uint32_t kPwmPeriodNs = 50000U;        // 20 kHz PWM period (well above audible range).

    // ---- IR2104 SHUTDOWN pins (pin 3 of each IC) ------------------------
    // Active-LOW in devicetree: gpio_pin_set_dt(spec, 1) == enabled (SD low),
    // gpio_pin_set_dt(spec, 0) == shutdown (SD high), matching IR2104 datasheet.

    const gpio_dt_spec& sd1() const { return sd1_; }        // Returns IR2104 #1 shutdown pin spec (PC1).
    const gpio_dt_spec& sd2() const { return sd2_; }        // Returns IR2104 #2 shutdown pin spec (PC3).

    // ---- Motor direction indicator pins ---------------------------------

    const gpio_dt_spec& dir_fwd() const { return dir_fwd_; } // Returns forward-direction indicator pin (PB13).
    const gpio_dt_spec& dir_rev() const { return dir_rev_; } // Returns reverse-direction indicator pin (PB15).

    // ---- User button (onboard B1) ---------------------------------------

    const gpio_dt_spec& user_button() const { return user_button_; } // Returns onboard user button pin spec.

    // ---- ADC (current / voltage sensing) ---------------------------------

    const device* current_adc_dev() const { return current_adc_dev_; } // Returns ADC1 device (ACS712 current sensor).
    const device* voltage_adc_dev() const { return voltage_adc_dev_; } // Returns ADC2 device (0-25V voltage sensor).

    static constexpr uint8_t kCurrentAdcChannel = 1U;        // ADC1_IN1 -> PA0 -> ACS712 output.
    static constexpr uint8_t kVoltageAdcChannel = 17U;       // ADC2_IN17 -> PA4 -> voltage divider output.
    static constexpr uint8_t kAdcResolutionBits = 12U;       // STM32G4 ADC resolution used for both channels.

    // ---- LCD (16x2, PCF8574 I2C backpack) --------------------------------

    const device* lcd_i2c_bus() const { return lcd_i2c_bus_; } // Returns I2C device used for LCD communication.

    static constexpr uint16_t kLcdI2cAddr = 0x27U;            // I2C address of LCD PCF8574 backpack.


private:

    const device* pwm_dev_ = nullptr;                       // Stores TIM1 PWM device pointer (drives both legs).

    gpio_dt_spec sd1_{};                                    // Stores IR2104 #1 shutdown pin spec.
    gpio_dt_spec sd2_{};                                    // Stores IR2104 #2 shutdown pin spec.

    gpio_dt_spec dir_fwd_{};                                 // Stores forward direction indicator pin spec.
    gpio_dt_spec dir_rev_{};                                 // Stores reverse direction indicator pin spec.

    gpio_dt_spec user_button_{};                             // Stores onboard user button pin spec.

    const device* current_adc_dev_ = nullptr;                // Stores ADC1 device pointer (current sensor).
    const device* voltage_adc_dev_ = nullptr;                // Stores ADC2 device pointer (voltage sensor).

    const device* lcd_i2c_bus_ = nullptr;                     // Stores I2C device pointer used for LCD.

    bool initialized_ = false;                                // Stores whether hardware initialization is completed.
};


}  // namespace mc::motor_control                          // Closes motor control namespace.
```

## Include/lcd_display.hpp
```c
#pragma once                                              // Prevents this header file from being included multiple times.

#include <cstdint>                                        // Includes fixed-size integer types like uint8_t.

#include "gpio_overlay.hpp"                                // Includes GPIO and I2C hardware control functions.


namespace mc::motor_control {                              // Opens motor control namespace.


class ILcdDisplay {                                        // Creates LCD interface class for abstraction.

public:

    virtual ~ILcdDisplay() = default;
    // Creates virtual destructor for safe deletion of derived LCD objects.

    virtual bool Init() = 0;
    // Defines function to initialize LCD hardware, implemented by child class.

    virtual void ShowVoltageCurrent(float voltage_v, float current_a) = 0;
    // Displays voltage and current together on LCD row 0.

    virtual void ShowPwmStatus(uint8_t pwm_percent, bool forward) = 0;
    // Displays commanded PWM duty and direction on LCD row 1.

    virtual void ShowFault(const char* reason_text) = 0;
    // Displays a fault message across both LCD rows.
};


class LcdDisplay final : public ILcdDisplay {              // Creates LCD class that implements ILcdDisplay interface.

public:

    explicit LcdDisplay(GpioOverlay& overlay);
    // Constructor connects LCD object with GPIO/I2C hardware control.

    bool Init() override;
    // Initializes LCD hardware communication.

    void ShowVoltageCurrent(float voltage_v, float current_a) override;
    // Displays voltage (V) and current (A) together on row 0.

    void ShowPwmStatus(uint8_t pwm_percent, bool forward) override;
    // Displays PWM duty percentage and direction on row 1.

    void ShowFault(const char* reason_text) override;
    // Displays a fault message across both rows.


private:

    static constexpr uint8_t kLcdColumns = 16U;
    // Defines LCD number of columns (16 characters).

    static constexpr uint8_t kLcdRows = 2U;
    // Defines LCD number of rows (2 lines).

    static constexpr uint8_t kBacklightBit = 0x08U;
    // Defines bit position used to control LCD backlight.

    static constexpr uint8_t kEnableBit = 0x04U;
    // Defines bit position used for LCD enable signal.

    static constexpr uint8_t kRegisterSelectBit = 0x01U;
    // Defines bit position used to select LCD command/data mode.

    void WriteNibble(uint8_t nibble, bool is_data);
    // Sends 4-bit data to LCD through I2C interface.

    void WriteByte(uint8_t value, bool is_data);
    // Sends complete 8-bit data or command to LCD.

    void SetCursor(uint8_t row, uint8_t col);
    // Moves LCD cursor position to given row and column.

    void WriteLine(uint8_t row, const char* text);
    // Writes text data on selected LCD row.


    GpioOverlay& overlay_;
    // Stores reference to GPIO object for LCD communication.

    bool initialized_ = false;
    // Stores whether LCD initialization is completed.

    bool i2c_error_logged_ = false;
    // Prevents repeated logging of same I2C communication error.
};


}  // namespace mc::motor_control                         // Closes motor control namespace.
```

## Include/motor_control.hpp
```c
#pragma once                                              // Prevents this header file from being included multiple times.

#include <cstdint>                                        // Includes fixed-size integer types.

#include "gpio_overlay.hpp"                                // Includes GPIO/PWM hardware access.


namespace mc::motor_control {                              // Opens motor control namespace.


enum class Direction {                                      // Enumerates motor rotation direction.

    kForward,                                                // Motor commanded to rotate forward.
    kReverse,                                                 // Motor commanded to rotate reverse.
};


enum class RampState {                                       // Enumerates PWM ramp phase.

    kStopped,                                                 // Motor has never been started (PWM = 0, bridges disabled).
    kIncreasing,                                               // PWM ramping up towards 100%.
    kHoldAtMax,                                                // PWM has reached 100% and is holding there.
    kDecreasing,                                               // PWM ramping down towards 0%, then auto-reverses.
};


// Drives the H-bridge (2x IR2104 half-bridge) using a "PWM leg + static leg"
// scheme: whichever leg matches the current direction carries the duty
// cycle, the other leg is held at 0%. Speed ramps up/down in 5% steps on
// each button press per the task spec; reaching 0% while decelerating
// automatically flips direction and resumes ramping up.
class MotorControl {                                          // Creates class implementing the motor control state machine.

public:

    explicit MotorControl(GpioOverlay& overlay);               // Constructor connects motor control with GPIO/PWM hardware.

    bool Init();                                                // Initializes PWM outputs and brings hardware to a safe stopped state.

    void OnButtonPress();                                       // Handles one debounced user-button press event.

    void Tick();                                                // Advances the ramp state machine by one step (call periodically).

    void EmergencyStop();                                       // Immediately disables both bridges and halts the ramp (fault path).

    void ClearFaultAndStop();                                   // Clears the faulted flag and leaves the motor in a stopped state.

    uint8_t pwm_percent() const { return pwm_percent_; }        // Returns current commanded PWM duty percentage (0-100).

    Direction direction() const { return direction_; }          // Returns current commanded direction.

    bool is_running() const { return running_; }                // Returns whether the motor is actively running (not stopped/faulted).

    bool is_faulted() const { return faulted_; }                 // Returns whether the motor is latched in a fault state.


private:

    static constexpr uint8_t kPwmStepPercent = 5U;               // PWM ramp step size, per task spec (5% steps).
    static constexpr uint8_t kPwmMaxPercent = 100U;               // Maximum PWM duty percentage.
    static constexpr uint8_t kPwmMinPercent = 0U;                  // Minimum PWM duty percentage.

    void ApplyPwm();                                              // Pushes pwm_percent_/direction_ out to the two PWM legs.

    void SetDirectionIndicators(Direction dir);                    // Drives the PB13/PB15 direction indicator pins.

    void EnableBridges();                                          // Enables both IR2104 half-bridges (clears SD/shutdown).

    void DisableBridges();                                         // Disables both IR2104 half-bridges (asserts SD/shutdown).

    GpioOverlay& overlay_;                                          // Stores reference to GPIO/PWM hardware control object.

    uint8_t pwm_percent_ = 0U;                                       // Stores current commanded PWM duty percentage.

    Direction direction_ = Direction::kForward;                       // Stores current commanded direction.

    RampState ramp_state_ = RampState::kStopped;                       // Stores current ramp phase.

    bool running_ = false;                                              // Stores whether the motor has been started.

    bool faulted_ = false;                                               // Stores whether a fault has latched the motor off.
};


}  // namespace mc::motor_control                                       // Closes motor control namespace.
```

## Include/sensor_manager.hpp
```c
#pragma once                                              // Prevents this header file from being included multiple times.

#include <array>                                          // Includes fixed-size array container.
#include <cstddef>                                        // Includes size_t type.

#include "current_sensor.hpp"                              // Includes current sensor interface.
#include "lcd_display.hpp"                                 // Includes LCD display interface.
#include "voltage_sensor.hpp"                              // Includes voltage sensor interface.


namespace mc::motor_control {                              // Opens motor control namespace.


class ISensorDataObserver {                                  // Creates interface for receiving sensor data.

public:

    virtual ~ISensorDataObserver() = default;                 // Creates virtual destructor.

    virtual void OnVoltageSample(float voltage_v) = 0;          // Receives new voltage sample.

    virtual void OnCurrentSample(float current_a) = 0;          // Receives new current sample.
};


// Forwards live voltage/current samples to LCD row 0. Suppressed while a
// fault is active so the fault message on the LCD is not overwritten by
// the next periodic sensor sample.
class LcdSensorObserver final : public ISensorDataObserver {   // Creates LCD observer.

public:

    explicit LcdSensorObserver(ILcdDisplay& lcd) : lcd_(lcd) {}  // Constructor connects LCD object.

    void OnVoltageSample(float voltage_v) override {              // Updates cached voltage and refreshes LCD row 0.

        last_voltage_v_ = voltage_v;                                // Caches the latest voltage sample.

        if (!fault_active_) {                                        // Checks emergency stop / fault status.

            lcd_.ShowVoltageCurrent(last_voltage_v_, last_current_a_);  // Shows combined voltage/current line.
        }
    }

    void OnCurrentSample(float current_a) override {               // Updates cached current and refreshes LCD row 0.

        last_current_a_ = current_a;                                  // Caches the latest current sample.

        if (!fault_active_) {                                          // Checks emergency stop / fault status.

            lcd_.ShowVoltageCurrent(last_voltage_v_, last_current_a_);    // Shows combined voltage/current line.
        }
    }

    void SetFaultActive(bool active) { fault_active_ = active; }        // Updates fault-suppression state.


private:

    ILcdDisplay& lcd_;                                                    // Stores LCD reference.

    float last_voltage_v_ = 0.0F;                                          // Stores last cached voltage sample.

    float last_current_a_ = 0.0F;                                          // Stores last cached current sample.

    bool fault_active_ = false;                                             // Stores whether row 0 updates are suppressed.
};


// Reads both sensors once per Tick() and fans the raw values out to every
// registered observer (Observer pattern) - no heap allocation, fixed-size
// observer list.
class SensorManager {                                         // Manages sensors and observers.

public:

    static constexpr std::size_t kMaxObservers = 4U;            // Maximum observer count.

    SensorManager(IVoltageSensor& voltage_sensor,
                  ICurrentSensor& current_sensor);               // Connects voltage and current sensors.

    bool AddObserver(ISensorDataObserver& observer);             // Registers a new observer.

    void Tick();                                                  // Reads sensors and updates observers.

    float last_voltage_v() const { return last_voltage_v_; }      // Returns the most recent voltage reading.

    float last_current_a() const { return last_current_a_; }       // Returns the most recent current reading.


private:

    IVoltageSensor& voltage_sensor_;                                 // Stores voltage sensor reference.

    ICurrentSensor& current_sensor_;                                  // Stores current sensor reference.

    std::array<ISensorDataObserver*, kMaxObservers> observers_{};      // Stores registered observer pointers.

    std::size_t observer_count_ = 0U;                                  // Stores current observer count.

    float last_voltage_v_ = 0.0F;                                       // Stores last successfully read voltage.

    float last_current_a_ = 0.0F;                                        // Stores last successfully read current.
};


}  // namespace mc::motor_control                                       // Closes motor control namespace.
```

## Include/voltage_sensor.hpp
```c
#pragma once                                              // Prevents this header file from being included multiple times.

#include <cstdint>                                        // Includes fixed-size integer types.

#include "gpio_overlay.hpp"                                // Includes GPIO/ADC hardware access.


namespace mc::motor_control {                              // Opens motor control namespace.


class IVoltageSensor {                                      // Creates interface class for voltage sensor abstraction.

public:

    virtual ~IVoltageSensor() = default;                     // Virtual destructor allows safe object deletion.

    virtual bool Init() = 0;                                 // Pure virtual function for sensor initialization.

    virtual bool Read(float& voltage_v_out) = 0;             // Pure virtual function to read voltage value in volts.
};


// Generic "0-25V DC voltage sensor module" - a fixed resistor divider
// (commonly 30k / 7.5k, ratio 5:1) feeding STM32G4 ADC2 channel on PA4.
class VoltageSensor final : public IVoltageSensor {          // Creates VoltageSensor class implementing IVoltageSensor.

public:

    explicit VoltageSensor(GpioOverlay& overlay);            // Constructor connects sensor with GPIO/ADC hardware.

    bool Init() override;                                    // Initializes voltage sensor ADC reading path.

    bool Read(float& voltage_v_out) override;                 // Reads ADC and converts to volts.


private:

    static constexpr float kDividerRatio = 5.0F;
    // 0-25V module divider ratio: Vin = Vadc * 5 (verify against your
    // specific module if it differs).

    static constexpr float kAdcRefVoltage = 3.3F;              // STM32G4 ADC reference voltage.

    static constexpr uint32_t kAdcMaxCode =
        (1U << GpioOverlay::kAdcResolutionBits) - 1U;           // Maximum raw ADC code (4095 for 12-bit).

    GpioOverlay& overlay_;                                     // Stores reference to GPIO/ADC hardware control object.

    bool initialized_ = false;                                 // Stores whether voltage sensor initialization is completed.
};


}  // namespace mc::motor_control                             // Closes motor control namespace.
```

## src/current_sensor.cpp
```c
#include "current_sensor.hpp"                                      // Includes CurrentSensor class definition.

#include <zephyr/drivers/adc.h>                                    // Includes Zephyr ADC read functions.
#include <zephyr/logging/log.h>                                    // Includes Zephyr logging functions.


LOG_MODULE_REGISTER(current_sensor, LOG_LEVEL_INF);                // Creates log module for current sensor.


namespace mc::motor_control {                                     // Opens motor control namespace.


CurrentSensor::CurrentSensor(GpioOverlay& overlay) : overlay_(overlay) {}
// Constructor connects current sensor object with GPIO/ADC hardware control.


bool CurrentSensor::Init() {                                       // Initializes current sensor ADC path.

    if (!device_is_ready(overlay_.current_adc_dev())) {            // Checks whether ADC1 device is ready.

        LOG_ERR("Current sensor ADC device not ready");            // Prints ADC error message.

        initialized_ = false;                                      // Marks sensor initialization as failed.

        return false;                                               // Returns failure.
    }

    initialized_ = true;                                            // Marks current sensor as initialized.

    return true;                                                    // Returns successful initialization.
}


bool CurrentSensor::Read(float& current_a_out) {                   // Reads ACS712 current value.

    if (!initialized_) {                                            // Checks whether sensor was initialized.

        return false;                                               // Returns failure if sensor is not ready.
    }

    int16_t raw_sample = 0;                                         // Creates buffer to hold raw ADC conversion result.

    adc_sequence sequence = {};                                     // Creates ADC read sequence descriptor.
    sequence.channels = BIT(GpioOverlay::kCurrentAdcChannel);       // Selects the ACS712 ADC channel.
    sequence.buffer = &raw_sample;                                   // Points sequence at the raw sample buffer.
    sequence.buffer_size = sizeof(raw_sample);                       // Sets buffer size in bytes.
    sequence.resolution = GpioOverlay::kAdcResolutionBits;           // Sets ADC resolution to 12 bits.

    const int err = adc_read(overlay_.current_adc_dev(), &sequence); // Performs the ADC conversion.

    if (err != 0) {                                                  // Checks if ADC read failed.

        LOG_WRN("Current sensor ADC read failed: %d", err);          // Prints ADC read error.

        return false;                                                // Returns failure.
    }

    const auto raw_code = static_cast<uint32_t>(raw_sample < 0 ? 0 : raw_sample);
    // Clamps a negative sample (should not normally occur) to zero.

    const float adc_pin_voltage =
        (static_cast<float>(raw_code) * kAdcRefVoltage) / static_cast<float>(kAdcMaxCode);
    // Converts raw ADC code into the voltage actually present on the ADC pin.

    const float acs_output_voltage = adc_pin_voltage / kAdcInputDividerRatio;
    // Recovers the ACS712 output voltage before any external divider.

    current_a_out = (acs_output_voltage - kAcsZeroCurrentVoltage) / kAcsSensitivityVPerA;
    // Converts ACS712 output voltage into current in amperes.

    LOG_INF("ACS712 raw=%u Vpin=%d.%02u mV Iout=%d.%02u A", raw_code,
            static_cast<int>(adc_pin_voltage),
            static_cast<unsigned>((adc_pin_voltage - static_cast<int>(adc_pin_voltage)) * 100),
            static_cast<int>(current_a_out),
            static_cast<unsigned>((current_a_out - static_cast<int>(current_a_out)) * 100));
    // Prints raw code and computed current for debugging.

    return true;                                                     // Returns successful sensor reading.
}


}  // namespace mc::motor_control                                  // Closes motor control namespace.
```

## src/fault_detection.cpp
```c
#include "fault_detection.hpp"                                    // Includes FaultDetector class definition.

#include <zephyr/logging/log.h>                                   // Includes Zephyr logging functions.


LOG_MODULE_REGISTER(fault_detection, LOG_LEVEL_INF);              // Creates log module for fault detection.


namespace mc::motor_control {                                    // Opens motor control namespace.


bool FaultDetector::CheckVoltage(float voltage_v) {               // Checks a new voltage sample against the limit.

    if (active_) {                                                 // Checks whether a fault is already latched.

        return false;                                              // Does not re-trigger an already-latched fault.
    }

    if (voltage_v > kMaxVoltageV) {                                // Checks whether voltage exceeds the limit.

        active_ = true;                                            // Latches the fault.
        reason_ = FaultReason::kOverVoltage;                        // Records the fault reason.

        LOG_ERR("FAULT: over-voltage %d.%02u V (limit %d V)",
                static_cast<int>(voltage_v),
                static_cast<unsigned>((voltage_v - static_cast<int>(voltage_v)) * 100),
                static_cast<int>(kMaxVoltageV));
        // Prints over-voltage fault details.

        return true;                                                // Reports a newly-triggered fault.
    }

    return false;                                                  // No fault on this sample.
}


bool FaultDetector::CheckCurrent(float current_a) {                 // Checks a new current sample against the limit.

    if (active_) {                                                  // Checks whether a fault is already latched.

        return false;                                               // Does not re-trigger an already-latched fault.
    }

    if (current_a > kMaxCurrentA) {                                  // Checks whether current exceeds the limit.

        active_ = true;                                              // Latches the fault.
        reason_ = FaultReason::kOverCurrent;                          // Records the fault reason.

        LOG_ERR("FAULT: over-current %d.%02u A (limit %d A)",
                static_cast<int>(current_a),
                static_cast<unsigned>((current_a - static_cast<int>(current_a)) * 100),
                static_cast<int>(kMaxCurrentA));
        // Prints over-current fault details.

        return true;                                                  // Reports a newly-triggered fault.
    }

    return false;                                                    // No fault on this sample.
}


void FaultDetector::Reset() {                                        // Clears the latched fault.

    active_ = false;                                                   // Clears fault-active flag.
    reason_ = FaultReason::kNone;                                       // Clears fault reason.
}


}  // namespace mc::motor_control                                    // Closes motor control namespace.
```
