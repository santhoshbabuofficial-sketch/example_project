## CMakeLists.txt
```
cmake_minimum_required(VERSION 3.20.0)

set(CMAKE_CXX_STANDARD 20)
set(CMAKE_CXX_STANDARD_REQUIRED ON)
set(CMAKE_CXX_EXTENSIONS OFF)

# Overlay lives in "Board/" (capital B, singular), not Zephyr's
# auto-detected "boards/" convention, so DTC_OVERLAY_FILE must be set
# explicitly before find_package(Zephyr ...).
set(DTC_OVERLAY_FILE ${CMAKE_CURRENT_SOURCE_DIR}/Board/nucleo_g474re.overlay)

# The custom,bldc-motor binding lives in this application, not in Zephyr.
list(APPEND DTS_ROOT ${CMAKE_CURRENT_SOURCE_DIR})

find_package(Zephyr REQUIRED HINTS $ENV{ZEPHYR_BASE})
project(Bldc_Open_Loop_Commutation LANGUAGES CXX)

target_sources(app PRIVATE
  ${CMAKE_CURRENT_SOURCE_DIR}/src/main.cpp
  ${CMAKE_CURRENT_SOURCE_DIR}/src/bldc_driver.cpp
)

target_include_directories(app PRIVATE
  ${CMAKE_CURRENT_SOURCE_DIR}/src
)

target_compile_options(app PRIVATE
  -Wall
  -Wextra
  -Werror
  -Wvolatile
)
```

## prj.conf
```kconfig
# --- Core -------------------------------------------------------------------
CONFIG_CPP=y
CONFIG_STD_CPP20=y
CONFIG_GLIBCXX_LIBCPP=y
CONFIG_NEWLIB_LIBC=y
CONFIG_MAIN_STACK_SIZE=2048

# No exceptions, no RTTI, no heap - the commutation path must stay
# deterministic and every allocation in this application is static.
CONFIG_CPP_EXCEPTIONS=n
CONFIG_CPP_RTTI=n
CONFIG_HEAP_MEM_POOL_SIZE=0

# --- Timing -----------------------------------------------------------------
# Commutation dwell times reach ~1.5 ms at cruise. A 100 us tick keeps the
# quantisation error on each step down to a few percent. Raise this to 20000
# if a faster final speed is needed.
CONFIG_SYS_CLOCK_TICKS_PER_SEC=10000

# --- PWM: TIM1 CH1/CH2/CH3 (PC0 / PC1 / PC2) --------------------------------
CONFIG_PWM=y
CONFIG_PWM_STM32=y

# --- GPIO: half-bridge shutdown pins and the scope sync marker --------------
CONFIG_GPIO=y

# --- Logging ----------------------------------------------------------------
# Deferred mode so LOG_INF() from the commutation thread never blocks on the
# UART and stretches a commutation step.
CONFIG_LOG=y
CONFIG_LOG_MODE_DEFERRED=y
CONFIG_LOG_DEFAULT_LEVEL=3

# --- Console ----------------------------------------------------------------
CONFIG_CONSOLE=y
CONFIG_UART_CONSOLE=y

# --- Diagnostics (optional, handy while tuning the ramp) --------------------
CONFIG_THREAD_NAME=y
CONFIG_THREAD_MONITOR=y
```

## dts/bindings/custom,bldc-motor.yaml
```yaml
# Binding for a three-phase BLDC inverter built from three EN/IN style
# half-bridge gate drivers (IR2104, L6234, DRV8313, ...).
#
# Each phase contributes one PWM channel (the driver IN pin) and one GPIO
# (the driver SD / enable pin). A further GPIO is used purely as an
# oscilloscope trigger marker.

description: Three-phase BLDC inverter, six-step open-loop commutation

compatible: "custom,bldc-motor"

include: base.yaml

properties:
  pwms:
    required: true
    description: PWM channels feeding the three driver IN pins.

  pwm-names:
    required: true
    description: Must be "phase-a", "phase-b", "phase-c" in that order.

  enable-gpios:
    type: phandle-array
    required: true
    description: |
      Shutdown / enable pin of each half-bridge driver, in phase A, B, C
      order. Declare the electrical polarity here (IR2104 SD is active low)
      so the application can work in logical levels only.

  sync-gpios:
    type: phandle-array
    required: true
    description: Scope trigger, pulsed once per electrical revolution.
```

## src/main.cpp
```c
#include <cstdint>                                                 // Fixed-width integer types.

#include <zephyr/kernel.h>                                         // Threads, timers, sleep.
#include <zephyr/logging/log.h>                                    // Logging macros.

#include "bldc_driver.hpp"                                         // Inverter hardware abstraction.
#include "commutation_profile.hpp"                                 // Step table and open-loop ramp maths.

LOG_MODULE_REGISTER(bldc_open_loop, LOG_LEVEL_INF);                // Log module for the application layer.

namespace {

// ---------------------------------------------------------------------------
// Static resources - nothing here is heap allocated
// ---------------------------------------------------------------------------

constexpr size_t kCommutationStackSize = 1024U;                    // Stack for the commutation thread.
constexpr int    kCommutationPriority  = K_HIGHEST_APPLICATION_THREAD_PRIO;  // Highest app priority: timing matters most.

K_THREAD_STACK_DEFINE(commutation_stack, kCommutationStackSize);   // Statically allocated thread stack.

k_thread commutation_thread_data{};                                // Statically allocated thread control block.

K_TIMER_DEFINE(commutation_timer, nullptr, nullptr);               // Paces commutation without cumulative drift.

bldc::BldcDriver driver{};                                         // The one and only inverter instance.

constexpr bool     kForwardRotation = true;                        // Direction: true walks the step table forwards.
constexpr uint32_t kLogIntervalMs   = 1000U;                       // How often the run state prints telemetry.

// ---------------------------------------------------------------------------
// Open-loop control states
// ---------------------------------------------------------------------------

enum class MotorState : uint8_t {
    Align = 0U,                                                    // Park the rotor on a known step.
    Ramp  = 1U,                                                    // Accelerate from crawl to cruise.
    Run   = 2U,                                                    // Hold the cruise rate indefinitely.
    Fault = 3U                                                     // Something failed; bridges are off.
};

// ---------------------------------------------------------------------------
// Commutation thread
// ---------------------------------------------------------------------------

void commutation_thread_entry(void* /*p1*/, void* /*p2*/, void* /*p3*/) {

    MotorState state = MotorState::Align;                          // Start by aligning the rotor.
    uint8_t    step_index = 0U;                                    // Current index into the six-step table.
    uint32_t   ramp_elapsed_ms = 0U;                               // Time spent ramping so far.
    uint32_t   log_accumulator_ms = 0U;                            // Throttles logging in the Run state.
    uint32_t   electrical_revs = 0U;                               // Completed electrical revolutions, for telemetry.

    // --- Alignment ---------------------------------------------------------
    // Energise a single step and hold it. The rotor snaps to that electrical
    // position, which gives the blind ramp a known starting angle. Without
    // this the first few commutations are a coin flip and the motor may
    // stutter or briefly run backwards.
    LOG_INF("state: ALIGN (%u ms @ %u%% duty)", bldc::kAlignDurationMs, bldc::kAlignDutyPercent);

    if (driver.apply_step(step_index, bldc::kAlignDutyPercent) != 0) {
        state = MotorState::Fault;                                 // Give up before spinning anything.
    } else {
        k_msleep(static_cast<int32_t>(bldc::kAlignDurationMs));    // Hold the alignment step.
        state = MotorState::Ramp;
        LOG_INF("state: RAMP (%u ms, %u -> %u steps/s)",
                bldc::kRampDurationMs,
                bldc::kStartStepRateMilliHz / 1000U,
                bldc::kRunStepRateMilliHz / 1000U);
    }

    // --- Commutation loop --------------------------------------------------
    while (state != MotorState::Fault) {

        const bldc::RampPoint point = bldc::evaluate_ramp(ramp_elapsed_ms);  // Rate and duty for right now.

        // Mark the top of every electrical revolution on the sync pin so a
        // scope can trigger on a repeatable point in the sequence.
        driver.pulse_sync(step_index == 0U);

        if (driver.apply_step(step_index, point.duty_percent) != 0) {        // Drive the bridges.
            state = MotorState::Fault;
            break;
        }

        // Arm a one-shot timer for the dwell time, then block on it. Using the
        // timer rather than k_sleep() keeps the commutation period referenced
        // to the kernel clock, so scheduling jitter does not accumulate into
        // a slowly drifting electrical frequency.
        k_timer_start(&commutation_timer, K_USEC(point.step_period_us), K_NO_WAIT);
        (void)k_timer_status_sync(&commutation_timer);                        // Sleep until this step's dwell expires.

        step_index = bldc::next_step(step_index, kForwardRotation);           // Advance the sequence.

        if (step_index == 0U) {                                               // Wrapped -> one electrical revolution done.
            electrical_revs++;
        }

        const uint32_t elapsed_step_ms = point.step_period_us / 1000U;        // Approximate ms consumed by this step.

        if (state == MotorState::Ramp) {
            ramp_elapsed_ms += elapsed_step_ms;                               // Advance along the ramp.

            if (ramp_elapsed_ms >= bldc::kRampDurationMs) {                   // Ramp finished.
                ramp_elapsed_ms = bldc::kRampDurationMs;                      // Pin it so evaluate_ramp() saturates.
                state = MotorState::Run;
                LOG_INF("state: RUN (steady at %u us/step, %u%% duty)",
                        point.step_period_us, point.duty_percent);
            }
        } else {
            log_accumulator_ms += elapsed_step_ms;                            // Run state: periodic telemetry only.

            if (log_accumulator_ms >= kLogIntervalMs) {
                log_accumulator_ms = 0U;
                LOG_INF("running: %u us/step, %u%% duty, %u elec revs",
                        point.step_period_us, point.duty_percent, electrical_revs);
            }
        }
    }

    // --- Fault -------------------------------------------------------------
    driver.coast();                                                           // Bridges off, windings free.
    driver.pulse_sync(false);                                                 // Leave the trigger line idle.
    LOG_ERR("state: FAULT - inverter disabled, motor coasting");

    while (true) {                                                            // Park the thread; require a reset to recover.
        k_msleep(1000);
    }
}

}  // namespace

int main() {

    LOG_INF("open-loop BLDC commutation starting (NUCLEO-G474RE / TIM1)");

    if (driver.init() != 0) {                                                 // Validate PWM channels and GPIOs.
        LOG_ERR("inverter init failed - not spinning the motor");
        return -1;                                                            // Nothing is ever energised on this path.
    }

    const k_tid_t tid = k_thread_create(&commutation_thread_data,             // Spawn the timing-critical thread.
                                        commutation_stack,
                                        K_THREAD_STACK_SIZEOF(commutation_stack),
                                        commutation_thread_entry,
                                        nullptr, nullptr, nullptr,
                                        kCommutationPriority,
                                        0,
                                        K_NO_WAIT);

    (void)k_thread_name_set(tid, "commutation");                              // Name it for shell / thread analyzer output.

    while (true) {                                                            // Main thread stays idle; commutation runs elsewhere.
        k_msleep(1000);
    }

    return 0;                                                                 // Unreachable.
}
```

## src/bldc_driver.cpp
```c
#include "bldc_driver.hpp"                                         // Class declaration.

#include <zephyr/devicetree.h>                                     // DT_ALIAS / DT_NODELABEL macros.
#include <zephyr/logging/log.h>                                    // Logging macros.

LOG_MODULE_REGISTER(bldc_driver, LOG_LEVEL_INF);                   // Log module for the inverter driver layer.

namespace bldc {

namespace {                                                        // Private linkage for the devicetree bindings.

// --- PWM inputs: TIM1_CH1/CH2/CH3 -> PC0 / PC1 / PC2 -----------------------
// All three channels share TIM1, so they share one period and stay phase
// coherent - exactly what a three-phase inverter wants.
const pwm_dt_spec kPhaseA = PWM_DT_SPEC_GET_BY_NAME(DT_PATH(bldc_motor), phase_a);
const pwm_dt_spec kPhaseB = PWM_DT_SPEC_GET_BY_NAME(DT_PATH(bldc_motor), phase_b);
const pwm_dt_spec kPhaseC = PWM_DT_SPEC_GET_BY_NAME(DT_PATH(bldc_motor), phase_c);

// --- Shutdown / enable pins: one per IR2104 --------------------------------
// The overlay declares these GPIO_ACTIVE_LOW because IR2104 SD is active-low
// in silicon. Zephyr's logical-level API means gpio_pin_set(..., 1) always
// reads as "bridge active" here, whatever the electrical polarity.
const gpio_dt_spec kEnableA = GPIO_DT_SPEC_GET_BY_IDX(DT_PATH(bldc_motor), enable_gpios, 0);
const gpio_dt_spec kEnableB = GPIO_DT_SPEC_GET_BY_IDX(DT_PATH(bldc_motor), enable_gpios, 1);
const gpio_dt_spec kEnableC = GPIO_DT_SPEC_GET_BY_IDX(DT_PATH(bldc_motor), enable_gpios, 2);

// --- Scope trigger ---------------------------------------------------------
const gpio_dt_spec kSyncPin = GPIO_DT_SPEC_GET(DT_PATH(bldc_motor), sync_gpios);

constexpr uint32_t kPwmPeriodNs = 50000U;                          // 20 kHz carrier - above audible, easy to filter on a scope.

}  // namespace

int BldcDriver::init() noexcept {

    const pwm_dt_spec* const pwm_channels[3] = {&kPhaseA, &kPhaseB, &kPhaseC};   // Iterate the three PWM channels.

    for (const pwm_dt_spec* const channel : pwm_channels) {                       // Validate each PWM binding.
        if (!pwm_is_ready_dt(channel)) {
            LOG_ERR("PWM channel not ready (dev=%s ch=%u)",
                    (channel->dev != nullptr) ? channel->dev->name : "<null>",
                    channel->channel);
            return -ENODEV;                                                       // Refuse to run with half a bridge.
        }
    }

    const gpio_dt_spec* const gpio_outputs[4] = {&kEnableA, &kEnableB, &kEnableC, &kSyncPin};  // All GPIO outputs.

    for (const gpio_dt_spec* const pin : gpio_outputs) {                          // Validate and configure each GPIO.
        if (!gpio_is_ready_dt(pin)) {
            LOG_ERR("GPIO not ready (port=%s pin=%u)",
                    (pin->port != nullptr) ? pin->port->name : "<null>", pin->pin);
            return -ENODEV;
        }

        const int err = gpio_pin_configure_dt(pin, GPIO_OUTPUT_INACTIVE);         // Start inactive: bridges disabled.
        if (err != 0) {
            LOG_ERR("gpio_pin_configure_dt failed (pin=%u err=%d)", pin->pin, err);
            return err;
        }
    }

    ready_ = true;                                                                // Hardware validated.

    coast();                                                                      // Guarantee a known safe state before returning.

    LOG_INF("inverter ready: 20 kHz carrier, 3x half-bridge, six-step table");

    return 0;
}

int BldcDriver::set_phase(const pwm_dt_spec& pwm_ch,
                          const gpio_dt_spec& enable_pin,
                          PhaseState state,
                          uint32_t duty_percent) noexcept {

    uint32_t pulse_ns = 0U;                                                       // Default: IN low.
    bool enable = false;                                                          // Default: bridge disabled.

    switch (state) {
        case PhaseState::High:                                                    // Sourcing phase: chop the high side.
            pulse_ns = duty_to_pulse_ns(kPwmPeriodNs, duty_percent);
            enable   = true;
            break;

        case PhaseState::Low:                                                     // Sinking phase: IN held low, low side fully on.
            pulse_ns = 0U;
            enable   = true;
            break;

        case PhaseState::Float:                                                   // Idle phase: bridge off, winding high-Z.
        default:
            pulse_ns = 0U;
            enable   = false;
            break;
    }

    const int pwm_err = pwm_set_dt(&pwm_ch, kPwmPeriodNs, pulse_ns);              // Program the timer channel.
    if (pwm_err != 0) {
        LOG_ERR("pwm_set_dt failed (ch=%u err=%d)", pwm_ch.channel, pwm_err);
        return pwm_err;
    }

    const int gpio_err = gpio_pin_set_dt(&enable_pin, enable ? 1 : 0);            // Then enable or disable the bridge.
    if (gpio_err != 0) {
        LOG_ERR("gpio_pin_set_dt failed (pin=%u err=%d)", enable_pin.pin, gpio_err);
        return gpio_err;
    }

    return 0;
}

int BldcDriver::apply_step(uint8_t step_index, uint32_t duty_percent) noexcept {

    if (!ready_) {                                                                // Never touch hardware before init().
        return -EPERM;
    }

    if (step_index >= kStepsPerElectricalRev) {                                   // Guard against a corrupt step counter.
        LOG_ERR("invalid step index %u", step_index);
        coast();
        return -EINVAL;
    }

    const CommutationStep& step = kCommutationTable[step_index];                  // Look up the phase pattern.

    // Phase 1: drop the enables of every bridge that must float in the new
    // step *before* reprogramming anything, so no winding is ever driven with
    // a stale pattern during the transition.
    if (step.phase_a == PhaseState::Float) { (void)gpio_pin_set_dt(&kEnableA, 0); }
    if (step.phase_b == PhaseState::Float) { (void)gpio_pin_set_dt(&kEnableB, 0); }
    if (step.phase_c == PhaseState::Float) { (void)gpio_pin_set_dt(&kEnableC, 0); }

    // Phase 2: program duty and enable for each phase in turn.
    int err = set_phase(kPhaseA, kEnableA, step.phase_a, duty_percent);
    if (err == 0) { err = set_phase(kPhaseB, kEnableB, step.phase_b, duty_percent); }
    if (err == 0) { err = set_phase(kPhaseC, kEnableC, step.phase_c, duty_percent); }

    if (err != 0) {                                                               // Any failure mid-step is unsafe.
        LOG_ERR("apply_step(%u) failed (err=%d) - coasting", step_index, err);
        coast();
    }

    return err;
}

void BldcDriver::coast() noexcept {

    (void)gpio_pin_set_dt(&kEnableA, 0);                                          // Disable bridge A.
    (void)gpio_pin_set_dt(&kEnableB, 0);                                          // Disable bridge B.
    (void)gpio_pin_set_dt(&kEnableC, 0);                                          // Disable bridge C.

    (void)pwm_set_dt(&kPhaseA, kPwmPeriodNs, 0U);                                 // Zero duty on A.
    (void)pwm_set_dt(&kPhaseB, kPwmPeriodNs, 0U);                                 // Zero duty on B.
    (void)pwm_set_dt(&kPhaseC, kPwmPeriodNs, 0U);                                 // Zero duty on C.
}

void BldcDriver::pulse_sync(bool level) noexcept {
    (void)gpio_pin_set_dt(&kSyncPin, level ? 1 : 0);                              // Scope trigger marker.
}

}  // namespace bldc
```

## src/bldc_driver.hpp
```c
#ifndef BLDC_DRIVER_HPP                                            // Include guard opens.
#define BLDC_DRIVER_HPP                                            // Include guard symbol.

#include <cstdint>                                                 // Fixed-width integer types.

#include <zephyr/device.h>                                         // Zephyr device structure.
#include <zephyr/drivers/gpio.h>                                   // gpio_dt_spec for the bridge enable pins.
#include <zephyr/drivers/pwm.h>                                    // pwm_dt_spec / pwm_set for the phase inputs.

#include "commutation_profile.hpp"                                 // Step table, ramp maths, tuning constants.

namespace bldc {

// Drives a three-phase inverter built from three half-bridge gate drivers of
// the IR2104 family (or any EN/IN style driver such as L6234 or DRV8313).
//
// Each phase needs two MCU signals:
//   IN  -> a TIM1 PWM channel  (decides high-side vs low-side conduction)
//   SD  -> a plain GPIO        (asserted = bridge active, deasserted = high-Z)
//
// The class owns no dynamic memory and performs no allocation at any point.
class BldcDriver {
public:
    BldcDriver() = default;                                        // Trivially constructible; real setup happens in init().

    BldcDriver(const BldcDriver&)            = delete;             // Non-copyable: it owns hardware.
    BldcDriver& operator=(const BldcDriver&) = delete;             // Non-copyable.
    BldcDriver(BldcDriver&&)                 = delete;             // Non-movable.
    BldcDriver& operator=(BldcDriver&&)      = delete;             // Non-movable.

    // Validates every device binding and forces the inverter into a safe
    // (all bridges disabled, all duties zero) state. Returns 0 on success.
    int init() noexcept;

    // Applies one entry of the six-step table at the requested duty.
    // Sequencing is float-first, then re-program, then enable, so the two
    // conducting bridges are never reconfigured while still energised.
    int apply_step(uint8_t step_index, uint32_t duty_percent) noexcept;

    // Disables all three bridges and zeroes all three PWM channels.
    // Safe to call from an error path or at any time.
    void coast() noexcept;

    // Drives the scope-trigger pin. Pulsed once per electrical revolution so a
    // scope can be triggered on a known point in the commutation sequence.
    void pulse_sync(bool level) noexcept;

private:
    int set_phase(const pwm_dt_spec& pwm_ch,
                  const gpio_dt_spec& enable_pin,
                  PhaseState state,
                  uint32_t duty_percent) noexcept;                 // Applies one phase's half of a step.

    bool ready_{false};                                            // True once init() has validated all hardware.
};

}  // namespace bldc

#endif  // BLDC_DRIVER_HPP
```

## src/commutation_profile.hpp
```c
#ifndef COMMUTATION_PROFILE_HPP                                    // Include guard opens.
#define COMMUTATION_PROFILE_HPP                                    // Include guard symbol.

#include <array>                                                   // std::array for the fixed six-step table.
#include <cstdint>                                                 // Fixed-width integer types.

// This header is deliberately free of any Zephyr dependency so the
// commutation table and the open-loop ramp maths can be compiled and
// unit-tested on the host with GTest (see tests/).

namespace bldc {

// ---------------------------------------------------------------------------
// Six-step (trapezoidal) commutation table
// ---------------------------------------------------------------------------

enum class PhaseState : uint8_t {                                  // What a single half-bridge must do in a step.
    Float = 0U,                                                    // Bridge disabled (SD asserted) -> phase is high-Z.
    High  = 1U,                                                    // Bridge enabled, IN driven with PWM -> sourcing.
    Low   = 2U                                                     // Bridge enabled, IN held at 0 -> sinking to ground.
};

struct CommutationStep {                                           // One entry of the six-step sequence.
    PhaseState phase_a;                                            // State of phase A half-bridge.
    PhaseState phase_b;                                            // State of phase B half-bridge.
    PhaseState phase_c;                                            // State of phase C half-bridge.
};

inline constexpr uint8_t kStepsPerElectricalRev = 6U;              // Six-step commutation -> 6 steps per electrical revolution.

// Standard 120-degree conduction sequence. In every step exactly one phase
// sources current, one sinks it, and one floats (the floating phase is where
// back-EMF would be measured in a sensorless closed-loop design).
inline constexpr std::array<CommutationStep, kStepsPerElectricalRev> kCommutationTable = {{
    {PhaseState::High,  PhaseState::Low,   PhaseState::Float},     // Step 0: A -> B.
    {PhaseState::High,  PhaseState::Float, PhaseState::Low  },     // Step 1: A -> C.
    {PhaseState::Float, PhaseState::High,  PhaseState::Low  },     // Step 2: B -> C.
    {PhaseState::Low,   PhaseState::High,  PhaseState::Float},     // Step 3: B -> A.
    {PhaseState::Low,   PhaseState::Float, PhaseState::High },     // Step 4: C -> A.
    {PhaseState::Float, PhaseState::Low,   PhaseState::High }      // Step 5: C -> B.
}};

// Returns the next step index, honouring the requested direction of rotation.
// Reversing the traversal order of the same table reverses the motor.
constexpr uint8_t next_step(uint8_t current_step, bool forward) noexcept {
    if (forward) {
        return static_cast<uint8_t>((current_step + 1U) % kStepsPerElectricalRev);
    }
    return static_cast<uint8_t>((current_step + (kStepsPerElectricalRev - 1U)) % kStepsPerElectricalRev);
}

// ---------------------------------------------------------------------------
// Open-loop ramp profile
// ---------------------------------------------------------------------------

// Tuning constants. These are the knobs to turn when a particular motor
// stalls on start-up or loses sync during the ramp.
inline constexpr uint32_t kAlignDurationMs      = 750U;            // Time spent parking the rotor on step 0 before ramping.
inline constexpr uint32_t kAlignDutyPercent     = 20U;             // Duty used during alignment (enough to pull the rotor in).

inline constexpr uint32_t kStartStepRateMilliHz = 50000U;          // 50 steps/s  -> 20.0 ms per step (slow crawl).
inline constexpr uint32_t kRunStepRateMilliHz   = 660000U;         // 660 steps/s -> ~1.52 ms per step (final cruise).
inline constexpr uint32_t kRampDurationMs       = 5000U;           // Time taken to climb from start rate to run rate.

inline constexpr uint32_t kStartDutyPercent     = 18U;             // Duty at the bottom of the ramp.
inline constexpr uint32_t kRunDutyPercent       = 45U;             // Duty at the top of the ramp.
inline constexpr uint32_t kMaxDutyPercent       = 60U;             // Hard ceiling; never exceeded regardless of tuning.

struct RampPoint {                                                 // Result of evaluating the ramp at one instant.
    uint32_t step_period_us;                                       // How long to dwell on the current commutation step.
    uint32_t duty_percent;                                         // PWM duty applied to the sourcing phase.
};

// Linear ramp in *commutation rate* (not in period), which gives constant
// angular acceleration rather than an acceleration that tails off. Duty is
// raised in step with the rate - a crude constant V/f law that keeps enough
// torque available as the electrical frequency climbs.
constexpr RampPoint evaluate_ramp(uint32_t elapsed_ms) noexcept {
    const uint32_t clamped_ms =
        (elapsed_ms > kRampDurationMs) ? kRampDurationMs : elapsed_ms;      // Saturate once the ramp completes.

    const uint64_t rate_span =
        static_cast<uint64_t>(kRunStepRateMilliHz - kStartStepRateMilliHz);  // Total rate increase across the ramp.

    const uint64_t rate_millihz =
        static_cast<uint64_t>(kStartStepRateMilliHz) +
        ((rate_span * static_cast<uint64_t>(clamped_ms)) / static_cast<uint64_t>(kRampDurationMs));
    // Interpolated commutation rate in milli-steps per second.

    const uint32_t period_us =
        static_cast<uint32_t>(1000000000ULL / rate_millihz);                 // Convert rate to a per-step dwell time.

    const uint64_t duty_span =
        static_cast<uint64_t>(kRunDutyPercent - kStartDutyPercent);          // Total duty increase across the ramp.

    uint32_t duty_percent =
        static_cast<uint32_t>(static_cast<uint64_t>(kStartDutyPercent) +
                              ((duty_span * static_cast<uint64_t>(clamped_ms)) /
                               static_cast<uint64_t>(kRampDurationMs)));
    // Interpolated duty, matched to the interpolated rate (V/f).

    if (duty_percent > kMaxDutyPercent) {                                    // Defensive clamp against mis-tuning.
        duty_percent = kMaxDutyPercent;
    }

    return RampPoint{period_us, duty_percent};
}

// Converts a duty percentage into a PWM pulse width for a given period.
constexpr uint32_t duty_to_pulse_ns(uint32_t period_ns, uint32_t duty_percent) noexcept {
    const uint32_t clamped =
        (duty_percent > kMaxDutyPercent) ? kMaxDutyPercent : duty_percent;   // Never let a bad caller over-drive the bridge.
    return static_cast<uint32_t>((static_cast<uint64_t>(period_ns) *
                                  static_cast<uint64_t>(clamped)) / 100ULL);
}

}  // namespace bldc

#endif  // COMMUTATION_PROFILE_HPP
```
