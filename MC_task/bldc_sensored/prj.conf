## CMakeLists.txt
```
cmake_minimum_required(VERSION 3.20.0)

set(CMAKE_CXX_STANDARD 20)
set(CMAKE_CXX_STANDARD_REQUIRED ON)
set(CMAKE_CXX_EXTENSIONS OFF)

# Overlay lives in "Board/" (capital B, singular), not Zephyr's
# auto-detected "boards/" convention, so DTC_OVERLAY_FILE must be set
# explicitly before find_package(Zephyr ...).
set(DTC_OVERLAY_FILE ${CMAKE_CURRENT_SOURCE_DIR}/Board/nucleo_g474re.overlay)

find_package(Zephyr REQUIRED HINTS $ENV{ZEPHYR_BASE})
project(Bldc_Sensored_SixStep LANGUAGES CXX)

target_sources(app PRIVATE
  ${CMAKE_CURRENT_SOURCE_DIR}/src/main.cpp
  ${CMAKE_CURRENT_SOURCE_DIR}/src/phase_driver.cpp
  ${CMAKE_CURRENT_SOURCE_DIR}/src/hall_sensor.cpp
  ${CMAKE_CURRENT_SOURCE_DIR}/src/motor_controller.cpp
)

target_compile_options(app PRIVATE
  -Wall
  -Wextra
  -Werror
  -Wvolatile
)
```

## prj.conf
```kconfig
# --- Core ---------------------------------------------------------------
CONFIG_CPP=y
CONFIG_STD_CPP20=y
CONFIG_GLIBCXX_LIBCPP=y
CONFIG_NEWLIB_LIBC=y
CONFIG_MAIN_STACK_SIZE=4096

# --- PWM (TIM1 CH1/CH2/CH3 -> phase U/V/W) -------------------------------
CONFIG_PWM=y
CONFIG_PWM_STM32=y

# --- GPIO (phase driver enables + hall sensor inputs) --------------------
CONFIG_GPIO=y

# --- Hall interrupts run on the system workqueue -------------------------
CONFIG_SYSTEM_WORKQUEUE_STACK_SIZE=2048

# --- Logging --------------------------------------------------------------------
CONFIG_LOG=y
CONFIG_LOG_MODE_DEFERRED=y
CONFIG_LOG_DEFAULT_LEVEL=3

# --- Console (routed to UART on this board) ---------------------------------------
CONFIG_CONSOLE=y
CONFIG_UART_CONSOLE=y
```

## src/main.cpp
```c
#include <array>

#include <zephyr/devicetree.h>
#include <zephyr/drivers/gpio.h>
#include <zephyr/drivers/pwm.h>
#include <zephyr/kernel.h>
#include <zephyr/logging/log.h>

#include "hall_sensor.hpp"
#include "motor_controller.hpp"
#include "phase_driver.hpp"

LOG_MODULE_REGISTER(bldc_sensored, LOG_LEVEL_INF);

namespace {

// zephyr,user node in Board/nucleo_g474re.overlay holds the per-phase
// enable GPIOs and the hall sensor GPIOs.
#define BLDC_IO_NODE DT_PATH(zephyr_user)

const bldc::PhaseDriver::PhaseHw kPhaseU{
    .pwm = PWM_DT_SPEC_GET(DT_ALIAS(bldc_pwm_u)),
    .enable = GPIO_DT_SPEC_GET_BY_IDX(BLDC_IO_NODE, phase_en_gpios, 0),
};
const bldc::PhaseDriver::PhaseHw kPhaseV{
    .pwm = PWM_DT_SPEC_GET(DT_ALIAS(bldc_pwm_v)),
    .enable = GPIO_DT_SPEC_GET_BY_IDX(BLDC_IO_NODE, phase_en_gpios, 1),
};
const bldc::PhaseDriver::PhaseHw kPhaseW{
    .pwm = PWM_DT_SPEC_GET(DT_ALIAS(bldc_pwm_w)),
    .enable = GPIO_DT_SPEC_GET_BY_IDX(BLDC_IO_NODE, phase_en_gpios, 2),
};

const bldc::HallSensor::HallHw kHallHw{
    .u = GPIO_DT_SPEC_GET_BY_IDX(BLDC_IO_NODE, hall_gpios, 0),
    .v = GPIO_DT_SPEC_GET_BY_IDX(BLDC_IO_NODE, hall_gpios, 1),
    .w = GPIO_DT_SPEC_GET_BY_IDX(BLDC_IO_NODE, hall_gpios, 2),
};

bldc::MotorController* g_controller = nullptr;  // Set once in main(); read-only after that.
gpio_callback g_hall_callback{};

// Hall transitions commutate through the system workqueue rather than
// straight out of the GPIO ISR: PhaseDriver's calls into the PWM and
// GPIO drivers aren't guaranteed-safe from interrupt context on every
// backend, and keeping the ISR to "just submit work" keeps interrupt
// latency predictable regardless of what Commutate() ends up doing.
void HallWorkHandler(k_work*) {
    if (g_controller != nullptr) {
        g_controller->OnHallChange();
    }
}
K_WORK_DEFINE(g_hall_work, HallWorkHandler);

void HallIsr(const device*, gpio_callback*, uint32_t) {
    k_work_submit(&g_hall_work);
}

void StallTimerHandler(k_timer*) {
    if (g_controller != nullptr) {
        g_controller->CheckStall();
    }
}
K_TIMER_DEFINE(g_stall_timer, StallTimerHandler, nullptr);

}  // namespace

int main() {
    LOG_INF("Sensored BLDC six-step commutation booting");

    const std::array<bldc::PhaseDriver::PhaseHw, 3U> phases{kPhaseU, kPhaseV, kPhaseW};
    bldc::PhaseDriver driver(phases);
    bldc::HallSensor hall(kHallHw);
    bldc::MotorController controller(driver, hall);
    g_controller = &controller;

    if (!controller.Init()) {
        LOG_ERR("Motor controller init failed - halting");
        return -1;
    }

    if (!hall.Init(HallIsr, g_hall_callback)) {
        LOG_ERR("Hall sensor init failed - halting");
        return -1;
    }

    // Commutate once immediately so the motor starts turning right away
    // even if the rotor is already sitting mid-sector (i.e. not on a
    // hall edge) at boot.
    controller.Commutate();

    k_timer_start(&g_stall_timer, K_MSEC(100), K_MSEC(100));

    while (true) {
        k_msleep(1000);
    }

    return 0;
}
```

## src/bldc_types.hpp
```c
#pragma once

#include <cstdint>

namespace bldc {

enum class Phase : uint8_t { kU = 0U, kV = 1U, kW = 2U };

enum class ZeroCrossEdge : uint8_t { kRising = 0U, kFalling = 1U };

}  // namespace bldc
```

## src/hall_commutation_table.hpp
```c
#pragma once

#include <array>

#include "bldc_types.hpp"

namespace bldc {

struct HallCommutationStep {
    Phase high_phase;
    Phase low_phase;
    Phase floating_phase;
    bool valid;
};

// Hall code (bit0 = U, bit1 = V, bit2 = W) -> commutation step. Codes 0
// (000) and 7 (111) can't happen with correctly wired 120-degree hall
// sensors and mean a hall wire fault, a disconnected sensor, or missing
// hall supply power.
//
// Hall electrical alignment is NOT standardized across motor vendors -
// this is the commonly published 1-3-2-6-4-5 sequence, but treat it as a
// first guess. To calibrate for your motor: spin the shaft by hand in
// the direction you want to call "forward" and log ReadCode() at each of
// the 6 transitions in order, then reorder this table so each code maps
// to the step that should follow it (the standard hall-drive calibration
// procedure).
inline constexpr std::array<HallCommutationStep, 8U> kHallCommutationTable{{
    /* code 0 (000) */ {Phase::kU, Phase::kU, Phase::kU, false},
    /* code 1 (001) */ {Phase::kU, Phase::kV, Phase::kW, true},
    /* code 2 (010) */ {Phase::kV, Phase::kW, Phase::kU, true},
    /* code 3 (011) */ {Phase::kU, Phase::kW, Phase::kV, true},
    /* code 4 (100) */ {Phase::kW, Phase::kU, Phase::kV, true},
    /* code 5 (101) */ {Phase::kW, Phase::kV, Phase::kU, true},
    /* code 6 (110) */ {Phase::kV, Phase::kU, Phase::kW, true},
    /* code 7 (111) */ {Phase::kU, Phase::kU, Phase::kU, false},
}};

}  // namespace bldc
```

## src/hall_sensor.cpp
```c
#include "hall_sensor.hpp"

#include <array>

#include <zephyr/logging/log.h>

LOG_MODULE_REGISTER(bldc_hall_sensor, LOG_LEVEL_INF);

namespace bldc {

HallSensor::HallSensor(const HallHw& hw) : hw_(hw) {}

bool HallSensor::Init(gpio_callback_handler_t handler, gpio_callback& callback_data) {
    const std::array<const gpio_dt_spec*, 3U> pins{&hw_.u, &hw_.v, &hw_.w};

    for (const auto* pin : pins) {
        if (!gpio_is_ready_dt(pin)) {
            LOG_ERR("Hall GPIO not ready");
            return false;
        }
        if (gpio_pin_configure_dt(pin, GPIO_INPUT) != 0) {
            LOG_ERR("Failed to configure hall GPIO as input");
            return false;
        }
        if (gpio_pin_interrupt_configure_dt(pin, GPIO_INT_EDGE_BOTH) != 0) {
            LOG_ERR("Failed to configure hall GPIO interrupt");
            return false;
        }
    }

    gpio_init_callback(&callback_data, handler,
                        BIT(hw_.u.pin) | BIT(hw_.v.pin) | BIT(hw_.w.pin));

    if (gpio_add_callback(hw_.u.port, &callback_data) != 0) {
        LOG_ERR("Failed to add hall GPIO callback");
        return false;
    }

    return true;
}

uint8_t HallSensor::ReadCode() const {
    const int u = gpio_pin_get_dt(&hw_.u);
    const int v = gpio_pin_get_dt(&hw_.v);
    const int w = gpio_pin_get_dt(&hw_.w);

    if ((u < 0) || (v < 0) || (w < 0)) {
        return 0U;  // Invalid code - caller treats this as a fault.
    }

    return static_cast<uint8_t>((static_cast<uint8_t>(u) << 0U) |
                                 (static_cast<uint8_t>(v) << 1U) |
                                 (static_cast<uint8_t>(w) << 2U));
}

}  // namespace bldc
```

## src/hall_sensor.hpp
```c
#pragma once

#include <cstdint>

#include <zephyr/drivers/gpio.h>

namespace bldc {

// Reads three 120-degree-spaced hall sensor inputs and registers a
// combined edge interrupt for them.
//
// Simplification: assumes all three hall pins live on the same GPIO
// port, since gpio_add_callback() registers per-port. If your hall
// sensors are wired across multiple ports, register one gpio_callback
// per port instead of the single one used here.
class HallSensor {
public:
    struct HallHw {
        gpio_dt_spec u;
        gpio_dt_spec v;
        gpio_dt_spec w;
    };

    explicit HallSensor(const HallHw& hw);

    // handler/callback_data must outlive the HallSensor (pass a
    // statically-allocated gpio_callback, as in main.cpp).
    [[nodiscard]] bool Init(gpio_callback_handler_t handler, gpio_callback& callback_data);

    // Combines the three current pin states into a 3-bit code:
    // bit0 = U, bit1 = V, bit2 = W. Returns 0 (an invalid/fault code) if
    // any pin read fails.
    [[nodiscard]] uint8_t ReadCode() const;

private:
    HallHw hw_;
};

}  // namespace bldc
```

## src/motor_controller.cpp
```c
#include "motor_controller.hpp"

#include <zephyr/kernel.h>
#include <zephyr/logging/log.h>

#include "hall_commutation_table.hpp"

LOG_MODULE_REGISTER(bldc_motor_controller, LOG_LEVEL_INF);

namespace bldc {
namespace {

constexpr uint32_t kDutyPercent = 35U;  // Placeholder - tune for your motor/load.
constexpr int64_t kStallTimeoutMs = 500;

}  // namespace

MotorController::MotorController(PhaseDriver& driver, HallSensor& hall)
    : driver_(driver), hall_(hall) {}

bool MotorController::Init() {
    if (!driver_.Init()) {
        return false;
    }
    driver_.AllOff();
    return true;
}

void MotorController::Commutate() {
    const uint8_t code = hall_.ReadCode();
    const auto& step = kHallCommutationTable[code];

    if (!step.valid) {
        Fault("invalid hall code (0 or 7) - check hall wiring/power");
        return;
    }

    if (!driver_.ApplyStep(step.high_phase, step.low_phase, step.floating_phase, kDutyPercent)) {
        Fault("phase driver failure");
        return;
    }

    running_ = true;
    last_transition_uptime_ = k_uptime_get();
}

void MotorController::OnHallChange() {
    Commutate();
}

void MotorController::CheckStall() {
    if (!running_) {
        return;
    }
    if ((k_uptime_get() - last_transition_uptime_) > kStallTimeoutMs) {
        Fault("stall detected: no hall transition within timeout");
    }
}

void MotorController::Fault(const char* reason) {
    LOG_ERR("Motor fault: %s - cutting all phases", reason);
    driver_.AllOff();
    running_ = false;
}

}  // namespace bldc
```

## src/motor_controller.hpp
```c
#pragma once

#include <cstdint>

#include "hall_sensor.hpp"
#include "phase_driver.hpp"

namespace bldc {

// Sensored six-step trapezoidal BLDC controller. Unlike the sensorless
// version, hall sensors give absolute rotor position immediately, so
// there's no align/ramp: the first hall code read is commutated directly,
// and every subsequent hall transition commutates again.
class MotorController {
public:
    MotorController(PhaseDriver& driver, HallSensor& hall);

    [[nodiscard]] bool Init();

    // Reads the current hall code and applies the matching commutation
    // step. Call once at startup, and again from OnHallChange() on every
    // hall transition.
    void Commutate();

    // Call from a deferred (thread/workqueue) context whenever any hall
    // pin transitions - see main.cpp for why this isn't called directly
    // from the GPIO ISR.
    void OnHallChange();

    // Call periodically (e.g. every 100 ms from a k_timer). If the motor
    // is expected to be running but no hall transition has been seen
    // within the stall timeout, cuts all phases - catches a stalled
    // rotor or a disconnected/powered-down hall sensor.
    void CheckStall();

private:
    void Fault(const char* reason);

    PhaseDriver& driver_;
    HallSensor& hall_;
    int64_t last_transition_uptime_ = 0;
    bool running_ = false;
};

}  // namespace bldc
```

## src/phase_driver.cpp
```c
#include "phase_driver.hpp"

#include <zephyr/logging/log.h>

LOG_MODULE_REGISTER(bldc_phase_driver, LOG_LEVEL_INF);

namespace bldc {

PhaseDriver::PhaseDriver(const std::array<PhaseHw, 3U>& phases) : phases_(phases) {}

bool PhaseDriver::Init() {
    for (const auto& hw : phases_) {
        if (!pwm_is_ready_dt(&hw.pwm)) {
            LOG_ERR("Phase PWM device not ready");
            return false;
        }
        if (!gpio_is_ready_dt(&hw.enable)) {
            LOG_ERR("Phase enable GPIO not ready");
            return false;
        }
        if (gpio_pin_configure_dt(&hw.enable, GPIO_OUTPUT_INACTIVE) != 0) {
            LOG_ERR("Failed to configure phase enable GPIO");
            return false;
        }
    }
    return true;
}

bool PhaseDriver::DriveHigh(Phase phase, uint32_t duty_percent) {
    const auto idx = static_cast<uint8_t>(phase);
    if (gpio_pin_set_dt(&phases_[idx].enable, 1) != 0) {
        return false;
    }
    const uint32_t pulse_ns = (phases_[idx].pwm.period * duty_percent) / 100U;
    return pwm_set_pulse_dt(&phases_[idx].pwm, pulse_ns) == 0;
}

bool PhaseDriver::DriveLow(Phase phase) {
    const auto idx = static_cast<uint8_t>(phase);
    if (gpio_pin_set_dt(&phases_[idx].enable, 1) != 0) {
        return false;
    }
    return pwm_set_pulse_dt(&phases_[idx].pwm, 0U) == 0;
}

bool PhaseDriver::Float(Phase phase) {
    const auto idx = static_cast<uint8_t>(phase);
    // Zero the duty first so nothing is driven the instant enable drops.
    static_cast<void>(pwm_set_pulse_dt(&phases_[idx].pwm, 0U));
    return gpio_pin_set_dt(&phases_[idx].enable, 0) == 0;
}

bool PhaseDriver::ApplyStep(Phase high_phase, Phase low_phase, Phase floating_phase,
                             uint32_t duty_percent) {
    // Float the outgoing phase first so it never overlaps a driven state.
    if (!Float(floating_phase)) {
        return false;
    }
    if (!DriveLow(low_phase)) {
        return false;
    }
    return DriveHigh(high_phase, duty_percent);
}

void PhaseDriver::AllOff() {
    for (uint8_t i = 0U; i < phases_.size(); ++i) {
        static_cast<void>(Float(static_cast<Phase>(i)));
    }
}

}  // namespace bldc
```
